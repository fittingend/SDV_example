AUTOSAR XML (schema 00049)
package /Application/DltConfig
  dlt log channel to process mapping DltLogChannelToProcessMapping_DummyTest_Consumer_TO_DummyTest_Consumer: dlt-log-channel=DummyTest_Consumer, process=DummyTest_Consumer
  dlt log channel to process mapping DltLogChannelToProcessMapping_DummyTest_Provider_TO_DummyTest_Provider: dlt-log-channel=DummyTest_Provider, process=DummyTest_Provider
package /Application/Executable
  executable DummyTest_Consumer: category=APPLICATION_LEVEL, logging-behavior=USES-LOGGING, reporting-behavior=REPORTS-EXECUTION-STATE, version=1.0.0
    root sw component prototype AA: application-type=DummyTest_Consumer
  executable DummyTest_Provider: category=APPLICATION_LEVEL, logging-behavior=USES-LOGGING, reporting-behavior=REPORTS-EXECUTION-STATE, version=1.0.0
    root sw component prototype AA: application-type=DummyTest_Provider
package /Application/Manifest
  service instance to port prototype mapping DummyTest_Consumer_AA_DummyTest_RPort: port-prototype=AA.DummyTest_RPort, process=DummyTest_Consumer, service-instance=DummyTest_Consumer
  service instance to port prototype mapping DummyTest_Provider_AA_DummyTest_PPort: port-prototype=AA.DummyTest_PPort, process=DummyTest_Provider, service-instance=DummyTest_Provider
package /Application/Package/SoftwareCluster_1_0_0
  software cluster DummyTest_Consumer: category=APPLICATION_LAYER, contained-ar-element=DummyTest_Consumer, contained-package-element=DummyTest_Consumer_AA_DummyTest_RPort, contained-process=DummyTest_Consumer, vendor-id=101, vendor-signature=ParaCertificate, version=1.0.0  # 1.0.0
package /Application/Package/SoftwareCluster_1_0_1
  software cluster DummyTest_Consumer: category=APPLICATION_LAYER, contained-ar-element=DummyTest_Consumer, contained-package-element=DummyTest_Consumer_AA_DummyTest_RPort, contained-process=DummyTest_Consumer, vendor-id=101, vendor-signature=ParaCertificate, version=1.0.1  # 1.0.1
package /Application/Package/SoftwarePackage
  software package DummyTest_Consumer_Install_1_0_0: action-type=INSTALL, compressed-software-package-size=0, maximum-supported-ucm-version=1.0.0, minimum-supported-ucm-version=1.0.0, packager-id=101, packager-signature=ParaCertificate, post-verification-reboot=false, pre-activation-reboot=false, software-cluster=SoftwareCluster_1_0_1/DummyTest_Consumer, uncompressed-software-cluster-size=0
  software package DummyTest_Consumer_Remove_1_0_1: action-type=REMOVE, compressed-software-package-size=0, maximum-supported-ucm-version=1.0.1, minimum-supported-ucm-version=1.0.0, packager-id=101, packager-signature=ParaCertificate, post-verification-reboot=false, pre-activation-reboot=false, software-cluster=SoftwareCluster_1_0_1/DummyTest_Consumer, uncompressed-software-cluster-size=0
  software package DummyTest_Consumer_Update_1_0_1: action-type=UPDATE, compressed-software-package-size=0, maximum-supported-ucm-version=1.0.0, minimum-supported-ucm-version=1.0.0, packager-id=101, packager-signature=ParaCertificate, post-verification-reboot=false, pre-activation-reboot=false, software-cluster=SoftwareCluster_1_0_1/DummyTest_Consumer, uncompressed-software-cluster-size=0
package /Application/Package/VehiclePackage
  vehicle package DummyTest_Consumer_Install_1_0_0: vehicle-driver-notification{approval-required=true, notification-state=PROCESS}, packager-signature=ParaCertificate
    rollout-qualifications:
      vehicle rollout step RolloutQualification
        ucm-processings:
          ucm step UcmProcessing: ucm=DummyTest_Consumer_Install_1_0_0/EEVP_UCM
            software package step SoftwarePackageStep: process=DummyTest_Consumer_Install_1_0_0, transfers=software-package-storing={storing=UCM, transfer=DummyTest_Consumer_Install_1_0_0}
    ucm description EEVP_UCM: identifier=EEVP_UCM
  vehicle package DummyTest_Consumer_Remove_1_0_1: vehicle-driver-notification{approval-required=true, notification-state=PROCESS}, packager-signature=ParaCertificate
    rollout-qualifications:
      vehicle rollout step RolloutQualification
        ucm-processings:
          ucm step UcmProcessing: ucm=DummyTest_Consumer_Remove_1_0_1/EEVP_UCM
            software package step SoftwarePackageStep: process=DummyTest_Consumer_Remove_1_0_1, transfers=software-package-storing={storing=UCM, transfer=DummyTest_Consumer_Remove_1_0_1}
    ucm description EEVP_UCM: identifier=EEVP_UCM
  vehicle package DummyTest_Consumer_Update_1_0_1: vehicle-driver-notification{approval-required=true, notification-state=PROCESS}, packager-signature=ParaCertificate
    rollout-qualifications:
      vehicle rollout step RolloutQualification
        ucm-processings:
          ucm step UcmProcessing: ucm=DummyTest_Consumer_Update_1_0_1/EEVP_UCM
            software package step SoftwarePackageStep: process=DummyTest_Consumer_Update_1_0_1, transfers=software-package-storing={storing=UCM, transfer=DummyTest_Consumer_Update_1_0_1}
    ucm description EEVP_UCM: identifier=EEVP_UCM
package /Application/Process
  process DummyTest_Consumer: executable=DummyTest_Consumer, state-dependent-startup-config{function-group-state=[SC.On, SC.Verify], resource-group=DefaultResourceGroup, startup-config=DefaultStartupConfig}
    process state machine DummyTest_Consumer: type=ProcessState
  process DummyTest_Provider: executable=DummyTest_Provider, state-dependent-startup-config{execution-dependency=CM.Running, function-group-state=MachineFG.Startup, resource-group=DefaultResourceGroup, startup-config=DefaultStartupConfig}
    process state machine DummyTest_Provider: type=ProcessState
  process design TestDummy_Consumer: executable=DummyTest_Consumer
  process design TestDummy_Provider: executable=DummyTest_Provider
package /Application/StartupConfig
  startup config set EEVP_DummyTest_StartupConfig
    startup config DummyTest_Consumer: scheduling-policy=SCHED_OTHER, scheduling-priority=0, timeout={enter-timeout-value=2.0, exit-timeout-value=2.0}
    startup config DummyTest_Provider: scheduling-policy=SCHED_OTHER, scheduling-priority=0, timeout={enter-timeout-value=2.0, exit-timeout-value=2.0}
package /Application/SwComponent
  adaptive application sw component type DummyTest_Consumer
    require port DummyTest_RPort: required-interface=DummyTest
  adaptive application sw component type DummyTest_Provider
    provide port DummyTest_PPort: provided-interface=DummyTest
