AUTOSAR XML (schema 00049)
package /Application/DltConfig
  dlt log channel to process mapping DltLogChannelToProcessMapping_AppIpsvTest_TO_AppIpsvTest: dlt-log-channel=AppIpsvTest, process=AppIpsvTest
package /Application/Executable
  executable AppIpsvTest: category=APPLICATION_LEVEL, logging-behavior=USES-LOGGING, reporting-behavior=REPORTS-EXECUTION-STATE, version=1.0.0
    root sw component prototype RootSwComponent: application-type=AppIpsvTest
package /Application/Manifest
  service instance to port prototype mapping AppIpsvTest_RootSwComponent_RPortAdasAppIpsv: port-prototype=RootSwComponent.RPortAdasAppIpsv, process=AppIpsvTest, service-instance=EEVP_AppIpsv_Consumer_AdasAppIpsv
package /Application/Process
  process AppIpsvTest: design=AppIpsvTest_Consumer, executable=AppIpsvTest, state-dependent-startup-config{execution-dependency=SM.Running, function-group-state=MachineFG.Startup, resource-group=DefaultResourceGroup, startup-config=AppIpsvTest}
    process state machine AppIpsvTest: type=ProcessState
  process design AppIpsvTest_Consumer: executable=AppIpsvTest
package /Application/StartupConfig
  startup config set EEVP_AppIpsvTest_StartupConfig
    startup config AppIpsvTest: scheduling-policy=SCHED_OTHER, scheduling-priority=0, timeout={enter-timeout-value=2.0, exit-timeout-value=2.0}
package /Application/SwComponent
  adaptive application sw component type AppIpsvTest
    require port RPortAdasAppIpsv: required-interface=AdasAppIpsv
