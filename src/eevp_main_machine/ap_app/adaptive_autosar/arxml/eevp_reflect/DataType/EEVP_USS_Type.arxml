AUTOSAR XML (schema 00049)
package /DataType/CppImplementationType
  std cpp implementation data type UssData: category=STRUCTURE
    namespaces:
      symbol props zone
      symbol props input
      symbol props type
    72 x cpp implementation data type element:
      TofUpdateFlagDirRSL: type-reference=uint8_t
      TofUpdateFlagIndORSL: type-reference=uint8_t
      TofUpdateFlagDirROL: type-reference=uint8_t
      TofUpdateFlagIndIROL: type-reference=uint8_t
      TofUpdateFlagIndORIL: type-reference=uint8_t
      TofUpdateFlagDirRIL: type-reference=uint8_t
      TofUpdateFlagIndIRIL: type-reference=uint8_t
      TofUpdateFlagIndIRIR: type-reference=uint8_t
      TofUpdateFlagDirRIR: type-reference=uint8_t
      TofUpdateFlagIndORIR: type-reference=uint8_t
      TofUpdateFlagIndIROR: type-reference=uint8_t
      TofUpdateFlagDirROR: type-reference=uint8_t
      TofUpdateFlagIndORSR: type-reference=uint8_t
      TofUpdateFlagDirRSR: type-reference=uint8_t
      TofUpdateFlagDirFSL: type-reference=uint8_t
      TofUpdateFlagIndOFSL: type-reference=uint8_t
      TofUpdateFlagDirFOL: type-reference=uint8_t
      TofUpdateFlagIndIFOL: type-reference=uint8_t
      TofUpdateFlagIndOFIL: type-reference=uint8_t
      TofUpdateFlagDirFIL: type-reference=uint8_t
      TofUpdateFlagIndIFIL: type-reference=uint8_t
      TofUpdateFlagIndIFIR: type-reference=uint8_t
      TofUpdateFlagDirFIR: type-reference=uint8_t
      TofUpdateFlagIndOFIR: type-reference=uint8_t
      TofUpdateFlagIndIFOR: type-reference=uint8_t
      TofUpdateFlagDirFOR: type-reference=uint8_t
      TofUpdateFlagIndOFSR: type-reference=uint8_t
      TofUpdateFlagDirFSR: type-reference=uint8_t
      ProcTof1DirRSL: type-reference=uint16_t
      ProcTof1IndORSL: type-reference=uint16_t
      ProcTof1DirROL: type-reference=uint16_t
      ProcTof1IndIROL: type-reference=uint16_t
      ProcTof1IndORIL: type-reference=uint16_t
      ProcTof1DirRIL: type-reference=uint16_t
      ProcTof1IndIRIL: type-reference=uint16_t
      ProcTof1IndIRIR: type-reference=uint16_t
      ProcTof1DirRIR: type-reference=uint16_t
      ProcTof1IndORIR: type-reference=uint16_t
      ProcTof1IndIROR: type-reference=uint16_t
      ProcTof1DirROR: type-reference=uint16_t
      ProcTof1IndORSR: type-reference=uint16_t
      ProcTof1DirRSR: type-reference=uint16_t
      ProcTof1DirFSL: type-reference=uint16_t
      ProcTof1IndOFSL: type-reference=uint16_t
      ProcTof1DirFOL: type-reference=uint16_t
      ProcTof1IndIFOL: type-reference=uint16_t
      ProcTof1IndOFIL: type-reference=uint16_t
      ProcTof1DirFIL: type-reference=uint16_t
      ProcTof1IndIFIL: type-reference=uint16_t
      ProcTof1IndIFIR: type-reference=uint16_t
      ProcTof1DirFIR: type-reference=uint16_t
      ProcTof1IndOFIR: type-reference=uint16_t
      ProcTof1IndIFOR: type-reference=uint16_t
      ProcTof1DirFOR: type-reference=uint16_t
      ProcTof1IndOFSR: type-reference=uint16_t
      ProcTof1DirFSR: type-reference=uint16_t
      ErrorFlagRSL: type-reference=uint16_t
      ErrorFlagROL: type-reference=uint16_t
      ErrorFlagRIL: type-reference=uint16_t
      ErrorFlagRIR: type-reference=uint16_t
      ErrorFlagROR: type-reference=uint16_t
      ErrorFlagRSR: type-reference=uint16_t
      ErrorFlagFSL: type-reference=uint16_t
      ErrorFlagFOL: type-reference=uint16_t
      ErrorFlagFIL: type-reference=uint16_t
      ErrorFlagFIR: type-reference=uint16_t
      ErrorFlagFOR: type-reference=uint16_t
      ErrorFlagFSR: type-reference=uint16_t
      AliveCount: type-reference=uint8_t
      Version: type-reference=uint8_t
      LowspeedState: type-reference=uint8_t
      InitComplete: type-reference=uint8_t
