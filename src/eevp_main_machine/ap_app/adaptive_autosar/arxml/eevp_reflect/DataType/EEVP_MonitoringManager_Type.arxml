AUTOSAR XML (schema 00049)
package /DataType/CppImplementationType
  8 x std cpp implementation data type:
    ControllerServiceInfo: category=STRUCTURE
      namespaces:
        symbol props eevp
        symbol props monitoring
        symbol props type
      4 x cpp implementation data type element:
        serviceName: type-reference=String
        version: type-reference=String
        lastUpdateTime: type-reference=uint64_t
        actionType: type-reference=String
    ControllerServiceStatus: compu {0x00=NORMAL, 0x01=ABNORMAL, 0x02=STATUS_3, 0x03=STATUS_4}, type-reference=uint8_t
      namespaces:
        symbol props eevp
        symbol props monitoring
        symbol props type
    MainErrorReason: compu-method=ErrorReason, type-reference=uint8_t
      namespaces:
        symbol props eevp
        symbol props monitoring
        symbol props type
    MainState: compu-method=State, type-reference=uint8_t
      namespaces:
        symbol props eevp
        symbol props monitoring
        symbol props type
    MbTempStatus: category=STRUCTURE
      namespaces:
        symbol props eevp
        symbol props monitoring
        symbol props type
      cpp implementation data type element State: type-reference=MainState
      cpp implementation data type element ErrorReason: type-reference=MainErrorReason
    StringArray: category=ARRAY, array-size=16, cpp-template-argument=String
      namespaces:
        symbol props eevp
        symbol props monitoring
        symbol props type
    TimeArray: category=ARRAY, array-size=16, cpp-template-argument=uint64_t
      namespaces:
        symbol props eevp
        symbol props monitoring
        symbol props type
    UpdatableServiceList: category=STRUCTURE
      namespaces:
        symbol props eevp
        symbol props monitoring
        symbol props type
      cpp implementation data type element serviceName: type-reference=String
      cpp implementation data type element version: type-reference=String
      cpp implementation data type element actionType: type-reference=String
package /DataType/Semantics
  compu method ControllerServiceInfoError: 0x00=NO_ERROR, 0x01=INVALID
  compu method ControllerServiceStatusError: 0x00=NO_ERROR, 0x01=INVALID
