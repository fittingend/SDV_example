AUTOSAR XML (schema 00049)
package /DataType/CppImplementationType
  66 x std cpp implementation data type:
    EcmRoaSnsrStatus: category=STRUCTURE
      namespaces:
        symbol props zone2
        symbol props roa
        symbol props control
      4 x cpp implementation data type element, all with type-reference=uint8_t:
        detInfo
        snsrStat
        snsrErrState
        isNormal
    EcuDrvSeatMotorDirection: category=STRUCTURE
      namespaces:
        symbol props zone1
        symbol props drvseat
        symbol props control
      5 x cpp implementation data type element, all with type-reference=uint8_t:
        slide
        recline
        height
        rlxTilt
        isNormal
    EcuDrvSeatMotorInst: category=STRUCTURE
      namespaces:
        symbol props zone1
        symbol props drvseat
        symbol props control
      4 x cpp implementation data type element, all with type-reference=uint8_t:
        slide
        recline
        height
        rlxTilt
    EcuDrvseatMotorPosition: category=STRUCTURE
      namespaces:
        symbol props zone1
        symbol props drvseat
        symbol props control
      4 x cpp implementation data type element, all with type-reference=uint8_t:
        slidePos
        reclinePos
        heightPos
        rlxTiltPos
    EcuMlmState: category=STRUCTURE
      namespaces:
        symbol props zone1
        symbol props mlm
        symbol props control
      cpp implementation data type element colorIndex: type-reference=uint8_t
      cpp implementation data type element brightness: type-reference=uint8_t
      cpp implementation data type element isNormal: type-reference=int8_t
    EcuRcurtainStatus: category=STRUCTURE
      namespaces:
        symbol props zone3
        symbol props rcurtain
        symbol props control
      4 x cpp implementation data type element:
        curMotorDir: type-reference=uint8_t
        curMotorLimit: type-reference=uint8_t
        motorCurrent: type-reference={inplace=false, type-reference=uint16_t}
        isNormal: type-reference=uint8_t
    EcuWiperOperationStatus: category=STRUCTURE
      namespaces:
        symbol props zone4
        symbol props wiper
        symbol props control
      cpp implementation data type element curOperationMode: type-reference=uint8_t
      cpp implementation data type element isNormal: type-reference=uint8_t
    EcuZ1Mfsw: category=STRUCTURE
      namespaces:
        symbol props zone1
        symbol props mfsw
        symbol props input
      4 x cpp implementation data type element, all with type-reference=uint8_t:
        wiperState
        wiperMistState
        wiperIntState
        wiperWasherState
    EcuZ1PowerCurrent: category=STRUCTURE
      namespaces:
        symbol props zone1
        symbol props power
        symbol props control
      cpp implementation data type element mlmCurrent: type-reference=uint16_t
      cpp implementation data type element drvSeatCurrent: type-reference=uint16_t
      cpp implementation data type element mfswCurrent: type-reference=uint16_t
    EcuZ1PowerState: category=STRUCTURE
      namespaces:
        symbol props zone1
        symbol props power
        symbol props control
      cpp implementation data type element mlmPowerState: type-reference=uint8_t
      cpp implementation data type element drvSeatPowerState: type-reference=uint8_t
      cpp implementation data type element mfswPowerState: type-reference=uint8_t
    EcuZ2PowerCurrent: category=STRUCTURE
      namespaces:
        symbol props zone2
        symbol props power
        symbol props control
      cpp implementation data type element roaCurrent: type-reference=uint16_t
      cpp implementation data type element rainSnsrCurrent: type-reference=uint16_t
    EcuZ2PowerState: category=STRUCTURE
      namespaces:
        symbol props zone2
        symbol props power
        symbol props control
      cpp implementation data type element roaPowerState: type-reference=uint8_t
      cpp implementation data type element rainSnsrPowerState: type-reference=uint8_t
    EcuZ3PowerCurrent: category=STRUCTURE
      namespaces:
        symbol props zone3
        symbol props power
        symbol props control
      cpp implementation data type element rcurtCurrent: type-reference=uint16_t
      cpp implementation data type element rpdwCurrent: type-reference=uint16_t
    EcuZ3PowerState: category=STRUCTURE
      namespaces:
        symbol props zone3
        symbol props power
        symbol props control
      cpp implementation data type element rcurtPowerState: type-reference=uint8_t
      cpp implementation data type element rpdwPowerState: type-reference=uint8_t
    EcuZ4PowerCurrent: category=STRUCTURE
      namespaces:
        symbol props zone4
        symbol props power
        symbol props control
      cpp implementation data type element wiperCurrent: type-reference=uint8_t
      cpp implementation data type element fpdwCurrent: type-reference=uint8_t
    EcuZ4PowerState: category=STRUCTURE
      namespaces:
        symbol props zone4
        symbol props power
        symbol props control
      cpp implementation data type element wiperPowerState: type-reference=uint8_t
      cpp implementation data type element fpdwPowerState: type-reference=uint8_t
    EcuZ5DmsDriverStatus: category=STRUCTURE
      namespaces:
        symbol props zone5
        symbol props dms
        symbol props control
      4 x cpp implementation data type element, all with type-reference=uint8_t:
        gazingDir
        fatigue
        smoking
        onPhone
    EcuZ5DmsStatus: category=STRUCTURE
      namespaces:
        symbol props zone5
        symbol props dms
        symbol props control
      cpp implementation data type element powerOn: type-reference=uint8_t
      cpp implementation data type element subElement3: type-reference=uint8_t
    EcuZ5HvacStatus: category=STRUCTURE
      namespaces:
        symbol props zone5
        symbol props hvac
        symbol props control
      11 x cpp implementation data type element:
        powerOn: type-reference=uint8_t
        acOnOff: type-reference=uint8_t
        autoMode: type-reference=uint8_t
        syncMode: type-reference=uint8_t
        driverTemp: type-reference=int8_t
        passengerTemp: type-reference=int8_t
        blowingForce: type-reference=uint8_t
        blowingDir: type-reference=uint8_t
        airSrc: type-reference=uint8_t
        forwardDefrostOn: type-reference=uint8_t
        backwardDefrostOn: type-reference=uint8_t
    EcuZ5HvacTemps: category=STRUCTURE
      namespaces:
        symbol props zone5
        symbol props hvac
        symbol props control
      8 x cpp implementation data type element, all with type-reference=int8_t:
        inside
        outside
        duct
        evaporator
        driverVentDuct
        driverFloarDuct
        passengerVentDuct
        passengerFloorDuct
    SoaAccState: compu {0=kOFF, 1=kON, 2=kERROR}, type-reference=uint8_t
      namespaces:
        symbol props eevp
        symbol props control
    SoaDeviceIsNormal: compu {0=kNORMAL, 1=kABNORMAL}, type-reference=uint8_t
      namespaces:
        symbol props eevp
        symbol props control
    SoaDmsDriverInside: compu {0=kUNKNOWN, 1=kDRIVER, 2=kNONE}, type-reference=uint8_t
      namespaces:
        symbol props eevp
        symbol props control
    SoaDmsFatigue: compu {0=kUNKNOWN, 1=kOK, 2=kDROWSY, 3=kSLEEP}, type-reference=uint8_t
      namespaces:
        symbol props eevp
        symbol props control
    SoaDmsGazingDir: compu {0=kUNKNOWN, 1=kFRONT, 2=kFRONT_LEFT, 3=kFRONT_RIGHT, 4=kREAR_MIRROR, 5=kLEFT_MIRROR, 6=kRIGHT_MIRROR, 7=kDASH_BOARD, 8=kMEDIA, 9=kOTHER}, type-reference=uint8_t
      namespaces:
        symbol props eevp
        symbol props control
    SoaDmsOnPhone: compu {0=kUNKNOWN, 1=kON_PHONE, 2=kNOT_ON_PHONE}, type-reference=uint8_t
      namespaces:
        symbol props eevp
        symbol props control
    SoaDmsSmoking: compu {0=kUNKNOWN, 1=kSMOKE, 2=kNOSMOKE}, type-reference=uint8_t
      namespaces:
        symbol props eevp
        symbol props control
    SoaDmsStatus: category=STRUCTURE
      namespaces:
        symbol props eevp
        symbol props control
      cpp implementation data type element powerOn: type-reference=bool
      cpp implementation data type element driverInside: type-reference=SoaDmsDriverInside
    SoaErrorState: compu {0=kOK, 1=kERROR}, type-reference=uint8_t
      namespaces:
        symbol props eevp
        symbol props control
    SoaFilmOpacityArray: category=ARRAY, array-size=16, cpp-template-argument=uint8_t
      namespaces:
        symbol props eevp
        symbol props control
    SoaFilmPos: compu {1=kWINDSHIELD, 2=kROOF_GLASS, 3=kDS_FRONTREAR, 4=kDS_QUARTER, 5=kAS_FRONTREAR, 6=kAS_QUARTER, 7=kREAR_GLASS}, type-reference=uint8_t
      namespaces:
        symbol props eevp
        symbol props control
    SoaGearState: compu {0=kGEAR_UNKNOWN, 1=kGEAR_P, 2=kGEAR_D, 3=kGEAR_N, 4=kGEAR_R, 5=kGEAR_L, 6=kGEAR_2, 7=kGEAR_3, 8=kGEAR_DS, 9=kGEAR_MS, 10=kGEAR_PS, 11=kGEAR_SUBCOM_COMM, 12=kGEAR_FAULT}, type-reference=uint8_t
      namespaces:
        symbol props eevp
        symbol props control
    SoaHvacAirSource: compu {1=kOUTER, 2=kINNER}, type-reference=uint8_t
      namespaces:
        symbol props eevp
        symbol props control
    SoaHvacBlowDir: compu {0=kCHEST, 1=kBOTH, 2=kFOOT, 3=kFOOT_WITH_WS}, type-reference=uint8_t
      namespaces:
        symbol props eevp
        symbol props control
    SoaHvacStatus: category=STRUCTURE
      namespaces:
        symbol props eevp
        symbol props control
      11 x cpp implementation data type element:
        powerOn: type-reference=bool
        acOnOff: type-reference=bool
        autoMode: type-reference=bool
        syncMode: type-reference=bool
        driverTemp: type-reference=int8_t
        passengerTemp: type-reference=int8_t
        blowingForce: type-reference=uint8_t
        blowingDir: type-reference=SoaHvacBlowDir
        airSrc: type-reference=SoaHvacAirSource
        forwardFrostOn: type-reference=bool
        backwardFrostOn: type-reference=bool
    SoaHvacTemps: category=STRUCTURE
      namespaces:
        symbol props eevp
        symbol props control
      8 x cpp implementation data type element, all with type-reference=int8_t:
        inside
        outside
        duct
        evaporator
        driverVentDuct
        driverFloorDuct
        passengerVentDuct
        passengerFloorDuct
    SoaIgnState: compu {0=kOFF, 1=kON, 2=kERROR}, type-reference=uint8_t
      namespaces:
        symbol props eevp
        symbol props control
    SoaMlmMoodMode: compu {0=kCARE_MOOD, 1=kCOMPORT_MOOD, 2=kDELIGHT_MOOD, 3=kMOOD_THERAPHY, 4=kVITALITY_MOOD}, type-reference=uint8_t
      namespaces:
        symbol props eevp
        symbol props control
    SoaMlmStatus: category=STRUCTURE
      namespaces:
        symbol props eevp
        symbol props control
      cpp implementation data type element colorTableIndex: type-reference=uint8_t
      cpp implementation data type element brightness: type-reference=uint16_t
      cpp implementation data type element isNormal: type-reference=SoaDeviceIsNormal
    SoaPowerState: compu {0=kON, 1=kOFF, 2=kERROR}, type-reference=uint8_t
      namespaces:
        symbol props eevp
        symbol props control
    SoaPwrZone1Curr: category=STRUCTURE
      namespaces:
        symbol props eevp
        symbol props control
      cpp implementation data type element mlmCurrentValue: type-reference=uint16_t
      cpp implementation data type element drvseatCurrentValue: type-reference=uint16_t
      cpp implementation data type element mfswCurrentValue: type-reference=uint16_t
    SoaPwrZone1Power: category=STRUCTURE
      namespaces:
        symbol props eevp
        symbol props control
      cpp implementation data type element mlmPowerState: type-reference=SoaPowerState
      cpp implementation data type element drvseatPowerState: type-reference=SoaPowerState
      cpp implementation data type element mfswPowerState: type-reference=SoaPowerState
    SoaPwrZone2Curr: category=STRUCTURE
      namespaces:
        symbol props eevp
        symbol props control
      cpp implementation data type element roaCurrentValue: type-reference=uint16_t
      cpp implementation data type element rainSnsrCurrentValue: type-reference=uint16_t
    SoaPwrZone2Power: category=STRUCTURE
      namespaces:
        symbol props eevp
        symbol props control
      cpp implementation data type element roaPowerState: type-reference=SoaPowerState
      cpp implementation data type element rainSnsrPowerState: type-reference=SoaPowerState
    SoaPwrZone3Curr: category=STRUCTURE
      namespaces:
        symbol props eevp
        symbol props control
      cpp implementation data type element rcurtCurrentValue: type-reference=uint16_t
      cpp implementation data type element rpdwCurrentValue: type-reference=uint16_t
    SoaPwrZone3Power: category=STRUCTURE
      namespaces:
        symbol props eevp
        symbol props control
      cpp implementation data type element rcurtPowerState: type-reference=SoaPowerState
      cpp implementation data type element rpdwPowerState: type-reference=SoaPowerState
    SoaPwrZone4Curr: category=STRUCTURE
      namespaces:
        symbol props eevp
        symbol props control
      cpp implementation data type element wiperCurrentValue: type-reference=uint16_t
      cpp implementation data type element fpdwCurrentValue: type-reference=uint16_t
    SoaPwrZone4Power: category=STRUCTURE
      namespaces:
        symbol props eevp
        symbol props control
      cpp implementation data type element wiperPowerState: type-reference=SoaPowerState
      cpp implementation data type element fpdwPowerState: type-reference=SoaPowerState
    SoaRctnMotorDir: compu {0=kSTOP, 1=kUP, 2=kDOWN}, type-reference=uint8_t
      namespaces:
        symbol props eevp
        symbol props control
    SoaRctnState: compu {0=kFULLY_UP, 1=kFULLY_DOWN, 2=kPARTLY_OPENED, 3=kMOVING_UP, 4=kMOVING_DOWN}, type-reference=uint8_t
      namespaces:
        symbol props eevp
        symbol props control
    SoaRctnStatus: category=STRUCTURE
      namespaces:
        symbol props eevp
        symbol props control
      4 x cpp implementation data type element:
        errorState: type-reference=SoaErrorState
        curMotorDirection: type-reference=SoaRctnMotorDir
        curtainState: type-reference=SoaRctnState
        isNormal: type-reference=SoaDeviceIsNormal
    SoaRoaDetectState: compu {0=kEMPTY, 1=kDETECTED_ONCE, 2=kDETECTED_SEVERAL, 3=kUNKNOWN}, type-reference=uint8_t
      namespaces:
        symbol props eevp
        symbol props control
    SoaRoaMode: compu {0=kOFF, 1=kNORMAL, 2=kADVANCED}, type-reference=uint8_t
      namespaces:
        symbol props eevp
        symbol props control
    SoaRoaRunningState: compu {0=kOFF, 1=kON, 2=kUNKNOWN}, type-reference=uint8_t
      namespaces:
        symbol props eevp
        symbol props control
    SoaRoaSensorError: compu {0=kOK, 1=kERR_SNSR, 2=kERR_BLCKGE}, type-reference=uint8_t
      namespaces:
        symbol props eevp
        symbol props control
    SoaSeatHeightDirection: compu {0=kSTOP, 1=kUP, 2=kDOWN}, type-reference=uint8_t
      namespaces:
        symbol props eevp
        symbol props control
    SoaSeatMotorDirection: category=STRUCTURE
      namespaces:
        symbol props eevp
        symbol props control
      4 x cpp implementation data type element:
        slide: type-reference=SoaSeatSlideDirection
        recline: type-reference=SoaSeatReclineDirection
        height: type-reference=SoaSeatHeightDirection
        tilt: type-reference=SoaSeatTiltDirection
    SoaSeatMotorPosition: category=STRUCTURE
      namespaces:
        symbol props eevp
        symbol props control
      4 x cpp implementation data type element, all with type-reference=uint8_t:
        slidePosition
        reclinePosition
        heightPosition
        tiltPosition
    SoaSeatReclineDirection: compu {0=kSTOP, 1=kFORWARD, 2=kBACKWARD}, type-reference=uint8_t
      namespaces:
        symbol props eevp
        symbol props control
    SoaSeatSlideDirection: compu {0=kSTOP, 1=kFORWARD, 2=kBACKWARD}, type-reference=uint8_t
      namespaces:
        symbol props eevp
        symbol props control
    SoaSeatTiltDirection: compu {0=kSTOP, 1=kUP, 2=kDOWN}, type-reference=uint8_t
      namespaces:
        symbol props eevp
        symbol props control
    SoaWiperMode: compu {0=kOFF, 1=kINT1, 2=kINT2, 3=kINT3, 4=kON}, type-reference=uint8_t
      namespaces:
        symbol props eevp
        symbol props control
    SoaWiperStatus: category=STRUCTURE
      namespaces:
        symbol props eevp
        symbol props control
      cpp implementation data type element isAutoMode: type-reference=bool
      cpp implementation data type element mode: type-reference=SoaWiperMode
    VehicleInfo: category=STRUCTURE
      namespaces:
        symbol props eevp
        symbol props control
      5 x cpp implementation data type element:
        speed: type-reference=uint16_t
        gearState: type-reference=SoaGearState
        accIn: type-reference=SoaAccState
        ign1In: type-reference=SoaIgnState
        ign2In: type-reference=SoaIgnState
    ZoneByteVectorType: category=VECTOR, cpp-template-argument=uint8_t
      namespaces:
        symbol props zone
        symbol props input
        symbol props type
    soaDmsDriverStatus: category=STRUCTURE
      namespaces:
        symbol props eevp
        symbol props control
      4 x cpp implementation data type element:
        gazingDir: type-reference=SoaDmsGazingDir
        fatigue: type-reference=SoaDmsFatigue
        smoking: type-reference=SoaDmsSmoking
        onPhone: type-reference=SoaDmsOnPhone
