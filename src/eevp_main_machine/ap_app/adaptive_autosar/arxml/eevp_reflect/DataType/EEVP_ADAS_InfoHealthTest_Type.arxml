AUTOSAR XML (schema 00049)
package /DataType/CppImplementationType
  std cpp implementation data type HealthStatus: compu {0x00=NORMAL, 0x01=ABNORMAL}, type-reference=uint8_t
    namespaces:
      4 x symbol props:
        adas
        info
        health
        type
