AUTOSAR XML (schema 00049)
package /ServiceDeployment/Someip
  someip service interface deployment Main_IPC_RoutingIPC: service-interface=Main_IPC_RoutingIPC, service-interface-id=4880, service-interface-version={major-version=1, minor-version=0}
    someip event deployment PeriodicSystemInfo: event=PeriodicSystemInfo, event-id=1000, transport-protocol=UDP
    someip event deployment SystemControlRequest: event=SystemControlRequest, event-id=1001, transport-protocol=UDP
    4 x someip method deployment, all with transport-protocol=UDP:
      ASMInfoRequest: method=ASMInfoRequest, method-id=1002
      GetOneTimeSystemInfo: method=GetOneTimeSystemInfo, method-id=1003
      SetAPSystemInfo: method=SetAPSystemInfo, method-id=1004
      SystemControlResponse: method=SystemControlResponse, method-id=1005
    someip event group Eventgroup_PeriodicSystemInfo: event-group-id=1100, event=PeriodicSystemInfo
    someip event group Eventgroup_SystemControlRequest: event-group-id=1101, event=SystemControlRequest
package /ServiceInstance/Endpoint
  someip service instance to machine mapping EEVP_IPCHandler_SomeipConsumers_Main_IPC_RoutingIPC: communication-connector=eth0, service-instance=EEVP_IPCHandler_Consumer_Main_IPC_RoutingIPC, udp-port=5001
  someip service instance to machine mapping EEVP_IPCHandler_SomeipProviders_Main_IPC_RoutingIPC: communication-connector=eth0, service-instance=EEVP_IPCHandler_Provider_Main_IPC_RoutingIPC, udp-port=5000
package /ServiceInstance/Someip/Consumer
  required someip service instance EEVP_IPCHandler_Consumer_Main_IPC_RoutingIPC: service-interface-deployment=Main_IPC_RoutingIPC, method-request-propss=[ASMInfoRequest, GetOneTimeSystemInfo, SetAPSystemInfo, SystemControlResponse], required-minor-version=ANY, required-service-instance-id=ANY, sd-client-config=DefaultSdClientConfig, version-driven-find-behavior=EXACT-OR-ANY-MINOR-VERSION
    someip required event group Eventgroup_PeriodicSystemInfo: event-group=Eventgroup_PeriodicSystemInfo, sd-client-event-group-timing-config=DefaultSdSubscribeConfig
    someip required event group Eventgroup_SystemControlRequest: event-group=Eventgroup_SystemControlRequest, sd-client-event-group-timing-config=DefaultSdSubscribeConfig
package /ServiceInstance/Someip/Provider
  provided someip service instance EEVP_IPCHandler_Provider_Main_IPC_RoutingIPC: service-interface-deployment=Main_IPC_RoutingIPC, event-propss=[PeriodicSystemInfo, SystemControlRequest], method-response-propss=[ASMInfoRequest, GetOneTimeSystemInfo, SetAPSystemInfo, SystemControlResponse], sd-server-config=DefaultSdServerConfig, service-instance-id=100
    someip provided event group Eventgroup_PeriodicSystemInfo: event-group=Eventgroup_PeriodicSystemInfo, multicast-threshold=0, sd-server-event-group-timing-config=DefaultSdPublishConfig
    someip provided event group Eventgroup_SystemControlRequest: event-group=Eventgroup_SystemControlRequest, multicast-threshold=0, sd-server-event-group-timing-config=DefaultSdPublishConfig
package /ServiceInterface
  service interface Main_IPC_RoutingIPC
    namespaces:
      symbol props eevp
      symbol props ipchandler
      symbol props service
    events:
      data PeriodicSystemInfo: type=PowerState
      data SystemControlRequest: type=SysCtrlReq
    methods:
      4 x operation, all with fire-and-forget=false:
        ASMInfoRequest
        GetOneTimeSystemInfo
          arg info: type=OneTimeSysInfo, direction=OUT
        SetAPSystemInfo
          arg apVersion: type=String, direction=IN
        SystemControlResponse
          arg response: type=SysCtrlResp, direction=IN
