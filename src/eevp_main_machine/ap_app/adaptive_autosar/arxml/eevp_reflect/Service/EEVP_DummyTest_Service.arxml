AUTOSAR XML (schema 00049)
package /ServiceDeployment/Someip
  someip service interface deployment DummyTest: service-interface=DummyTest, service-interface-id=5152, service-interface-version={major-version=1, minor-version=0}
    someip event deployment DeviceEvent: event=DeviceEvent, event-id=1, transport-protocol=UDP
    someip field deployment DeviceField: field=DeviceField
      get Get_DeviceField: method-id=11, transport-protocol=UDP
      notifier Notification_DeviceField: event-id=13, transport-protocol=UDP
      set Set_DeviceField: method-id=12, transport-protocol=UDP
    someip method deployment DeviceMethod: method=DeviceMethod, method-id=1, transport-protocol=UDP
    someip event group Eventgroup_DeviceEvent: event-group-id=3, event=DeviceEvent
    someip event group Eventgroup_Notification_DeviceField: event-group-id=4, event=Notification_DeviceField
package /ServiceInstance/Endpoint
  someip service instance to machine mapping Test_Dummy_SomeipConsumers: communication-connector=eth0, service-instance=DummyTest_Consumer, tcp-port=25000, udp-port=25000
  someip service instance to machine mapping Test_Dummy_SomeipProviders: communication-connector=eth0, service-instance=DummyTest_Provider, tcp-port=25050, udp-port=25050
package /ServiceInstance/SdTimingConfig/Client
  someip sd client service instance config SdClientConfig: initial-find-behavior={initial-delay-max-value=0.2, initial-delay-min-value=0.1, initial-repetitions-base-delay=0.1, initial-repetitions-max=4}, service-find-time-to-live=16777215
package /ServiceInstance/SdTimingConfig/Server
  someip sd server service instance config SdSeverConfig: initial-offer-behavior={initial-delay-max-value=0.2, initial-delay-min-value=0.1, initial-repetitions-base-delay=0.1, initial-repetitions-max=3}, offer-cyclic-delay=0.5, request-response-delay={max-value=0.0, min-value=0.0}, service-offer-time-to-live=16777215
package /ServiceInstance/SdTimingConfig/Subscription
  someip sd client event group timing config SdDeviceConfig: request-response-delay={max-value=0.0, min-value=0.0}, time-to-live=16777215
package /ServiceInstance/Someip/Consumer
  required someip service instance DummyTest_Consumer: service-interface-deployment=DummyTest, method-request-propss=[Get_DeviceField, Set_DeviceField, DeviceMethod], required-minor-version=ANY, required-service-instance-id=ANY, sd-client-config=SdClientConfig, version-driven-find-behavior=EXACT-OR-ANY-MINOR-VERSION
    someip required event group Eventgroup_DeviceEvent: event-group=Eventgroup_DeviceEvent, sd-client-event-group-timing-config=SdDeviceConfig
    someip required event group Eventgroup_Notification_DeviceField: event-group=Eventgroup_Notification_DeviceField, sd-client-event-group-timing-config=SdDeviceConfig
package /ServiceInstance/Someip/Provider
  provided someip service instance DummyTest_Provider: service-interface-deployment=DummyTest, event-propss=[DeviceEvent, Notification_DeviceField], method-response-propss=[Get_DeviceField, Set_DeviceField, DeviceMethod], sd-server-config=SdSeverConfig, service-instance-id=1
    someip provided event group Eventgroup_DeviceEvent: event-group=Eventgroup_DeviceEvent, multicast-threshold=0
    someip provided event group Eventgroup_Notification_DeviceField: event-group=Eventgroup_Notification_DeviceField, multicast-threshold=0
package /ServiceInterface
  service interface DummyTest: major-version=1, minor-version=0
    namespaces:
      symbol props test
      symbol props dummy
    events:
      data DeviceEvent: type=DeviceInfo
    field DeviceField: type=DeviceInfo, has-getter=true, has-notifier=true, has-setter=true
    methods:
      operation DeviceMethod: fire-and-forget=false
        arg DeviceNumber: type=int16_t, direction=IN
        arg DeviceState: type=bool, direction=OUT
