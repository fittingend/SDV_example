AUTOSAR XML (schema 00049)
package /ServiceDeployment/Someip
  someip service interface deployment Main_PDW_Service: service-interface=Main_PDW_Service, service-interface-id=4950, service-interface-version={major-version=1, minor-version=0}
    someip event deployment DistanceLevel: event=DistanceLevel, event-id=1, serializer=SOMEIP, transport-protocol=UDP
    someip field deployment UssStatus: field=UssStatus
      get Getter: method-id=257, transport-protocol=UDP
      notifier Notifier: event-id=257, serializer=SOMEIP, transport-protocol=UDP
    someip event group Eventgroup_DistanceLevel: event-group-id=1, event=DistanceLevel
    someip event group Eventgroup_UssStatus: event-group-id=2, event=Notifier
package /ServiceInstance/Endpoint
  6 x someip service instance to machine mapping, all with communication-connector=eth0:
    EEVP_MonitoringManager_SomeipConsumers_Hvac: service-instance=EEVP_MonitoringManager_Consumer_Hvac, tcp-port=55047, udp-port=55047
    EEVP_PDW_SomeipConsumers_UssFrontInput: service-instance=EEVP_PDW_Consumer_UssFrontInput, tcp-port=6102, udp-port=6102
    EEVP_PDW_SomeipConsumers_UssRearInput: service-instance=EEVP_PDW_Consumer_UssRearInput, tcp-port=6103, udp-port=6103
    EEVP_PDW_SomeipConsumers_VehicleInfo: service-instance=EEVP_PDW_Consumer_VehicleInfo, tcp-port=6101, udp-port=6101
    EEVP_PDW_SomeipProvider_PdwFrontService: service-instance=EEVP_PDW_Provider_PdwFrontService, tcp-port=6001, udp-port=6001
    EEVP_PDW_SomeipProvider_PdwRearService: service-instance=EEVP_PDW_Provider_PdwRearService, tcp-port=6002, udp-port=6002
package /ServiceInstance/Someip/Consumer
  required someip service instance EEVP_PDW_Consumer_UssFrontInput: service-interface-deployment=Zone_UssFront_Input, required-service-instance-id=ANY, sd-client-config=DefaultSdClientConfig
    someip required event group Eventgroup_UssData: event-group=Eventgroup_UssData, sd-client-event-group-timing-config=DefaultSdSubscribeConfig
  required someip service instance EEVP_PDW_Consumer_UssRearInput: service-interface-deployment=Zone_UssUssRear_Input, required-service-instance-id=ANY, sd-client-config=DefaultSdClientConfig
    someip required event group Eventgroup_UssData: event-group=Eventgroup_UssData, sd-client-event-group-timing-config=DefaultSdSubscribeConfig
  required someip service instance EEVP_PDW_Consumer_VehicleInfo_Input: service-interface-deployment=Zone_VehicleInfo_Input, required-service-instance-id=ANY, sd-client-config=DefaultSdClientConfig
    someip required event group Eventgroup_VehicleInfo: event-group=Eventgroup_VehicleInfo, sd-client-event-group-timing-config=DefaultSdSubscribeConfig
package /ServiceInstance/Someip/Provider
  provided someip service instance EEVP_PDW_Provider_PdwFrontService: service-interface-deployment=Main_PDW_Service, someip-event-props=event=DistanceLevel, sd-server-config=DefaultSdServerConfig, service-instance-id=1
    someip provided event group Eventgroup_DistanceLevel: event-group=Eventgroup_DistanceLevel, multicast-threshold=0, sd-server-event-group-timing-config=DefaultSdPublishConfig
    someip provided event group Eventgroup_UssStatus: event-group=Eventgroup_UssStatus, multicast-threshold=0
  provided someip service instance EEVP_PDW_Provider_PdwRearService: service-interface-deployment=Main_PDW_Service, someip-event-props=DistanceLevel, sd-server-config=DefaultSdServerConfig, service-instance-id=2
    someip provided event group Eventgroup_DistanceLevel: event-group=Eventgroup_DistanceLevel, multicast-threshold=0, sd-server-event-group-timing-config=DefaultSdPublishConfig
    someip provided event group Eventgroup_UssStatus: event-group=Eventgroup_UssStatus, multicast-threshold=0
package /ServiceInterface
  service interface Main_PDW_Service: major-version=1, minor-version=0
    namespaces:
      symbol props eevp
      symbol props pdw
      symbol props service
    events:
      data DistanceLevel: type=DistanceLevel
    field UssStatus: type=UssStatus, has-getter=true, has-notifier=true, has-setter=false
