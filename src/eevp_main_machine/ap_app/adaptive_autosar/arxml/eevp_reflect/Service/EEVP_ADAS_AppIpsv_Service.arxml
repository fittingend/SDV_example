AUTOSAR XML (schema 00049)
package /ServiceDeployment/Someip
  someip service interface deployment AdasAppIpsv: service-interface=AdasAppIpsv, service-interface-id=6673, service-interface-version={major-version=1, minor-version=0}
    someip field deployment viewMode: field=viewMode
      get Getter_viewMode: method-id=256, transport-protocol=TCP
      notifier Notifier_viewMode: event-id=256, transport-protocol=TCP
    someip method deployment requestViewMode: method=requestViewMode, method-id=257, transport-protocol=TCP
    someip event group Eventgroup_viewMode: event-group-id=33024, event=Notifier_viewMode
package /ServiceInstance/Endpoint
  someip service instance to machine mapping EEVP_AppIpsvTest_SomeipConsumer_AdasAppIpsv: communication-connector=eth0, service-instance=EEVP_AppIpsv_Consumer_AdasAppIpsv, tcp-port=30600, udp-port=30600
package /ServiceInstance/Someip/Consumer
  required someip service instance EEVP_AppIpsv_Consumer_AdasAppIpsv: service-interface-deployment=AdasAppIpsv, method-request-propss=[Getter_viewMode, requestViewMode], required-minor-version=ANY, required-service-instance-id=ANY, sd-client-config=DefaultSdClientConfig, version-driven-find-behavior=EXACT-OR-ANY-MINOR-VERSION
    someip required event group Eventgroup_viewMode: event-group=Eventgroup_viewMode, sd-client-event-group-timing-config=DefaultSdSubscribeConfig
package /ServiceInstance/Someip/Provider
  provided someip service instance EEVP_AppIpsv_Provider_AdasAppIpsv: service-interface-deployment=AdasAppIpsv, someip-event-props=Notifier_viewMode, method-response-propss=[Getter_viewMode, requestViewMode], sd-server-config=DefaultSdServerConfig, service-instance-id=6673
    someip provided event group Eventgroup_viewMode: event-group=Eventgroup_viewMode, multicast-threshold=0
package /ServiceInterface
  service interface AdasAppIpsv
    namespaces:
      symbol props adas
      symbol props app
      symbol props ipsv
    field viewMode: type=ViewMode, has-getter=true, has-notifier=true, has-setter=false
    methods:
      operation requestViewMode: fire-and-forget=false
        arg viewMode: type=ViewMode, direction=IN
