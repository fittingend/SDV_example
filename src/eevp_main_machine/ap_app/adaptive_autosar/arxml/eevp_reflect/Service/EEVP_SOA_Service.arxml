AUTOSAR XML (schema 00049)
package /ServiceDeployment/Someip
  28 x someip service interface deployment, all with service-interface-version={major-version=1, minor-version=0}:
    SoaDms: service-interface=SoaDms, service-interface-id=4954
      someip event deployment onDriverNotFocusing: event=onDriverNotFocusing, event-id=3, transport-protocol=UDP
      someip event deployment onDriverNotWaken: event=onDriverNotWaken, event-id=2, transport-protocol=UDP
      someip event deployment onDriverNotWatchingFront: event=onDriverNotWatchingFront, event-id=1, transport-protocol=UDP
      4 x someip field deployment:
        soaDmsDeviceNormal: field=soaDmsDeviceNormal
          get Get_soaDmsDeviceNormal: method-id=1, transport-protocol=UDP
          notifier Notify_soaDmsDeviceNormal: event-id=16385, transport-protocol=UDP
        soaDmsDriverStatus: field=soaDmsDriverStatus
          get Get_soaDmsDriverStatus: method-id=3, transport-protocol=UDP
          notifier Notify_soaDmsDriverStatus: event-id=16387, transport-protocol=UDP
        soaDmsStatus: field=soaDmsStatus
          get Get_soaDmsStatus: method-id=2, transport-protocol=UDP
          notifier Notify_soaDmsStatus: event-id=16386, transport-protocol=UDP
        soaDmsSwVersion: field=soaDmsSwVersion
          get Get_soaDmsSwVersion: method-id=4, transport-protocol=UDP
          notifier Notify_soaDmsSwVersion: event-id=16388, transport-protocol=UDP
      someip method deployment SetDmsPower: method=SoaDms/SetDmsPower, method-id=16385, transport-protocol=UDP
      7 x someip event group:
        Eventgroup_Notify_soaDmsDeviceNormal: event-group-id=8705, event=Notify_soaDmsDeviceNormal
        Eventgroup_Notify_soaDmsDriverStatus: event-group-id=8707, event=Notify_soaDmsDriverStatus
        Eventgroup_Notify_soaDmsStatus: event-group-id=8706, event=Notify_soaDmsStatus
        Eventgroup_Notify_soaDmsSwVersion: event-group-id=8708, event=Notify_soaDmsSwVersion
        Eventgroup_onDriverNotFocusing: event-group-id=8963, event=onDriverNotFocusing
        Eventgroup_onDriverNotWaken: event-group-id=8962, event=onDriverNotWaken
        Eventgroup_onDriverNotWatchingFront: event-group-id=8961, event=onDriverNotWatchingFront
    SoaDriverSeat: service-interface=SoaDriverSeat, service-interface-id=4946
      4 x someip field deployment:
        soaDrvSeatDeviceNormal: field=soaDrvSeatDeviceNormal
          get Get_soaDrvSeatDeviceNormal: method-id=1, transport-protocol=UDP
          notifier Notification_soaDrvSeatDeviceNormal: event-id=16385, transport-protocol=UDP
        soaDrvSeatMotorDirection: field=soaDrvSeatMotorDirection
          get Get_soaDrvSeatMotorDirection: method-id=2, transport-protocol=UDP
          notifier Notify_soaDrvSeatMotorDirection: event-id=16386, transport-protocol=UDP
        soaDrvSeatMotorPosition: field=soaDrvSeatMotorPosition
          get Get_soaDrvSeatMotorPosition: method-id=3, transport-protocol=UDP
          notifier Notify_soaDrvSeatMotorPosition: event-id=16387, transport-protocol=UDP
        soaDrvSeatSwVersion: field=soaDrvSeatSwVersion
          get Get_soaDrvSeatSwVersion: method-id=4, transport-protocol=UDP
          notifier Notify_soaDrvSeatSwVersion: event-id=16388, transport-protocol=UDP
      4 x someip method deployment, all with transport-protocol=UDP:
        RequestMoveDrvSeatHeight: method=RequestMoveDrvSeatHeight, method-id=16387
        RequestMoveDrvSeatRecline: method=RequestMoveDrvSeatRecline, method-id=16386
        RequestMoveDrvSeatSlide: method=RequestMoveDrvSeatSlide, method-id=16385
        RequestMoveDrvSeatTilt: method=RequestMoveDrvSeatTilt, method-id=16388
      4 x someip event group:
        Eventgroup_Notification_soaDrvSeatDeviceNormal: event-group-id=8705, event=Notification_soaDrvSeatDeviceNormal
        Eventgroup_Notification_soaDrvSeatMotorDirection: event-group-id=8706, event=Notify_soaDrvSeatMotorDirection
        Eventgroup_Notification_soaDrvSeatMotorPosition: event-group-id=8707, event=Notify_soaDrvSeatMotorPosition
        Eventgroup_Notification_soaDrvSeatSwVersion: event-group-id=8708, event=Notify_soaDrvSeatSwVersion
    SoaHvac: service-interface=SoaHvac, service-interface-id=4952
      5 x someip field deployment:
        soaHvacDeviceNormal: field=soaHvacDeviceNormal
          get Get_soaHvacDeviceNormal: method-id=1, transport-protocol=UDP
          notifier Notify_soaHvacDeviceNormal: event-id=16385, transport-protocol=UDP
        soaHvacSetting: field=soaHvacSetting
          get Get_soaHvacSetting: method-id=2, transport-protocol=UDP
          notifier Notify_soaHvacSetting: event-id=16386, transport-protocol=UDP
        soaHvacStatus: field=soaHvacStatus
          get Get_soaHvacStatus: method-id=3, transport-protocol=UDP
          notifier Notify_soaHvacStatus: event-id=16387, transport-protocol=UDP
        soaHvacSwVersion: field=SoaHvacSwVersion
          get Get_soaHvacSwVersion: method-id=5, transport-protocol=UDP
          notifier Notify_soaHvacSwVersion: event-id=16389, transport-protocol=UDP
        soaHvacTemps: field=soaHvacTemps
          get Get_soaHvacTemps: method-id=4, transport-protocol=UDP
          notifier Notify_soaHvacTemps: event-id=16388, transport-protocol=UDP
      11 x someip method deployment, all with transport-protocol=UDP:
        SetAcOnOff: method=SoaHvac/SetAcOnOff, method-id=16386
        SetAirSource: method=SoaHvac/SetAirSource, method-id=16393
        SetAutoTemp: method=SoaHvac/SetAutoTemp, method-id=16387
        SetBackwardDefrostOn: method=SoaHvac/SetBackwardDefrostOn, method-id=16395
        SetBlowingDirection: method=SoaHvac/SetBlowingDirection, method-id=16391
        SetBlowingForce: method=SoaHvac/SetBlowingForce, method-id=16390
        SetDriverTemp: method=SoaHvac/SetDriverTemp, method-id=16388
        SetForwardDefrostOn: method=SoaHvac/SetForwardDefrostOn, method-id=16394
        SetHvacPower: method=SoaHvac/SetHvacPower, method-id=16385
        SetPassengerTemp: method=SoaHvac/SetPassengerTemp, method-id=16389
        SetSync: method=SoaHvac/SetSync, method-id=16392
      5 x someip event group:
        Eventgroup_Notify_soaHvacDeviceNormal: event-group-id=8705, event=Notify_soaHvacDeviceNormal
        Eventgroup_Notify_soaHvacSetting: event-group-id=8706, event=Notify_soaHvacSetting
        Eventgroup_Notify_soaHvacStatus: event-group-id=8707, event=Notify_soaHvacStatus
        Eventgroup_Notify_soaHvacSwVersion: event-group-id=8709, event=Notify_soaHvacSwVersion
        Eventgroup_Notify_soaHvacTemps: event-group-id=8708, event=Notify_soaHvacTemps
    SoaMlm: service-interface=SoaMlm, service-interface-id=4945
      someip field deployment soaMlmStatus: field=soaMlmStatus
        get Get_soaMlmStatus: method-id=1, transport-protocol=UDP
        notifier Notification_soaMlmStatus: event-id=16385, transport-protocol=UDP
      someip field deployment soaMlmSwVersion: field=soaMlmSwVersion
        get Get_soaMlmSwVersion: method-id=2, transport-protocol=UDP
        notifier Notify_soaMlmSwVersion: event-id=16386, transport-protocol=UDP
      someip method deployment RequestMlmSetBrightness: method=RequestMlmSetBrightness, method-id=16387, transport-protocol=UDP
      someip method deployment RequestMlmSetMode: method=RequestMlmSetMode, method-id=16386, transport-protocol=UDP
      someip method deployment RequestMlmSetRgbColor: method=RequestMlmSetRgbColor, method-id=16385, transport-protocol=UDP
      someip event group Eventgroup_Notification_soaMlmStatus: event-group-id=8705, event=Notification_soaMlmStatus
      someip event group Eventgroup_Notification_soaMlmSwVersion: event-group-id=8706, event=Notify_soaMlmSwVersion
    SoaPower: service-interface=SoaPower, service-interface-id=4944
      someip field deployment soaPowerDeviceNormal: field=soaPowerDeviceNormal
        get Get_soaPowerDeviceNormal: method-id=1, transport-protocol=UDP
        notifier Notify_soaPowerDeviceNormal: event-id=16385, transport-protocol=UDP
      someip field deployment soaPowerSwVersion: field=soaPowerSwVersion
        get Get_soaPowerSwVersion: method-id=2, transport-protocol=UDP
        notifier Notify_soaPowerSwVersion: event-id=16386, transport-protocol=UDP
      someip event group Eventgroup_Notification_soaPowerDeviceNormal: event-group-id=8193, event=Notify_soaPowerDeviceNormal
      someip event group Eventgroup_Notify_soaPowerSwVersion: event-group-id=8194, event=Notify_soaPowerSwVersion
    SoaRcurtain: service-interface=SoaRcurtain, service-interface-id=4948
      someip field deployment soaRctnStatus: field=soaRctnStatus
        get Get_soaRctnStatus: method-id=1, transport-protocol=UDP
        notifier Notification_soaRctnStatus: event-id=16385, transport-protocol=UDP
      someip field deployment soaRctnSwVersion: field=soaRctnSwVersion
        get Get_soaRctnSwVersion: method-id=2, transport-protocol=UDP
        notifier Notify_soaRctnSwVersion: event-id=16386, transport-protocol=UDP
      someip method deployment RequestRearCurtainOperation: method=RequestRearCurtainOperation, method-id=16385, transport-protocol=UDP
      someip method deployment RequestRearCurtainPosition: method=RequestRearCurtainPosition, method-id=16386, transport-protocol=UDP
      someip event group Eventgroup_Notification_soaRctnStatus: event-group-id=8705, event=Notification_soaRctnStatus
      someip event group Eventgroup_Notification_soaRctnSwVersion: event-group-id=8706, event=Notify_soaRctnSwVersion
    SoaRoa: service-interface=SoaRoa, service-interface-id=4947
      7 x someip field deployment:
        soaRoaDetectCount: field=soaRoaDetectCount
          get Get_soaRoaDetectCount: method-id=5, transport-protocol=UDP
          notifier Notify_soaRoaDetectCount: event-id=16389, transport-protocol=UDP
        soaRoaDetectState: field=soaRoaDetectState
          get Get_soaRoaDetectState: method-id=4, transport-protocol=UDP
          notifier Notify_soaRoaDetectState: event-id=16388, transport-protocol=UDP
        soaRoaDeviceNormal: field=soaRoaDeviceNormal
          get Get_soaRoaDeviceNormal: method-id=1, transport-protocol=UDP
          notifier Notify_soaRoaDeviceNormal: event-id=16385, transport-protocol=UDP
        soaRoaMode: field=soaRoaMode
          get Get_soaRoaMode: method-id=3, transport-protocol=UDP
          notifier Notify_soaRoaMode: event-id=16387, transport-protocol=UDP
        soaRoaRunningState: field=soaRoaRunningState
          get Get_soaRoaRunningState: method-id=2, transport-protocol=UDP
          notifier Notify_soaRoaRunningState: event-id=16386, transport-protocol=UDP
        soaRoaSensorError: field=soaRoaSensorError
          get Get_soaRoaSensorError: method-id=6, transport-protocol=UDP
          notifier Notify_soaRoaSensorError: event-id=16390, transport-protocol=UDP
        soaRoaSwVersion: field=soaRoaSwVersion
          get Get_soaRoaSwVersion: method-id=7, transport-protocol=UDP
          notifier Notify_soaRoaSwVersion: event-id=16391, transport-protocol=UDP
      4 x someip method deployment, all with transport-protocol=UDP:
        ResetRoaDetectInfo: method=ResetRoaDetectInfo, method-id=16387
        SetRoaMode: method=SetRoaMode, method-id=16388
        StartRoa: method=StartRoa, method-id=16385
        StopRoa: method=StopRoa, method-id=16386
      7 x someip event group:
        Eventgroup3_Notification_soaRoaDetectState: event-group-id=8708, event=Notify_soaRoaDetectState
        Eventgroup_Notification_soaRoaDetectCount: event-group-id=8709, event=Notify_soaRoaDetectCount
        Eventgroup_Notification_soaRoaDeviceNormal: event-group-id=8705, event=Notify_soaRoaDeviceNormal
        Eventgroup_Notification_soaRoaMode: event-group-id=8707, event=Notify_soaRoaMode
        Eventgroup_Notification_soaRoaRunningState: event-group-id=8706, event=Notify_soaRoaRunningState
        Eventgroup_Notification_soaRoaSensorError: event-group-id=8710, event=Notify_soaRoaSensorError
        Eventgroup_Notification_soaRoaSwVersion: event-group-id=8711, event=Notify_soaRoaSwVersion
    SoaSmartFilm: service-interface=SoaSmartFilm, service-interface-id=4953
      4 x someip field deployment:
        soaFilmAuto: field=soaFilmAuto
          get Get_soaFilmAuto: method-id=3, transport-protocol=UDP
          notifier Notify_soaFilmAuto: event-id=16387, transport-protocol=UDP
        soaFilmDeviceNormal: field=soaFilmDeviceNormal
          get Get_soaFilmDeviceNormal: method-id=1, transport-protocol=UDP
          notifier Notify_soaFilmDeviceNormal: event-id=16385, transport-protocol=UDP
        soaFilmOpacities: field=soaFilmOpacities
          get Get_soaFilmOpacities: method-id=2, transport-protocol=UDP
          notifier Notify_soaFilmOpacities: event-id=16386, transport-protocol=UDP
        soaFilmSwVersion: field=soaFilmSwVersion
          get Get_soaFilmSwVersion: method-id=4, transport-protocol=UDP
          notifier Notify_soaFilmSwVersion: event-id=16388, transport-protocol=UDP
      someip method deployment SetAllOpacities: method=SetAllOpacities, method-id=16386, transport-protocol=UDP
      someip method deployment SetAuto: method=SetAuto, method-id=16387, transport-protocol=UDP
      someip method deployment SetOpacity: method=SoaSmartFilm/SetOpacity, method-id=16385, transport-protocol=UDP
      4 x someip event group:
        Eventgroup_Notify_soaFilmAuto: event-group-id=8707, event=Notify_soaFilmAuto
        Eventgroup_Notify_soaFilmDeviceNormal: event-group-id=8705, event=Notify_soaFilmDeviceNormal
        Eventgroup_Notify_soaFilmOpacities: event-group-id=8706, event=Notify_soaFilmOpacities
        Eventgroup_Notify_soaFilmSwVersion: event-group-id=8708, event=Notify_soaFilmSwVersion
    SoaVehicleInfo: service-interface=SoaVehicleInfo, service-interface-id=4955
      someip field deployment soaVehicleInfo: field=soaVehicleInfo
        get Get_soaVehicleInfo: method-id=1, transport-protocol=UDP
        notifier Notify_soaVehicleInfo: event-id=16385, transport-protocol=UDP
      someip event group Eventgroup_Notification_soaVehicleInfo: event-group-id=8705, event=Notify_soaVehicleInfo
    SoaWiper: service-interface=SoaWiper, service-interface-id=4949
      someip field deployment soaWiperDeviceNormal: field=soaWiperDeviceNormal
        get Get_soaWiperDeviceNormal: method-id=1, transport-protocol=UDP
        notifier Notify_soaWiperDeviceNormal: event-id=16385, transport-protocol=UDP
      someip field deployment soaWiperStatus: field=soaWiperStatus
        get Get_soaWiperStatus: method-id=2, transport-protocol=UDP
        notifier Notify_soaWiperStatus: event-id=16386, transport-protocol=UDP
      someip field deployment soaWiperSwVersion: field=soaWiperSwVersion
        get Get_soaWiperSwVersion: method-id=3, transport-protocol=UDP
        notifier Notify_soaWiperSwVersion: event-id=16387, transport-protocol=UDP
      someip method deployment RequestWiperOperation: method=RequestWiperOperation, method-id=16386, transport-protocol=UDP
      someip method deployment SetWiperAutoSpeed: method=SetWiperAutoSpeed, method-id=16385, transport-protocol=UDP
      someip event group Eventgroup_Notification_soaWiperDeviceNormal: event-group-id=8705, event=Notify_soaWiperDeviceNormal
      someip event group Eventgroup_Notification_soaWiperStatus: event-group-id=8706, event=Notify_soaWiperStatus
      someip event group Eventgroup_Notification_soaWiperSwVersion: event-group-id=8707, event=Notify_soaWiperSwVersion
    Zone1DrvSeat: service-interface=Zone1DrvSeat, service-interface-id=5408
      someip field deployment zone1DrvSeatMotorDir: field=zone1DrvSeatMotorDir
        get Get_zone1DrvSeatMotorDir: method-id=2088, transport-protocol=UDP
        notifier Notify_zone1DrvSeatMotorDir: event-id=2045, transport-protocol=UDP
      someip field deployment zone1DrvSeatMotorPos: field=zone1DrvSeatMotorPos
        get Get_zone1DrvSeatMotorPos: method-id=2089, transport-protocol=UDP
        notifier Notify_zone1DrvSeatMotorPos: event-id=2046, transport-protocol=UDP
      someip method deployment controlMotor: method=controlMotor, method-id=2090, transport-protocol=UDP
      someip event group Eventgroup_Notify_zone1DrvSeatMotorDir: event-group-id=1002, event=[Notify_zone1DrvSeatMotorDir, Notify_zone1DrvSeatMotorPos]
    Zone1MfswInput: service-interface=Zone1MfswInput, service-interface-id=5424
      someip event deployment onMfswInput: event=onMfswInput, event-id=12915, serializer=SOMEIP, transport-protocol=UDP
      someip event group Eventgroup_onMfswInput: event-group-id=1003, event=onMfswInput
    Zone1Mlm: service-interface=Zone1Mlm, service-interface-id=5392
      someip field deployment zone1MlmStatus: field=zone1MlmStatus
        get Get_zone1MlmStatus: method-id=2041, transport-protocol=UDP
        notifier Notify_zone1MlmStatus: event-id=2023, transport-protocol=UDP
      someip method deployment setMlmBrightness: method=setMlmBrightness, method-id=2042, transport-protocol=UDP
      someip method deployment setMlmColor: method=setMlmColor, method-id=2044, transport-protocol=UDP
      someip event group Eventgroup_Notify_zone1MlmStatus: event-group-id=1001, event=Notify_zone1MlmStatus
    Zone1Power: service-interface=Zone1Power, service-interface-id=5377
    Zone1Rsv: service-interface=Zone1RsvA, service-interface-id=5472
      someip field deployment zone1DeviceNormal: field=zone1DeviceNormal
        get Get_zone1DeviceNormal: method-id=2051, transport-protocol=UDP
        notifier Notify_zone1DeviceNormal: event-id=2027, transport-protocol=UDP
      someip event group Eventgroup_Notify_zone1DeviceNormal: event-group-id=1006, event=Notify_zone1DeviceNormal
    Zone2Power: service-interface=Zone2Power, service-interface-id=5633
    Zone2Roa: service-interface=Zone2Roa, service-interface-id=5648
      someip field deployment zone2RoaSnsrStatus: field=zone2RoaSnsrStatus
        get Get_zone2RoaSnsrStatus: method-id=2045, transport-protocol=UDP
        notifier Notify_zone2RoaSnsrStatus: event-id=2024, transport-protocol=UDP
      someip method deployment controlRoa: method=controlRoa, method-id=2093, transport-protocol=UDP
      someip event group Eventgroup_Notify_zone2RoaSnsrStatus: event-group-id=1011, event=Notify_zone2RoaSnsrStatus
    Zone2Rsv: service-interface=Zone2RsvA, service-interface-id=5680
      someip field deployment zone2DeviceNormal: field=zone2DeviceNormal
        get Get_zone2DeviceNormal: method-id=2071, transport-protocol=UDP
        notifier Notify_zone2DeviceNormal: event-id=2037, transport-protocol=UDP
      someip event group Eventgroup_Notify_zone2DeviceNormal: event-group-id=1013, event=Notify_zone2DeviceNormal
    Zone3Power: service-interface=Zone3Power, service-interface-id=5889
    Zone3Rcurtain: service-interface=Zone3Rcurtain, service-interface-id=5904
      someip field deployment zone3RcurtainStatus: field=zone3RcurtainStatus
        get Get_zone3RcurtainStatus: method-id=2086, transport-protocol=UDP
        notifier Notify_zone3RcurtainStatus: event-id=2044, transport-protocol=UDP
      someip method deployment controlRcurtain: method=controlRcurtain, method-id=2087, transport-protocol=UDP
      someip event group Eventgroup_Notify_zone3RcurtainStatus: event-group-id=1021, event=Notify_zone3RcurtainStatus
    Zone3RsvA: service-interface=Zone3RsvA, service-interface-id=5920
      someip field deployment zone3DeviceNormal: field=zone3DeviceNormal
        get Get_zone3DeviceNormal: method-id=2082, transport-protocol=UDP
        notifier Notify_zone3DeviceNormal: event-id=2042, transport-protocol=UDP
      someip event group Eventgroup_Notify_zone3DeviceNormal: event-group-id=1022, event=Notify_zone3DeviceNormal
    Zone4Power: service-interface=Zone4Power, service-interface-id=6145
    Zone4RsvA: service-interface=Zone4RsvA, service-interface-id=6176
      someip field deployment zone4DeviceNormal: field=zone4DeviceNormal
        get Get_zone4DeviceNormal: method-id=2059, transport-protocol=UDP
        notifier Notify_zone4DeviceNormal: event-id=2031, transport-protocol=UDP
      someip event group Eventgroup_Notify_zone4DeviceNormal: event-group-id=1032, event=Notify_zone4DeviceNormal
    Zone4Wiper: service-interface=Zone4Wiper, service-interface-id=6160
      someip field deployment zone4WiperOpStatus: field=zone4WiperOpStatus
        get Get_zone4WiperOpStatus: method-id=2084, transport-protocol=UDP
        notifier Notify_zone4WiperOpStatus: event-id=2043, transport-protocol=UDP
      someip method deployment controlWiper: method=controlWiper, method-id=2085, transport-protocol=UDP
      someip event group Eventgroup_Notify_zone4WiperOpStatus: event-group-id=1031, event=Notify_zone4WiperOpStatus
    Zone5Dms: service-interface=Zone5Dms, service-interface-id=6404
      someip field deployment zone5DmsDeviceNormal: field=zone5DmsDeviceNormal
        get Get_zone5DmsDeviceNormal: method-id=1, transport-protocol=UDP
        notifier Notify_zone5DmsDeviceNormal: event-id=16385, transport-protocol=UDP
      someip field deployment zone5DmsDriverStatus: field=zone5DmsDriverStatus
        get Get_zone5DmsDriverStatus: method-id=3, transport-protocol=UDP
        notifier Notify_zone5DmsDriverStatus: event-id=16387, transport-protocol=UDP
      someip field deployment zone5DmsStatus: field=zone5DmsStatus
        get Get_zone5DmsStatus: method-id=2, transport-protocol=UDP
        notifier Notify_zone5DmsStatus: event-id=16386, transport-protocol=UDP
      someip method deployment SetDmsPower: method=Zone5Dms/SetDmsPower, method-id=16385, transport-protocol=UDP
      someip event group Eventgroup_Notify_zone5DmsDeviceNormal: event-group-id=8705, event=Notify_zone5DmsDeviceNormal
      someip event group Eventgroup_Notify_zone5DmsDriverStatus: event-group-id=8707, event=Notify_zone5DmsDriverStatus
      someip event group Eventgroup_Notify_zone5DmsStatus: event-group-id=8706, event=Notify_zone5DmsStatus
    Zone5Hvac: service-interface=Zone5Hvac, service-interface-id=6402
      4 x someip field deployment:
        zone5HvacDeviceNormal: field=zone5HvacDeviceNormal
          get Get_zone5HvacDeviceNormal: method-id=1, transport-protocol=UDP
          notifier Notify_zone5HvacDeviceNormal: event-id=16385, transport-protocol=UDP
        zone5HvacSetting: field=zone5HvacSetting
          get Get_zone5HvacSetting: method-id=2, transport-protocol=UDP
          notifier Notify_zone5HvacSetting: event-id=16386, transport-protocol=UDP
        zone5HvacStatus: field=zone5HvacStatus
          get Get_zone5HvacStatus: method-id=3, transport-protocol=UDP
          notifier Notify_zone5HvacStatus: event-id=16387, transport-protocol=UDP
        zone5HvacTemps: field=zone5HvacTemps
          get Get_zone5HvacTemps: method-id=4, transport-protocol=UDP
          notifier Notify_zone5HvacTemps: event-id=16388, transport-protocol=UDP
      11 x someip method deployment, all with transport-protocol=UDP:
        SetAcOnOff: method=Zone5Hvac/SetAcOnOff, method-id=16386
        SetAirSource: method=Zone5Hvac/SetAirSource, method-id=16393
        SetAutoTemp: method=Zone5Hvac/SetAutoTemp, method-id=16387
        SetBackwardDefrostOn: method=Zone5Hvac/SetBackwardDefrostOn, method-id=16395
        SetBlowingDirection: method=Zone5Hvac/SetBlowingDirection, method-id=16391
        SetBlowingForce: method=Zone5Hvac/SetBlowingForce, method-id=16390
        SetDriverTemp: method=Zone5Hvac/SetDriverTemp, method-id=16388
        SetForwardDefrostOn: method=Zone5Hvac/SetForwardDefrostOn, method-id=16394
        SetHvacPower: method=Zone5Hvac/SetHvacPower, method-id=16385
        SetPassengerTemp: method=Zone5Hvac/SetPassengerTemp, method-id=16389
        SetSync: method=Zone5Hvac/SetSync, method-id=16392
      4 x someip event group:
        Eventgroup_Notify_zone5HvacDeviceNormal: event-group-id=8705, event=Notify_zone5HvacDeviceNormal
        Eventgroup_Notify_zone5HvacSetting: event-group-id=8706, event=Notify_zone5HvacSetting
        Eventgroup_Notify_zone5HvacStatus: event-group-id=8707, event=Notify_zone5HvacStatus
        Eventgroup_Notify_zone5HvacTemps: event-group-id=8708, event=Notify_zone5HvacTemps
    Zone5Power: service-interface=Zone5Power, service-interface-id=6401
      someip field deployment zone5PowerDeviceNormal: field=zone5PowerDeviceNormal
        get Get_zone5PowerDeviceNormal: method-id=1, transport-protocol=UDP
        notifier Notify_zone5PowerDeviceNormal: event-id=16385, transport-protocol=UDP
      someip event group Eventgroup_Notify_zone5PowerDeviceNormal: event-group-id=8705, event=Notify_zone5PowerDeviceNormal
    Zone5SmtFilm: service-interface=Zone5SmtFilm, service-interface-id=6403
      someip field deployment zone5SmtFilmDeviceNormal: field=zone5SmtFilmDeviceNormal
        get Get_zone5SmtFilmDeviceNormal: method-id=1, transport-protocol=UDP
        notifier Notify_zone5SmtFilmDeviceNormal: event-id=16385, transport-protocol=UDP
      someip field deployment zone5SmtFilmOpacities: field=zone5SmtFilmOpacities
        get Get_zone5SmtFilmOpacities: method-id=2, transport-protocol=UDP
        notifier Notify_zone5SmtFilmOpacities: event-id=16386, transport-protocol=UDP
      someip method deployment SetAllOpacity: method=SetAllOpacity, method-id=16386, transport-protocol=UDP
      someip method deployment SetOpacity: method=Zone5SmtFilm/SetOpacity, method-id=16385, transport-protocol=UDP
      someip event group Eventgroup_Notify_zone5SmtFilmDeviceNormal: event-group-id=8705, event=Notify_zone5SmtFilmDeviceNormal
      someip event group Eventgroup_Notify_zone5SmtFilmOpacities: event-group-id=8706, event=Notify_zone5SmtFilmOpacities
package /ServiceInstance/Endpoint
  45 x someip service instance to machine mapping, all with communication-connector=eth0:
    EEVP_SOA_DMS_SomeIpConsumer: service-instance=Consumer_SoaDms, tcp-port=37779, udp-port=37779
    EEVP_SOA_DMS_SomeIpProvider: service-instance=Provider_SoaDms, tcp-port=37778, udp-port=37778
    EEVP_SOA_DMS_VehicleInfo_SomeIpConsumer: service-instance=Consumer_SoaDms_VehicleInfo, tcp-port=1063, udp-port=1063
    EEVP_SOA_DriverSeat_SomeIpConsumer: service-instance=Consumer_SoaDriverSeat, tcp-port=37775, udp-port=37775
    EEVP_SOA_DriverSeat_SomeIpProvider: service-instance=Provider_SoaDriverSeat, tcp-port=37774, udp-port=37774
    EEVP_SOA_DriverSeat_VehicleInfo_SomeIpConsumer: service-instance=Consumer_SoaDriverSeat_VehicleInfo, tcp-port=1055, udp-port=1055
    EEVP_SOA_HVAC_SomeIpConsumer: service-instance=Consumer_SoaHvac, tcp-port=37777, udp-port=37777
    EEVP_SOA_HVAC_SomeIpProvider: service-instance=Provider_SoaHvac, tcp-port=37776, udp-port=37776
    EEVP_SOA_HVAC_VehicleInfo_SomeIpConsumer: service-instance=Consumer_SoaHvac_VehicleInfo, tcp-port=1061, udp-port=1061
    EEVP_SOA_MLM_SomeIpConsumer: service-instance=Consumer_SoaMlm, tcp-port=37767, udp-port=37767
    EEVP_SOA_MLM_SomeIpProvider: service-instance=Provider_SoaMlm, tcp-port=37766, udp-port=37766
    EEVP_SOA_Moodlamp_VehicleInfo_SomeIpConsumer: service-instance=Consumer_SoaMoodlamp_VehicleInfo, tcp-port=1056, udp-port=1056
    EEVP_SOA_POWER_SomeIpConsumer: service-instance=Consumer_SoaPower, tcp-port=37763, udp-port=37763
    EEVP_SOA_POWER_SomeIpProvider: service-instance=Provider_SoaPower, tcp-port=37762, udp-port=37762
    EEVP_SOA_RCRTN_SomeIpConsumer: service-instance=Consumer_SoaRcurtain, tcp-port=37765, udp-port=37765
    EEVP_SOA_RCRTN_SomeIpProvider: service-instance=Provider_SoaRcurtain, tcp-port=37764, udp-port=37764
    EEVP_SOA_ROA_SomeIpConsumer: service-instance=Consumer_SoaRoa, tcp-port=37769, udp-port=37769
    EEVP_SOA_ROA_SomeIpProvider: service-instance=Provider_SoaRoa, tcp-port=37768, udp-port=37768
    EEVP_SOA_ROA_VehicleInfo_SomeIpConsumer: service-instance=Consumer_SoaRoa_VehicleInfo, tcp-port=1057, udp-port=1057
    EEVP_SOA_Rcurtain_VehicleInfo_SomeIpConsumer: service-instance=Consumer_SoaRcurtain_VehicleInfo, tcp-port=1058, udp-port=1058
    EEVP_SOA_SmartFilm_SomeIpConsumer: service-instance=Consumer_SoaSmartFilm, tcp-port=37781, udp-port=37781
    EEVP_SOA_SmartFilm_SomeIpProvider: service-instance=Provider_SoaSmartFilm, tcp-port=37780, udp-port=37780
    EEVP_SOA_SmartFilm_VehicleInfo_SomeIpConsumer: service-instance=Consumer_SoaSmartFilm_VehicleInfo, tcp-port=1062, udp-port=1062
    EEVP_SOA_VehicleInfo_SomeIpProvider: service-instance=Provider_SoaVehicleInfo, tcp-port=1064, udp-port=1064
    EEVP_SOA_WIPER_MFSW_SomeIpConsumer: service-instance=Consumer_SoaWiper_MFSW, tcp-port=1060, udp-port=1060
    EEVP_SOA_Wiper_SomeIpConsumer: service-instance=Consumer_SoaWiper, tcp-port=37773, udp-port=37773
    EEVP_SOA_Wiper_SomeIpProvider: service-instance=Provider_SoaWiper, tcp-port=37772, udp-port=37772
    EEVP_SOA_Wiper_VehicleInfo_SomeIpConsumer: service-instance=Consumer_SoaWiper_VehicleInfo, tcp-port=1059, udp-port=1059
    EEVP_ZONE1_DrvSeat_SomeIpConsumer: service-instance=Consumer_Zone1DrvSeat, tcp-port=1030, udp-port=1030
    EEVP_ZONE1_MLM_SomeIpConsumer: service-instance=Consumer_Zone1Mlm, tcp-port=1031, udp-port=1031
    EEVP_ZONE1_Power_SomeIpConsumer: service-instance=Consumer_Zone1Power, tcp-port=1032, udp-port=1032
    EEVP_ZONE1_RSVA_SomeIpConsumer: service-instance=Consumer_Zone1Rsv, tcp-port=1033, udp-port=1033
    EEVP_ZONE2_Power_SomeIpConsumer: service-instance=Consumer_Zone2Power, tcp-port=1034, udp-port=1034
    EEVP_ZONE2_ROA_SomeIpConsumer: service-instance=Consumer_Zone2Roa, tcp-port=1035, udp-port=1035
    EEVP_ZONE2_RSVA_SomeIpConsumer: service-instance=Consumer_Zone2Rsv, tcp-port=1036, udp-port=1036
    EEVP_ZONE3_Power_SomeIpConsumer: service-instance=Consumer_Zone3Power, tcp-port=1037, udp-port=1037
    EEVP_ZONE3_RSVA_SomeIpConsumer: service-instance=Consumer_Zone3Rsv, tcp-port=1039, udp-port=1039
    EEVP_ZONE3_Rcrtn_SomeIpConsumer: service-instance=Consumer_Zone3Rcurtain, tcp-port=1038, udp-port=1038
    EEVP_ZONE4_Power_SomeIpConsumer: service-instance=Consumer_Zone4Power, tcp-port=1040, udp-port=1040
    EEVP_ZONE4_RSVA_SomeIpConsumer: service-instance=Consumer_Zone4Rsv, tcp-port=1041, udp-port=1041
    EEVP_ZONE4_Wiper_SomeIpConsumer: service-instance=Consumer_Zone4Wiper, tcp-port=1042, udp-port=1042
    EEVP_ZONE5_DMS_SomeIpConsumer: service-instance=Consumer_Zone5Dms, tcp-port=1054, udp-port=1054
    EEVP_ZONE5_HVAC_SomeIpConsumer: service-instance=Consumer_Zone5Hvac, tcp-port=1052, udp-port=1052
    EEVP_ZONE5_Power_SomeIpConsumer: service-instance=Consumer_Zone5Power, tcp-port=1051, udp-port=1051
    EEVP_ZONE5_SmtFilm_SomeIpConsumer: service-instance=Consumer_Zone5SmtFilm, tcp-port=1053, udp-port=1053
package /ServiceInstance/SdTimingConfig/Client
  someip sd client service instance config DefaultClientConfig: initial-find-behavior={initial-delay-max-value=0.1, initial-delay-min-value=0.1, initial-repetitions-base-delay=0.1, initial-repetitions-max=3}, service-find-time-to-live=16777215
package /ServiceInstance/SdTimingConfig/Server
  someip sd server service instance config DefaultSdServerConfig: initial-offer-behavior={initial-delay-max-value=0.1, initial-delay-min-value=0.1, initial-repetitions-base-delay=0.1, initial-repetitions-max=2}, offer-cyclic-delay=0.5, request-response-delay={max-value=0.0, min-value=0.0}, service-offer-time-to-live=16777215
package /ServiceInstance/SdTimingConfig/Subscription
  someip sd client event group timing config DefaultSdSubscribeConfig: request-response-delay={max-value=0.0, min-value=0.0}, subscribe-eventgroup-retry-delay=0.0, subscribe-eventgroup-retry-max=3, time-to-live=16777215
package /ServiceInstance/Someip/Consumer
  35 x required someip service instance, all with required-service-instance-id=ANY:
    Consumer_SoaDms: service-interface-deployment=SoaDms, method-request-propss=[Get_soaDmsDeviceNormal, Get_soaDmsStatus, Get_soaDmsDriverStatus, Get_soaDmsSwVersion, SoaDms/SetDmsPower], sd-client-config=DefaultSdClientConfig
      7 x someip required event group, all with sd-client-event-group-timing-config=DefaultSdSubscribeConfig:
        Eventgroup_Notify_onDriverNotFocusing: event-group=Eventgroup_onDriverNotFocusing
        Eventgroup_Notify_onDriverNotWaken: event-group=Eventgroup_onDriverNotWaken
        Eventgroup_Notify_onDriverNotWatchingFront: event-group=Eventgroup_onDriverNotWatchingFront
        Eventgroup_Notify_soaDmsDeviceNormal: event-group=Eventgroup_Notify_soaDmsDeviceNormal
        Eventgroup_Notify_soaDmsDriverStatus: event-group=Eventgroup_Notify_soaDmsDriverStatus
        Eventgroup_Notify_soaDmsStatus: event-group=Eventgroup_Notify_soaDmsStatus
        Eventgroup_Notify_soaDmsSwVersion: event-group=Eventgroup_Notify_soaDmsSwVersion
    Consumer_SoaDms_VehicleInfo: service-interface-deployment=Zone_VehicleInfo_Input, sd-client-config=DefaultSdClientConfig
      someip required event group Eventgroup_VehicleInfo: event-group=Eventgroup_VehicleInfo, sd-client-event-group-timing-config=DefaultSdSubscribeConfig
    Consumer_SoaDriverSeat: service-interface-deployment=SoaDriverSeat, sd-client-config=DefaultSdClientConfig
      method-request-propss:
        Get_soaDrvSeatDeviceNormal
        Get_soaDrvSeatMotorDirection
        Get_soaDrvSeatMotorPosition
        Get_soaDrvSeatSwVersion
        RequestMoveDrvSeatHeight
        RequestMoveDrvSeatRecline
        RequestMoveDrvSeatSlide
        RequestMoveDrvSeatTilt
      4 x someip required event group, all with sd-client-event-group-timing-config=DefaultSdSubscribeConfig:
        Eventgroup_Notification_soaDrvSeatDeviceNormal: event-group=Eventgroup_Notification_soaDrvSeatDeviceNormal
        Eventgroup_Notification_soaDrvSeatDevicePosition: event-group=Eventgroup_Notification_soaDrvSeatMotorPosition
        Eventgroup_Notification_soaDrvSeatDeviceSwVersion: event-group=Eventgroup_Notification_soaDrvSeatSwVersion
        Eventgroup_Notification_soaDrvSeatMotorDevice: event-group=Eventgroup_Notification_soaDrvSeatMotorDirection
    Consumer_SoaDriverSeat_VehicleInfo: service-interface-deployment=Zone_VehicleInfo_Input, sd-client-config=DefaultSdClientConfig
      someip required event group Eventgroup_VehicleInfo: event-group=Eventgroup_VehicleInfo, sd-client-event-group-timing-config=DefaultSdSubscribeConfig
    Consumer_SoaHvac: service-interface-deployment=SoaHvac, sd-client-config=DefaultSdClientConfig
      method-request-propss:
        method=Get_soaHvacDeviceNormal
        Get_soaHvacSetting
        Get_soaHvacStatus
        Get_soaHvacTemps
        Get_soaHvacSwVersion
        SoaHvac/SetHvacPower
        SoaHvac/SetAcOnOff
        SoaHvac/SetAutoTemp
        SoaHvac/SetDriverTemp
        SoaHvac/SetPassengerTemp
        SoaHvac/SetBlowingForce
        SoaHvac/SetBlowingDirection
        SoaHvac/SetSync
        SoaHvac/SetAirSource
        SoaHvac/SetForwardDefrostOn
        SoaHvac/SetBackwardDefrostOn
      5 x someip required event group, all with sd-client-event-group-timing-config=DefaultSdSubscribeConfig:
        Eventgroup_Notify_soaHvacDeviceNormal: event-group=Eventgroup_Notify_soaHvacDeviceNormal
        Eventgroup_Notify_soaHvacSetting: event-group=Eventgroup_Notify_soaHvacSetting
        Eventgroup_Notify_soaHvacStatus: event-group=Eventgroup_Notify_soaHvacStatus
        Eventgroup_Notify_soaHvacSwVersion: event-group=Eventgroup_Notify_soaHvacSwVersion
        Eventgroup_Notify_soaHvacTemps: event-group=Eventgroup_Notify_soaHvacTemps
    Consumer_SoaHvac_VehicleInfo: service-interface-deployment=Zone_VehicleInfo_Input, sd-client-config=DefaultSdClientConfig
      someip required event group Eventgroup_VehicleInfo: event-group=Eventgroup_VehicleInfo, sd-client-event-group-timing-config=DefaultSdSubscribeConfig
    Consumer_SoaMlm: service-interface-deployment=SoaMlm, method-request-propss=[Get_soaMlmStatus, Get_soaMlmSwVersion, RequestMlmSetBrightness, RequestMlmSetMode, RequestMlmSetRgbColor], sd-client-config=DefaultSdClientConfig
      someip required event group Eventgroup_Notification_soaMlmStatus: event-group=Eventgroup_Notification_soaMlmStatus, sd-client-event-group-timing-config=DefaultSdSubscribeConfig
      someip required event group Eventgroup_Notification_soaMlmSwVersion: event-group=Eventgroup_Notification_soaMlmSwVersion, sd-client-event-group-timing-config=DefaultSdSubscribeConfig
    Consumer_SoaMoodlamp_VehicleInfo: service-interface-deployment=Zone_VehicleInfo_Input, sd-client-config=DefaultSdClientConfig
      someip required event group Eventgroup_VehicleInfo: event-group=Eventgroup_VehicleInfo, sd-client-event-group-timing-config=DefaultSdSubscribeConfig
    Consumer_SoaPower: service-interface-deployment=SoaPower, method-request-propss=[Get_soaPowerDeviceNormal, method=Get_soaPowerSwVersion], sd-client-config=DefaultSdClientConfig
      someip required event group Eventgroup_Notification_soaPowerDeviceNormal: event-group=Eventgroup_Notification_soaPowerDeviceNormal, sd-client-event-group-timing-config=DefaultSdSubscribeConfig
      someip required event group Eventgroup_Notify_soaPowerSwVersion: event-group=Eventgroup_Notify_soaPowerSwVersion, sd-client-event-group-timing-config=DefaultSdSubscribeConfig
    Consumer_SoaRcurtain: service-interface-deployment=SoaRcurtain, sd-client-config=DefaultClientConfig
      method-request-propss:
        Get_soaRctnStatus
        method=Get_soaRctnSwVersion
        method=RequestRearCurtainOperation
        RequestRearCurtainPosition
      someip required event group Eventgroup_Notification_soaRctnStatus: event-group=Eventgroup_Notification_soaRctnStatus, sd-client-event-group-timing-config=DefaultSdSubscribeConfig
      someip required event group Eventgroup_Notification_soaRctnSwVersion: event-group=Eventgroup_Notification_soaRctnSwVersion, sd-client-event-group-timing-config=DefaultSdSubscribeConfig
    Consumer_SoaRcurtain_VehicleInfo: service-interface-deployment=Zone_VehicleInfo_Input, sd-client-config=DefaultSdClientConfig
      someip required event group Eventgroup_VehicleInfo: event-group=Eventgroup_VehicleInfo, sd-client-event-group-timing-config=DefaultSdSubscribeConfig
    Consumer_SoaRoa: service-interface-deployment=SoaRoa, sd-client-config=DefaultSdClientConfig
      method-request-propss:
        Get_soaRoaDetectCount
        Get_soaRoaDetectState
        collection-props=udp-collection-trigger=NEVER, method=Get_soaRoaDeviceNormal
        Get_soaRoaMode
        Get_soaRoaRunningState
        Get_soaRoaSensorError
        Get_soaRoaSwVersion
        ResetRoaDetectInfo
        SetRoaMode
        StartRoa
        StopRoa
      7 x someip required event group, all with sd-client-event-group-timing-config=DefaultSdSubscribeConfig:
        Eventgroup_Notification_soaRoaDetectCount: event-group=Eventgroup_Notification_soaRoaDetectCount
        Eventgroup_Notification_soaRoaDetectState: event-group=Eventgroup3_Notification_soaRoaDetectState
        Eventgroup_Notification_soaRoaDeviceNormal: event-group=Eventgroup_Notification_soaRoaDeviceNormal
        Eventgroup_Notification_soaRoaMode: event-group=Eventgroup_Notification_soaRoaMode
        Eventgroup_Notification_soaRoaRunningState: event-group=Eventgroup_Notification_soaRoaRunningState
        Eventgroup_Notification_soaRoaSensorError: event-group=Eventgroup_Notification_soaRoaSensorError
        Eventgroup_Notification_soaRoaSwVersion: event-group=Eventgroup_Notification_soaRoaSwVersion
    Consumer_SoaRoa_VehicleInfo: service-interface-deployment=Zone_VehicleInfo_Input, sd-client-config=DefaultSdClientConfig
      someip required event group Eventgroup_VehicleInfo: event-group=Eventgroup_VehicleInfo, sd-client-event-group-timing-config=DefaultSdSubscribeConfig
    Consumer_SoaSmartFilm: service-interface-deployment=SoaSmartFilm, sd-client-config=DefaultSdClientConfig
      method-request-propss:
        Get_soaFilmDeviceNormal
        Get_soaFilmOpacities
        Get_soaFilmAuto
        Get_soaFilmSwVersion
        SoaSmartFilm/SetOpacity
        SetAllOpacities
      4 x someip required event group, all with sd-client-event-group-timing-config=DefaultSdSubscribeConfig:
        Eventgroup_Notify_soaFilmAuto: event-group=Eventgroup_Notify_soaFilmAuto
        Eventgroup_Notify_soaFilmDeviceNormal: event-group=Eventgroup_Notify_soaFilmDeviceNormal
        Eventgroup_Notify_soaFilmOpacities: event-group=Eventgroup_Notify_soaFilmOpacities
        Eventgroup_Notify_soaFilmSwVersion: event-group=Eventgroup_Notify_soaFilmSwVersion
    Consumer_SoaSmartFilm_VehicleInfo: service-interface-deployment=Zone_VehicleInfo_Input, sd-client-config=DefaultSdClientConfig
      someip required event group Eventgroup_VehicleInfo: event-group=Eventgroup_VehicleInfo, sd-client-event-group-timing-config=DefaultSdSubscribeConfig
    Consumer_SoaWiper: service-interface-deployment=SoaWiper, sd-client-config=DefaultClientConfig
      method-request-propss:
        method=Get_soaWiperDeviceNormal
        Get_soaWiperStatus
        Get_soaWiperSwVersion
        RequestWiperOperation
        SetWiperAutoSpeed
      someip required event group Eventgroup_Notification_soaWiperDeviceNormal: event-group=Eventgroup_Notification_soaWiperDeviceNormal, sd-client-event-group-timing-config=DefaultSdSubscribeConfig
      someip required event group Eventgroup_Notification_soaWiperStatus: event-group=Eventgroup_Notification_soaWiperStatus, sd-client-event-group-timing-config=DefaultSdSubscribeConfig
      someip required event group Eventgroup_Notification_soaWiperSwVersion: event-group=Eventgroup_Notification_soaWiperSwVersion, sd-client-event-group-timing-config=DefaultSdSubscribeConfig
    Consumer_SoaWiper_MFSW: service-interface-deployment=Zone1MfswInput, sd-client-config=DefaultSdClientConfig
      someip required event group Eventgroup_onMfswInput: event-group=Eventgroup_onMfswInput, sd-client-event-group-timing-config=DefaultSdSubscribeConfig
    Consumer_SoaWiper_VehicleInfo: service-interface-deployment=Zone_VehicleInfo_Input, sd-client-config=DefaultSdClientConfig
      someip required event group Eventgroup_VehicleInfo: event-group=Eventgroup_VehicleInfo, sd-client-event-group-timing-config=DefaultSdSubscribeConfig
    Consumer_Zone1DrvSeat: service-interface-deployment=Zone1DrvSeat, method-request-propss=[Get_zone1DrvSeatMotorDir, Get_zone1DrvSeatMotorPos, method=controlMotor], sd-client-config=DefaultSdClientConfig
      someip required event group Eventgroup_Notify_zone1DrvSeatMotorDir: event-group=Eventgroup_Notify_zone1DrvSeatMotorDir, sd-client-event-group-timing-config=DefaultSdSubscribeConfig
    Consumer_Zone1Mlm: service-interface-deployment=Zone1Mlm, method-request-propss=[Get_zone1MlmStatus, setMlmColor, method=setMlmBrightness], sd-client-config=DefaultSdClientConfig
      someip required event group Eventgroup_Notify_zone1MlmStatus: event-group=Eventgroup_Notify_zone1MlmStatus, sd-client-event-group-timing-config=DefaultSdSubscribeConfig
    Consumer_Zone1Power: service-interface-deployment=Zone1Power, sd-client-config=DefaultSdClientConfig
    Consumer_Zone1Rsv: service-interface-deployment=Zone1Rsv, someip-method-props=Get_zone1DeviceNormal, sd-client-config=DefaultSdClientConfig
      someip required event group Eventgroup_Notify_zone1DeviceNormal: event-group=Eventgroup_Notify_zone1DeviceNormal, sd-client-event-group-timing-config=DefaultSdSubscribeConfig
    Consumer_Zone2Power: service-interface-deployment=Zone2Power, sd-client-config=DefaultSdClientConfig
    Consumer_Zone2Roa: service-interface-deployment=Zone2Roa, method-request-propss=[method=Get_zone2RoaSnsrStatus, controlRoa], sd-client-config=DefaultSdClientConfig
      someip required event group Eventgroup_Notify_zone2RoaSnsrStatus: event-group=Eventgroup_Notify_zone2RoaSnsrStatus, sd-client-event-group-timing-config=DefaultSdSubscribeConfig
    Consumer_Zone2Rsv: service-interface-deployment=Zone2Rsv, someip-method-props=method=Get_zone2DeviceNormal, sd-client-config=DefaultSdClientConfig
      someip required event group Eventgroup_Notify_zone2DeviceNormal: event-group=Eventgroup_Notify_zone2DeviceNormal, sd-client-event-group-timing-config=DefaultSdSubscribeConfig
    Consumer_Zone3Power: service-interface-deployment=Zone3Power, sd-client-config=DefaultSdClientConfig
    Consumer_Zone3Rcurtain: service-interface-deployment=Zone3Rcurtain, method-request-propss=[Get_zone3RcurtainStatus, controlRcurtain], sd-client-config=DefaultSdClientConfig
      someip required event group Eventgroup_Notify_zone3RcurtainStatus: event-group=Eventgroup_Notify_zone3RcurtainStatus, sd-client-event-group-timing-config=DefaultSdSubscribeConfig
    Consumer_Zone3Rsv: service-interface-deployment=Zone3RsvA, someip-method-props=Get_zone3DeviceNormal, sd-client-config=DefaultSdClientConfig
      someip required event group Eventgroup_Notify_zone3DeviceNormal: event-group=Eventgroup_Notify_zone3DeviceNormal, sd-client-event-group-timing-config=DefaultSdSubscribeConfig
    Consumer_Zone4Power: service-interface-deployment=Zone4Power, sd-client-config=DefaultSdClientConfig
    Consumer_Zone4Rsv: service-interface-deployment=Zone4RsvA, someip-method-props=method=Get_zone4DeviceNormal, sd-client-config=DefaultSdClientConfig
      someip required event group Eventgroup_Notify_zone4DeviceNormal: event-group=Eventgroup_Notify_zone4DeviceNormal, sd-client-event-group-timing-config=DefaultSdSubscribeConfig
    Consumer_Zone4Wiper: service-interface-deployment=Zone4Wiper, method-request-propss=[method=Get_zone4WiperOpStatus, controlWiper], sd-client-config=DefaultSdClientConfig
      someip required event group Eventgroup_Notify_zone4WiperOpStatus: event-group=Eventgroup_Notify_zone4WiperOpStatus, sd-client-event-group-timing-config=DefaultSdSubscribeConfig
    Consumer_Zone5Dms: service-interface-deployment=Zone5Dms, method-request-propss=[Get_zone5DmsDeviceNormal, Get_zone5DmsStatus, Get_zone5DmsDriverStatus, Zone5Dms/SetDmsPower], sd-client-config=DefaultSdClientConfig
      someip required event group Eventgroup_Notify_zone5DmsDeviceNormal: event-group=Eventgroup_Notify_zone5DmsDeviceNormal, sd-client-event-group-timing-config=DefaultSdSubscribeConfig
      someip required event group Eventgroup_Notify_zone5DmsDriverStatus: event-group=Eventgroup_Notify_zone5DmsDriverStatus, sd-client-event-group-timing-config=DefaultSdSubscribeConfig
      someip required event group Eventgroup_Notify_zone5DmsStatus: event-group=Eventgroup_Notify_zone5DmsStatus, sd-client-event-group-timing-config=DefaultSdSubscribeConfig
    Consumer_Zone5Hvac: service-interface-deployment=Zone5Hvac, sd-client-config=DefaultSdClientConfig
      method-request-propss:
        Get_zone5HvacDeviceNormal
        Get_zone5HvacSetting
        Get_zone5HvacStatus
        Get_zone5HvacTemps
        Zone5Hvac/SetHvacPower
        Zone5Hvac/SetAcOnOff
        Zone5Hvac/SetAutoTemp
        Zone5Hvac/SetDriverTemp
        Zone5Hvac/SetPassengerTemp
        Zone5Hvac/SetBlowingForce
        Zone5Hvac/SetBlowingDirection
        Zone5Hvac/SetSync
        Zone5Hvac/SetAirSource
        Zone5Hvac/SetForwardDefrostOn
        Zone5Hvac/SetBackwardDefrostOn
      4 x someip required event group, all with sd-client-event-group-timing-config=DefaultSdSubscribeConfig:
        Eventgroup_Notify_zone5HvacDeviceNormal: event-group=Eventgroup_Notify_zone5HvacDeviceNormal
        Eventgroup_Notify_zone5HvacSetting: event-group=Eventgroup_Notify_zone5HvacSetting
        Eventgroup_Notify_zone5HvacStatus: event-group=Eventgroup_Notify_zone5HvacStatus
        Eventgroup_Notify_zone5HvacTemps: event-group=Eventgroup_Notify_zone5HvacTemps
    Consumer_Zone5Power: service-interface-deployment=Zone5Power, someip-method-props=method=Get_zone5PowerDeviceNormal, sd-client-config=DefaultSdClientConfig
      someip required event group Eventgroup_Notify_zone5PowerDeviceNormal: event-group=Eventgroup_Notify_zone5PowerDeviceNormal, sd-client-event-group-timing-config=DefaultSdSubscribeConfig
    Consumer_Zone5SmtFilm: service-interface-deployment=Zone5SmtFilm, method-request-propss=[Get_zone5SmtFilmDeviceNormal, Get_zone5SmtFilmOpacities, Zone5SmtFilm/SetOpacity, SetAllOpacity], sd-client-config=DefaultSdClientConfig
      someip required event group Eventgroup_Notify_zone5SmtFilmDeviceNormal: event-group=Eventgroup_Notify_zone5SmtFilmDeviceNormal, sd-client-event-group-timing-config=DefaultSdSubscribeConfig
      someip required event group Eventgroup_Notify_zone5SmtFilmOpacities: event-group=Eventgroup_Notify_zone5SmtFilmOpacities, sd-client-event-group-timing-config=DefaultSdSubscribeConfig
package /ServiceInstance/Someip/Provider
  10 x provided someip service instance, all with sd-server-config=DefaultSdServerConfig:
    Provider_SoaDms: service-interface-deployment=SoaDms, method-response-propss=[Get_soaDmsDeviceNormal, Get_soaDmsStatus, Get_soaDmsDriverStatus, Get_soaDmsSwVersion, SoaDms/SetDmsPower], service-instance-id=4968
      event-propss:
        event=Notify_soaDmsDeviceNormal
        Notify_soaDmsStatus
        Notify_soaDmsDriverStatus
        onDriverNotWatchingFront
        onDriverNotWaken
        onDriverNotFocusing
      7 x someip provided event group, all with multicast-threshold=0, sd-server-event-group-timing-config=DefaultSdPublishConfig:
        Eventgroup_Notify_soaDmsDeviceNormal: event-group=Eventgroup_Notify_soaDmsDeviceNormal
        Eventgroup_Notify_soaDmsDriverStatus: event-group=Eventgroup_Notify_soaDmsDriverStatus
        Eventgroup_Notify_soaDmsStatus: event-group=Eventgroup_Notify_soaDmsStatus
        Eventgroup_Notify_soaDmsSwVersion: event-group=Eventgroup_Notify_soaDmsSwVersion
        Eventgroup_onDriverNotFocusing: event-group=Eventgroup_onDriverNotFocusing
        Eventgroup_onDriverNotWaken: event-group=Eventgroup_onDriverNotWaken
        Eventgroup_onDriverNotWatchingFront: event-group=Eventgroup_onDriverNotWatchingFront
    Provider_SoaDriverSeat: service-interface-deployment=SoaDriverSeat, service-instance-id=4962
      event-propss:
        event=Notification_soaDrvSeatDeviceNormal
        Notify_soaDrvSeatMotorDirection
        Notify_soaDrvSeatMotorPosition
        event=Notify_soaDrvSeatSwVersion
      method-response-propss:
        Get_soaDrvSeatDeviceNormal
        method=Get_soaDrvSeatMotorDirection
        Get_soaDrvSeatMotorPosition
        Get_soaDrvSeatSwVersion
        RequestMoveDrvSeatHeight
        RequestMoveDrvSeatRecline
        RequestMoveDrvSeatSlide
        RequestMoveDrvSeatTilt
      4 x someip provided event group, all with multicast-threshold=0, sd-server-event-group-timing-config=DefaultSdPublishConfig:
        Eventgroup_Notification_soaDrvSeatMotorDirection: event-group=Eventgroup_Notification_soaDrvSeatMotorDirection
        Eventgroup_Notification_soaDrvSeatMotorPosition: event-group=Eventgroup_Notification_soaDrvSeatMotorPosition
        Eventgroup_Notification_soaDrvSeatNormal: event-group=Eventgroup_Notification_soaDrvSeatDeviceNormal
        Eventgroup_Notification_soaDrvSeatSwVersion: event-group=Eventgroup_Notification_soaDrvSeatSwVersion
    Provider_SoaHvac: service-interface-deployment=SoaHvac, service-instance-id=4966
      event-propss:
        event=Notify_soaHvacDeviceNormal
        Notify_soaHvacSetting
        Notify_soaHvacStatus
        Notify_soaHvacTemps
        Notify_soaHvacSwVersion
      method-response-propss:
        method=SoaHvac/SetHvacPower
        SoaHvac/SetAcOnOff
        SoaHvac/SetAutoTemp
        SoaHvac/SetDriverTemp
        SoaHvac/SetPassengerTemp
        SoaHvac/SetBlowingForce
        SoaHvac/SetBlowingDirection
        SoaHvac/SetSync
        SoaHvac/SetAirSource
        SoaHvac/SetForwardDefrostOn
        SoaHvac/SetBackwardDefrostOn
        Get_soaHvacDeviceNormal
        Get_soaHvacSetting
        Get_soaHvacStatus
        Get_soaHvacTemps
        Get_soaHvacSwVersion
      5 x someip provided event group, all with multicast-threshold=0, sd-server-event-group-timing-config=DefaultSdPublishConfig:
        Eventgroup_Notify_soaHvacDeviceNormal: event-group=Eventgroup_Notify_soaHvacDeviceNormal
        Eventgroup_Notify_soaHvacSetting: event-group=Eventgroup_Notify_soaHvacSetting
        Eventgroup_Notify_soaHvacStatus: event-group=Eventgroup_Notify_soaHvacStatus
        Eventgroup_Notify_soaHvacSwVersion: event-group=Eventgroup_Notify_soaHvacSwVersion
        Eventgroup_Notify_soaHvacTemps: event-group=Eventgroup_Notify_soaHvacTemps
    Provider_SoaMlm: service-interface-deployment=SoaMlm, service-instance-id=4961
      event-propss:
        collection-props=udp-collection-trigger=NEVER, event=Notification_soaMlmStatus
        Notify_soaMlmSwVersion
      method-response-propss:
        Get_soaMlmStatus
        method=RequestMlmSetRgbColor
        RequestMlmSetMode
        RequestMlmSetBrightness
        Get_soaMlmSwVersion
      someip provided event group Eventgroup_Notification_soaMlmStatus: event-group=Eventgroup_Notification_soaMlmStatus, multicast-threshold=0, sd-server-event-group-timing-config=DefaultSdPublishConfig
      someip provided event group Eventgroup_Notification_soaMlmSwVersion: event-group=Eventgroup_Notification_soaMlmSwVersion, multicast-threshold=0, sd-server-event-group-timing-config=DefaultSdPublishConfig
    Provider_SoaPower: service-interface-deployment=SoaPower, someip-event-props=Notify_soaPowerDeviceNormal, method-response-propss=[method=Get_soaPowerDeviceNormal, Get_soaPowerSwVersion], service-instance-id=4960
      someip provided event group Eventgroup_Notification_soaPowerDeviceNormal: event-group=Eventgroup_Notification_soaPowerDeviceNormal, multicast-threshold=0, sd-server-event-group-timing-config=DefaultSdPublishConfig
      someip provided event group ProvidedEventgroup1: event-group=Eventgroup_Notify_soaPowerSwVersion, multicast-threshold=0, sd-server-event-group-timing-config=DefaultSdPublishConfig
    Provider_SoaRcurtain: service-interface-deployment=SoaRcurtain, event-propss=[Notification_soaRctnStatus, Notify_soaRctnSwVersion], method-response-propss=[Get_soaRctnStatus, Get_soaRctnSwVersion, RequestRearCurtainOperation, RequestRearCurtainPosition], service-instance-id=4964
      someip provided event group Eventgroup_Notification_soaRctnStatus: event-group=Eventgroup_Notification_soaRctnStatus, multicast-threshold=0, sd-server-event-group-timing-config=DefaultSdPublishConfig
      someip provided event group Eventgroup_Notification_soaRctnSwVersion: event-group=Eventgroup_Notification_soaRctnSwVersion, multicast-threshold=0, sd-server-event-group-timing-config=DefaultSdPublishConfig
    Provider_SoaRoa: service-interface-deployment=SoaRoa, service-instance-id=4963
      event-propss:
        event=Notify_soaRoaDetectCount
        Notify_soaRoaDetectState
        Notify_soaRoaDeviceNormal
        Notify_soaRoaMode
        Notify_soaRoaRunningState
        Notify_soaRoaSensorError
        Notify_soaRoaSwVersion
      method-response-propss:
        Get_soaRoaDetectCount
        Get_soaRoaDetectState
        Get_soaRoaDeviceNormal
        Get_soaRoaMode
        Get_soaRoaRunningState
        Get_soaRoaSensorError
        Get_soaRoaSwVersion
        ResetRoaDetectInfo
        SetRoaMode
        StartRoa
        StopRoa
      7 x someip provided event group, all with multicast-threshold=0, sd-server-event-group-timing-config=DefaultSdPublishConfig:
        Eventgroup_Notification_soaRoaDetectCount: event-group=Eventgroup_Notification_soaRoaDetectCount
        Eventgroup_Notification_soaRoaDetectState: event-group=Eventgroup3_Notification_soaRoaDetectState
        Eventgroup_Notification_soaRoaDeviceNormal: event-group=Eventgroup_Notification_soaRoaDeviceNormal
        Eventgroup_Notification_soaRoaMode: event-group=Eventgroup_Notification_soaRoaMode
        Eventgroup_Notification_soaRoaRunningState: event-group=Eventgroup_Notification_soaRoaRunningState
        Eventgroup_Notification_soaRoaSensorError: event-group=Eventgroup_Notification_soaRoaSensorError
        Eventgroup_Notification_soaRoaSwVersion: event-group=Eventgroup_Notification_soaRoaSwVersion
    Provider_SoaSmartFilm: service-interface-deployment=SoaSmartFilm, event-propss=[event=Notify_soaFilmDeviceNormal, Notify_soaFilmOpacities, Notify_soaFilmAuto, Notify_soaFilmSwVersion], service-instance-id=4967
      method-response-propss:
        Get_soaFilmDeviceNormal
        Get_soaFilmOpacities
        Get_soaFilmAuto
        Get_soaFilmSwVersion
        SoaSmartFilm/SetOpacity
        SetAllOpacities
      4 x someip provided event group, all with multicast-threshold=0, sd-server-event-group-timing-config=DefaultSdPublishConfig:
        Eventgroup_Notify_soaFilmAuto: event-group=Eventgroup_Notify_soaFilmAuto
        Eventgroup_Notify_soaFilmDeviceNormal: event-group=Eventgroup_Notify_soaFilmDeviceNormal
        Eventgroup_Notify_soaFilmOpacities: event-group=Eventgroup_Notify_soaFilmOpacities
        Eventgroup_Notify_soaFilmSwVersion: event-group=Eventgroup_Notify_soaFilmSwVersion
    Provider_SoaVehicleInfo: service-interface-deployment=SoaVehicleInfo, someip-event-props=event=Notify_soaVehicleInfo, someip-method-props=Get_soaVehicleInfo, service-instance-id=4969
      someip provided event group Eventgroup_onVehicleInfo: event-group=Eventgroup_Notification_soaVehicleInfo, multicast-threshold=0, sd-server-event-group-timing-config=DefaultSdPublishConfig
    Provider_SoaWiper: service-interface-deployment=SoaWiper, event-propss=[Notify_soaWiperDeviceNormal, Notify_soaWiperStatus, Notify_soaWiperSwVersion], service-instance-id=4965
      method-response-propss:
        Get_soaWiperDeviceNormal
        Get_soaWiperStatus
        Get_soaWiperSwVersion
        RequestWiperOperation
        SetWiperAutoSpeed
      someip provided event group Eventgroup_Notification_soaWiperDeviceNormal: event-group=Eventgroup_Notification_soaWiperDeviceNormal, multicast-threshold=0, sd-server-event-group-timing-config=DefaultSdPublishConfig
      someip provided event group Eventgroup_Notification_soaWiperStatus: event-group=Eventgroup_Notification_soaWiperStatus, multicast-threshold=0, sd-server-event-group-timing-config=DefaultSdPublishConfig
      someip provided event group Eventgroup_Notification_soaWiperSwVersion: event-group=Eventgroup_Notification_soaWiperSwVersion, multicast-threshold=0, sd-server-event-group-timing-config=DefaultSdPublishConfig
package /ServiceInterface
  28 x service interface:
    SoaDms: category=COMMUNICATION_GROUP, major-version=1
      namespaces:
        symbol props eevp
        symbol props control
      events:
        data onDriverNotFocusing: type=bool
        data onDriverNotWaken: type=bool
        data onDriverNotWatchingFront: type=bool
      4 x field, all with has-getter=true, has-notifier=true, has-setter=false:
        soaDmsDeviceNormal: type=SoaDeviceIsNormal
        soaDmsDriverStatus: type=soaDmsDriverStatus
        soaDmsStatus: type=SoaDmsStatus
        soaDmsSwVersion: type=uint8_t
      methods:
        operation SetDmsPower: fire-and-forget=true
          arg on: type=bool, direction=IN
    SoaDriverSeat: category=COMMUNICATION_GROUP, major-version=1, minor-version=0
      namespaces:
        symbol props eevp
        symbol props control
      4 x field, all with has-getter=true, has-notifier=true, has-setter=false:
        soaDrvSeatDeviceNormal: type=SoaDeviceIsNormal
        soaDrvSeatMotorDirection: type=SoaSeatMotorDirection
        soaDrvSeatMotorPosition: type=SoaSeatMotorPosition
        soaDrvSeatSwVersion: type=uint8_t
      methods:
        4 x operation, all with fire-and-forget=true:
          RequestMoveDrvSeatHeight
            arg dir: type=SoaSeatHeightDirection, direction=IN
          RequestMoveDrvSeatRecline
            arg dir: type=SoaSeatReclineDirection, direction=IN
          RequestMoveDrvSeatSlide
            arg dir: type=SoaSeatSlideDirection, direction=IN
          RequestMoveDrvSeatTilt
            arg dir: type=SoaSeatTiltDirection, direction=IN
    SoaHvac: category=COMMUNICATION_GROUP, major-version=1
      namespaces:
        symbol props eevp
        symbol props control
      5 x field, all with has-getter=true, has-notifier=true, has-setter=false:
        SoaHvacSwVersion: type=uint8_t
        soaHvacDeviceNormal: type=SoaDeviceIsNormal
        soaHvacSetting: type=SoaHvacStatus
        soaHvacStatus: type=SoaHvacStatus
        soaHvacTemps: type=SoaHvacTemps
      methods:
        11 x operation, all with fire-and-forget=true:
          SetAcOnOff
            arg on: type=bool, direction=IN
          SetAirSource
            arg src: type=SoaHvacAirSource, direction=IN
          SetAutoTemp
            arg on: type=bool, direction=IN
          SetBackwardDefrostOn
            arg on: type=bool, direction=IN
          SetBlowingDirection
            arg dir: type=SoaHvacBlowDir, direction=IN
          SetBlowingForce
            arg force: type=uint8_t, direction=IN
          SetDriverTemp
            arg temperature: type=int8_t, direction=IN
          SetForwardDefrostOn
            arg on: type=bool, direction=IN
          SetHvacPower
            arg on: type=bool, direction=IN
          SetPassengerTemp
            arg temperature: type=int8_t, direction=IN
          SetSync
            arg on: type=bool, direction=IN
    SoaMlm: category=COMMUNICATION_GROUP, major-version=1, minor-version=0
      namespaces:
        symbol props eevp
        symbol props control
      field soaMlmStatus: type=SoaMlmStatus, has-getter=true, has-notifier=true, has-setter=false
      field soaMlmSwVersion: type=uint8_t, has-getter=true, has-notifier=true, has-setter=false
      methods:
        operation RequestMlmSetBrightness: fire-and-forget=true
          arg brightness: type=uint16_t, direction=IN
        operation RequestMlmSetMode: fire-and-forget=true
          arg mood: type=SoaMlmMoodMode, direction=IN
        operation RequestMlmSetRgbColor: fire-and-forget=true
          arg colorTableIndex: type=uint8_t, direction=IN
    SoaPower: category=COMMUNICATION_GROUP, major-version=1, minor-version=0
      namespaces:
        symbol props eevp
        symbol props control
      field soaPowerDeviceNormal: type=SoaDeviceIsNormal, has-getter=true, has-notifier=true, has-setter=false
      field soaPowerSwVersion: type=uint8_t, has-getter=true, has-notifier=true, has-setter=false
    SoaRcurtain: category=COMMUNICATION_GROUP, major-version=1, minor-version=0
      namespaces:
        symbol props eevp
        symbol props control
      field soaRctnStatus: type=SoaRctnStatus, has-getter=true, has-notifier=true, has-setter=false
      field soaRctnSwVersion: type=uint8_t, has-getter=true, has-notifier=true, has-setter=false
      methods:
        operation RequestRearCurtainOperation: fire-and-forget=false
          arg motorDir: type=SoaRctnMotorDir, direction=IN
          arg err: type=SoaErrorState, direction=OUT
        operation RequestRearCurtainPosition: fire-and-forget=true
          arg posPercentage: type=uint8_t, direction=IN
    SoaRoa: category=COMMUNICATION_GROUP, major-version=1, minor-version=0
      namespaces:
        symbol props eevp
        symbol props control
      7 x field, all with has-getter=true, has-notifier=true, has-setter=false:
        soaRoaDetectCount: type=uint8_t
        soaRoaDetectState: type=SoaRoaDetectState
        soaRoaDeviceNormal: type=SoaDeviceIsNormal
        soaRoaMode: type=SoaRoaMode
        soaRoaRunningState: type=SoaRoaRunningState
        soaRoaSensorError: type=SoaRoaSensorError
        soaRoaSwVersion: type=uint8_t
      methods:
        4 x operation, all with fire-and-forget=true:
          ResetRoaDetectInfo
          SetRoaMode
            arg mode: type=SoaRoaMode, direction=IN
          StartRoa
          StopRoa
    SoaSmartFilm: category=COMMUNICATION_GROUP, major-version=1
      namespaces:
        symbol props eevp
        symbol props control
      4 x field, all with has-getter=true, has-notifier=true, has-setter=false:
        soaFilmAuto: type=bool
        soaFilmDeviceNormal: type=SoaDeviceIsNormal
        soaFilmOpacities: type=SoaFilmOpacityArray
        soaFilmSwVersion: type=uint8_t
      methods:
        operation SetAllOpacities: fire-and-forget=true
          arg opacity: type=uint8_t, direction=IN
        operation SetAuto: fire-and-forget=true
          arg on: type=bool, direction=IN
        operation SetOpacity: fire-and-forget=true
          arg pos: type=SoaFilmPos, direction=IN
          arg opacity: type=uint8_t, direction=IN
    SoaVehicleInfo: major-version=1, minor-version=0
      namespaces:
        symbol props eevp
        symbol props control
      field soaVehicleInfo: type=VehicleInfo, has-getter=true, has-notifier=true, has-setter=false
    SoaWiper: category=COMMUNICATION_GROUP, major-version=1, minor-version=0
      namespaces:
        symbol props eevp
        symbol props control
      field soaWiperDeviceNormal: type=SoaDeviceIsNormal, has-getter=true, has-notifier=true, has-setter=false
      field soaWiperStatus: type=SoaWiperStatus, has-getter=true, has-notifier=true, has-setter=false
      field soaWiperSwVersion: type=uint8_t, has-getter=true, has-notifier=true, has-setter=false
      methods:
        operation RequestWiperOperation: fire-and-forget=true
          arg mode: type=SoaWiperMode, direction=IN
        operation SetWiperAutoSpeed: fire-and-forget=true
          arg isAutoSpeed: type=bool, direction=IN
    Zone1DrvSeat
      namespaces:
        symbol props zone1
        symbol props drvseat
        symbol props control
      field zone1DrvSeatMotorDir: type=EcuDrvSeatMotorDirection, has-getter=true, has-notifier=true, has-setter=false
      field zone1DrvSeatMotorPos: type=EcuDrvseatMotorPosition, has-getter=true, has-notifier=true, has-setter=false
      methods:
        operation controlMotor: fire-and-forget=true
          arg inst: type=EcuDrvSeatMotorInst, direction=IN
    Zone1MfswInput: major-version=1, minor-version=0
      namespaces:
        symbol props zone1
        symbol props mfsw
        symbol props input
      events:
        data onMfswInput: type=ZoneByteVectorType
    Zone1Mlm
      namespaces:
        symbol props zone1
        symbol props mlm
        symbol props control
      field zone1MlmStatus: type=EcuMlmState, has-getter=true, has-notifier=true, has-setter=false
      methods:
        operation setMlmBrightness: fire-and-forget=true
          arg brightness: type=uint8_t, direction=IN
        operation setMlmColor: fire-and-forget=true
          arg colorIndex: type=uint8_t, direction=IN
    Zone1Power
      namespaces:
        symbol props zone1
        symbol props power
        symbol props control
      field zone1Current: type=EcuZ1PowerCurrent, has-getter=true, has-notifier=true, has-setter=false
      field zone1PowerState: type=EcuZ1PowerState, has-getter=true, has-notifier=true, has-setter=false
      methods:
        operation controlDrvseatPower: fire-and-forget=false
          arg turnon: type=bool, direction=IN
          arg error: type=uint8_t, direction=OUT
        operation controlMfswPower: fire-and-forget=false
          arg turnon: type=bool, direction=IN
          arg error: type=uint8_t, direction=OUT
        operation controlMlmPower: fire-and-forget=false
          arg turnon: type=bool, direction=IN
          arg error: type=uint8_t, direction=OUT
    Zone1RsvA
      namespaces:
        symbol props zone1
        symbol props reserved
        symbol props a
      field zone1DeviceNormal: type=uint8_t, has-getter=true, has-notifier=true, has-setter=false
    Zone2Power
      namespaces:
        symbol props zone2
        symbol props power
        symbol props control
      field zone2Current: type=EcuZ2PowerCurrent, has-getter=true, has-notifier=true, has-setter=false
      field zone2PowerState: type=EcuZ2PowerState, has-getter=true, has-notifier=true, has-setter=false
      methods:
        operation controlRainSnsrPower: fire-and-forget=false
          arg turnon: type=bool, direction=IN
          arg error: type=uint8_t, direction=OUT
        operation controlRoaPower: fire-and-forget=false
          arg turnon: type=bool, direction=IN
          arg error: type=uint8_t, direction=OUT
    Zone2Roa
      namespaces:
        symbol props zone2
        symbol props roa
        symbol props control
      field zone2RoaSnsrStatus: type=EcmRoaSnsrStatus, has-getter=true, has-notifier=true, has-setter=false
      methods:
        operation controlRoa: fire-and-forget=true
          arg snsrRunReq: type=uint8_t, direction=IN
    Zone2RsvA
      namespaces:
        symbol props zone2
        symbol props reserved
        symbol props a
      field zone2DeviceNormal: type=uint8_t, has-getter=true, has-notifier=true, has-setter=false
    Zone3Power
      namespaces:
        symbol props zone3
        symbol props power
        symbol props control
      field zone3Current: type=EcuZ3PowerCurrent, has-getter=true, has-notifier=true, has-setter=false
      field zone3PowerState: type=EcuZ3PowerState, has-getter=true, has-notifier=true, has-setter=false
      methods:
        operation controlRcurtPower: fire-and-forget=false
          arg turnon: type=bool, direction=IN
          arg error: type=uint8_t, direction=OUT
        operation controlRpdwPower: fire-and-forget=false
          arg turnon: type=bool, direction=IN
          arg error: type=uint8_t, direction=OUT
    Zone3Rcurtain
      namespaces:
        symbol props zone3
        symbol props rcurtain
        symbol props control
      field zone3RcurtainStatus: type=EcuRcurtainStatus, has-getter=true, has-notifier=true, has-setter=false
      methods:
        operation controlRcurtain: fire-and-forget=true
          arg motorPos: type=uint8_t, direction=IN
    Zone3RsvA
      namespaces:
        symbol props zone3
        symbol props reserved
        symbol props a
      field zone3DeviceNormal: type=uint8_t, has-getter=true, has-notifier=true, has-setter=false
    Zone4Power
      namespaces:
        symbol props zone4
        symbol props power
        symbol props control
      field zone4Current: type=EcuZ4PowerCurrent, has-getter=true, has-notifier=true, has-setter=false
      field zone4PowerState: type=EcuZ4PowerState, has-getter=true, has-notifier=true, has-setter=false
      methods:
        operation controlFpdwPower: fire-and-forget=false
          arg turnon: type=bool, direction=IN
          arg error: type=uint8_t, direction=OUT
        operation controlWiperPower: fire-and-forget=false
          arg turnon: type=bool, direction=IN
          arg error: type=uint8_t, direction=OUT
    Zone4RsvA
      namespaces:
        symbol props zone4
        symbol props reserved
        symbol props a
      field zone4DeviceNormal: type=uint8_t, has-getter=true, has-notifier=true, has-setter=false
    Zone4Wiper
      namespaces:
        symbol props zone4
        symbol props wiper
        symbol props control
      field zone4WiperOpStatus: type=EcuWiperOperationStatus, has-getter=true, has-notifier=true, has-setter=false
      methods:
        operation controlWiper: fire-and-forget=true
          arg mode: type=uint8_t, direction=IN
    Zone5Dms: major-version=1, minor-version=0
      namespaces:
        symbol props zone5
        symbol props dms
        symbol props control
      field zone5DmsDeviceNormal: type=uint8_t, has-getter=true, has-notifier=true, has-setter=false
      field zone5DmsDriverStatus: type=EcuZ5DmsDriverStatus, has-getter=true, has-notifier=true, has-setter=false
      field zone5DmsStatus: type=EcuZ5DmsStatus, has-getter=true, has-notifier=true, has-setter=false
      methods:
        operation SetDmsPower: fire-and-forget=true
          arg on: type=uint8_t, direction=IN
    Zone5Hvac: major-version=1, minor-version=0
      namespaces:
        symbol props zone5
        symbol props hvac
        symbol props control
      4 x field, all with has-getter=true, has-notifier=true, has-setter=false:
        zone5HvacDeviceNormal: type=uint8_t
        zone5HvacSetting: type=EcuZ5HvacStatus
        zone5HvacStatus: type=EcuZ5HvacStatus
        zone5HvacTemps: type=EcuZ5HvacTemps
      methods:
        11 x operation, all with fire-and-forget=true:
          SetAcOnOff
            arg on: type=uint8_t, direction=IN
          SetAirSource
            arg src: type=uint8_t, direction=IN
          SetAutoTemp
            arg on: type=uint8_t, direction=IN
          SetBackwardDefrostOn
            arg on: type=uint8_t, direction=IN
          SetBlowingDirection
            arg dir: type=uint8_t, direction=IN
          SetBlowingForce
            arg force: type=uint8_t, direction=IN
          SetDriverTemp
            arg temporature: type=int8_t, direction=IN
          SetForwardDefrostOn
            arg on: type=uint8_t, direction=IN
          SetHvacPower
            arg on: type=uint8_t, direction=IN
          SetPassengerTemp
            arg temporature: type=int8_t, direction=IN
          SetSync
            arg on: type=bool, direction=IN
    Zone5Power: major-version=1, minor-version=0
      namespaces:
        symbol props zone5
        symbol props power
        symbol props control
      field zone5PowerDeviceNormal: type=uint8_t, has-getter=true, has-notifier=true, has-setter=false
    Zone5SmtFilm: major-version=1, minor-version=0
      namespaces:
        symbol props zone5
        symbol props smtfilm
        symbol props control
      field zone5SmtFilmDeviceNormal: type=uint8_t, has-getter=true, has-notifier=true, has-setter=false
      field zone5SmtFilmOpacities: type=SoaFilmOpacityArray, has-getter=true, has-notifier=true, has-setter=false
      methods:
        operation SetAllOpacity: fire-and-forget=true
          arg opacity: type=uint8_t, direction=IN
        operation SetOpacity: fire-and-forget=true
          arg pos: type=uint8_t, direction=IN
          arg opacity: type=uint8_t, direction=IN
