AUTOSAR XML (schema 00049)
package /ServiceDeployment/Someip
  someip service interface deployment Zone_VehicleInfo_Input: service-interface=Zone_VehicleInfo_Input, service-interface-id=5440, service-interface-version={major-version=1, minor-version=0}
    someip event deployment VehicleInfo: event=VehicleInfo, event-id=12916, serializer=SOMEIP, transport-protocol=UDP
    someip event group Eventgroup_VehicleInfo: event-group-id=1004, event=VehicleInfo
package /ServiceInstance/Someip/Consumer
  required someip service instance EEVP_PDW_Consumer_VehicleInfo: service-interface-deployment=Zone_VehicleInfo_Input, required-service-instance-id=ANY, sd-client-config=DefaultSdClientConfig
    someip required event group Eventgroup_VehicleInfo: event-group=Eventgroup_VehicleInfo, sd-client-event-group-timing-config=DefaultSdSubscribeConfig
package /ServiceInstance/Someip/Provider
  provided someip service instance Zone_VehicleInfo_Provider_VehicleInfo_Input: service-interface-deployment=Zone_VehicleInfo_Input, someip-event-props=VehicleInfo, sd-server-config=DefaultSdServerConfig, service-instance-id=1
    someip provided event group Eventgroup_VehicleInfo: event-group=Eventgroup_VehicleInfo, multicast-threshold=0
package /ServiceInterface
  service interface Zone_VehicleInfo_Input: major-version=1, minor-version=0
    namespaces:
      symbol props zone
      symbol props input
      symbol props service
    events:
      data VehicleInfo: type=ZoneByteVectorType
