AUTOSAR XML (schema 00049)
package /Machine
  machine EEVP_Main_Machine: machine-design=EEVP_MAIN, trusted-platform-executable-launch-behavior=NO-TRUSTED-PLATFORM-SUPPORT
    module-instantiations:
      log and trace instantiation LOG: dlt-ecu-id=EEVP
        6 x dlt log channel, all with log-trace-default-log-level=ERROR, log-trace-log-modes=[CONSOLE, FILE, NETWORK]:
          CM: application-id=CM, context-id=CM, log-trace-file-path=var/logs/CM
          EM: application-id=EM, context-id=EM, log-trace-file-path=var/logs/EM
          PHM: application-id=PHM, context-id=PHM, log-trace-file-path=var/logs/PHM
          SM: application-id=SM, context-id=SM, log-trace-file-path=var/logs/SM
          UCM: application-id=UCM, context-id=UCM, log-trace-file-path=var/logs/UCM
          VUCM: application-id=VUCM, context-id=VUCM, log-trace-file-path=var/logs/VUCM
      os module instantiation POSIX
        resource group DefaultResourceGroup
      ucm module instantiation UCM: identifier=EEVP_UCM
    processor S32G2
      4 x processor core:
        Core{0..3}: core-id={0..3}
package /Machine/FunctionGroup
  function group set EEVP_Main_FunctionGroup
    function-groups:
      mode declaration group prototype MachineFG: type=MachineState
package /Machine/PlatformHealth
  platform health management contribution EEVP_Main_PHM
  phm contribution to machine mapping EEVP_Main_PhmContributionToMachineMapping: machine=EEVP_Main_Machine, phm-contribution=EEVP_Main_PHM
package /Machine/ProcessToMachine
  process to machine mapping set EEVP_Main_ProcessToMachineMapping
    6 x process to machine mapping, all with machine=EEVP_Main_Machine:
      ProcessToMachineMapping_CM_TO_EEVP_Machine_TO_UnknownModule: process=CM
      ProcessToMachineMapping_EM_TO_EEVP_Machine_TO_UnknownModule: process=EM
      ProcessToMachineMapping_PHM_TO_EEVP_Machine_TO_UnknownModule: process=PHM
      ProcessToMachineMapping_SM_TO_EEVP_Machine_TO_UnknownModule: process=SM
      ProcessToMachineMapping_UCM_TO_EEVP_Machine_TO_UnknownModule: process=UCM
      ProcessToMachineMapping_VUCM_TO_EEVP_Machine_TO_UnknownModule: process=VUCM
package /StateMachine
  mode declaration group MachineState: initial-mode=Off
    5 x mode:
      Off
      Restart
      Shutdown
      Startup
      Verify
  mode declaration group ProcessState: initial-mode=Idle
    4 x mode:
      Idle
      Running
      Starting
      Terminated
