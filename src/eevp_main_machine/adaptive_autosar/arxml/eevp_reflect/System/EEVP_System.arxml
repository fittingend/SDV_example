AUTOSAR XML (schema 00049)
package /System
  system System: category=SYSTEM_DESCRIPTION, system-version=1.0.0;EEVP
    root-software-compositions:
      root sw composition prototype System: software-composition=System
package /System/CommunicationCluster
  ethernet cluster EEVP_EthernetCluster
    ethernet physical channel PhysicalChannel: category=WIRED, comm-connectors=[EEVP_MAIN/eth0, EEVP_IVI/eth0, EEVP_ADAS/eth0]
      4 x network endpoint:
        EEVP_ADAS_Endpoint: network-endpoint-addresses=ipv-4-configuration={default-gateway=10.100.1.1, ipv-4-address=10.100.1.101, ipv-4-address-source=FIXED, network-mask=255.255.0.0}
        EEVP_AP_Endpoint: network-endpoint-addresses=ipv-4-configuration={default-gateway=10.100.0.1, ipv-4-address=10.100.0.40, ipv-4-address-source=FIXED, network-mask=255.255.0.0}
        EEVP_IVI_Endpoint: network-endpoint-addresses=ipv-4-configuration={default-gateway=10.100.0.1, ipv-4-address=10.100.0.20, ipv-4-address-source=FIXED, network-mask=255.255.0.0}
        SOMEIP_SD_Endpoint: network-endpoint-addresses=ipv-4-configuration={ipv-4-address=224.224.24.245, ipv-4-address-source=FIXED}
package /System/CryptoService
  crypto service certificate ParaCertificate: algorithm-family=RSA, format=X-509
package /System/Ecu
  machine design EEVP_ADAS: service-discover-configs=someip-service-discovery={multicast-sd-ip-address=SOMEIP_SD_Endpoint, someip-service-discovery-port=30490}
    ethernet communication connector eth0: unicast-network-endpoint=EEVP_ADAS_Endpoint
  machine design EEVP_IVI: service-discover-configs=someip-service-discovery={multicast-sd-ip-address=SOMEIP_SD_Endpoint, someip-service-discovery-port=30490}
    ethernet communication connector eth0: unicast-network-endpoint=EEVP_IVI_Endpoint
  machine design EEVP_MAIN: service-discover-configs=someip-service-discovery={multicast-sd-ip-address=SOMEIP_SD_Endpoint, someip-service-discovery-port=30490}
    user defined communication connector IPC
    ethernet communication connector eth0: unicast-network-endpoint=EEVP_AP_Endpoint
package /System/SwComponent
  composition sw component type EEVP_ADAS
  composition sw component type EEVP_IVI
  composition sw component type EEVP_MAIN
  composition sw component type System
    component EEVP_ADAS: type=EEVP_ADAS
    component EEVP_IVI: type=EEVP_IVI
    component EEVP_MAIN: type=EEVP_MAIN
