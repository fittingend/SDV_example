AUTOSAR XML (schema 00049)
package /ServiceDeployment/Someip
  someip service interface deployment BmsInfo: service-interface=BmsInfoSrv, service-interface-id=11, service-interface-version={major-version=1, minor-version=0}
    someip event deployment ems_BmsInfo: event=ems_BmsInfo, event-id=1, transport-protocol=UDP
    someip event group BmsInfoGr: event-group-id=1, event=ems_BmsInfo
package /ServiceInstance/Endpoint
  4 x someip service instance to machine mapping, all with communication-connector=eth0:
    EEVP_BatteryMonitor_SomeipConsumers_BmsInfo: service-instance=EEVP_BatteryMonitor_Consumer_BmsInfo, tcp-port=40201, udp-port=40201
    EEVP_BatteryMonitor_SomeipConsumers_SoaMlm: service-instance=EEVP_BatteryMonitor_Consumer_SoaMlm, tcp-port=40202, udp-port=40202
    EEVP_BatteryMonitor_SomeipConsumers_SubscriptionManagement: service-instance=EEVP_BatteryMonitor_Consumer_SubscriptionManagement, tcp-port=40203, udp-port=40203
    EEVP_BatteryMonitor_SomeipProviders_BmsInfo: service-instance=Provider_BmsInfo, tcp-port=40200, udp-port=40200
package /ServiceInstance/Someip/Consumer
  required someip service instance EEVP_BatteryMonitor_Consumer_BmsInfo: service-interface-deployment=BmsInfo, required-minor-version=ANY, required-service-instance-id=ANY, sd-client-config=DefaultClientConfig, version-driven-find-behavior=EXACT-OR-ANY-MINOR-VERSION
    someip required event group BmsInfoGr: event-group=BmsInfoGr, sd-client-event-group-timing-config=DefaultSdSubscribeConfig
  required someip service instance EEVP_BatteryMonitor_Consumer_SoaMlm: service-interface-deployment=SoaMlm, method-request-propss=[Get_soaMlmStatus, Get_soaMlmSwVersion, RequestMlmSetBrightness, RequestMlmSetRgbColor], required-minor-version=ANY, required-service-instance-id=ANY, sd-client-config=DefaultClientConfig, version-driven-find-behavior=EXACT-OR-ANY-MINOR-VERSION
    someip required event group Eventgroup_Notification_soaMlmStatus: event-group=Eventgroup_Notification_soaMlmStatus, sd-client-event-group-timing-config=DefaultSdSubscribeConfig
    someip required event group Eventgroup_Notification_soaMlmSwVersion: event-group=Eventgroup_Notification_soaMlmSwVersion, sd-client-event-group-timing-config=DefaultSdSubscribeConfig
  required someip service instance EEVP_BatteryMonitor_Consumer_SubscriptionManagement: service-interface-deployment=SubscriptionManagement, someip-method-props=registerSubscriptionApp, required-minor-version=ANY, required-service-instance-id=ANY, sd-client-config=DefaultClientConfig, version-driven-find-behavior=EXACT-OR-ANY-MINOR-VERSION
    someip required event group Eventgroup_notifySubscriptionEvent: event-group=Eventgroup_notifySubscriptionEvent, sd-client-event-group-timing-config=DefaultSdSubscribeConfig
package /ServiceInstance/Someip/Provider
  provided someip service instance Provider_BmsInfo: service-interface-deployment=BmsInfo, someip-event-props=ems_BmsInfo, sd-server-config=DefaultSdServerConfig, service-instance-id=1
    someip provided event group BmsInfoGr: event-group=BmsInfoGr, multicast-threshold=0, sd-server-event-group-timing-config=DefaultSdPublishConfig
package /ServiceInterface
  service interface BmsInfoSrv
    namespaces:
      symbol props eevp
      symbol props bmsinfosrv
    events:
      data ems_BmsInfo: type=Struct_BmsInfo
