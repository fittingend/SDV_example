AUTOSAR XML (schema 00049)
package /ServiceInstance/Endpoint
  someip service instance to machine mapping EEVP_IntelligentWiper_SomeipConsumers_SubscriptionManagement: communication-connector=eth0, service-instance=EEVP_IntelligentWiper_Consumer_SubscriptionManagement, tcp-port=40012, udp-port=40012
  someip service instance to machine mapping EEVP_IntelligentWiper_SomeipConsumers_VehicleInfo: communication-connector=eth0, service-instance=EEVP_IntelligentWiper_Consumer_SoaVehicleInfo, tcp-port=40010, udp-port=40010
  someip service instance to machine mapping EEVP_IntelligentWiper_SomeipConsumers_Wiper: communication-connector=eth0, service-instance=EEVP_IntelligentWiper_Consumer_SoaWiper, tcp-port=40011, udp-port=40011
package /ServiceInstance/Someip/Consumer
  required someip service instance EEVP_IntelligentWiper_Consumer_SoaVehicleInfo: service-interface-deployment=SoaVehicleInfo, someip-method-props=Get_soaVehicleInfo, required-minor-version=ANY, required-service-instance-id=ANY, sd-client-config=DefaultClientConfig, version-driven-find-behavior=EXACT-OR-ANY-MINOR-VERSION
    someip required event group Eventgroup_Notification_soaVehicleInfo: event-group=Eventgroup_Notification_soaVehicleInfo, sd-client-event-group-timing-config=DefaultSdSubscribeConfig
  required someip service instance EEVP_IntelligentWiper_Consumer_SoaWiper: service-interface-deployment=SoaWiper, required-minor-version=ANY, required-service-instance-id=ANY, sd-client-config=DefaultClientConfig, version-driven-find-behavior=EXACT-OR-ANY-MINOR-VERSION
    method-request-propss:
      method=Get_soaWiperDeviceNormal
      Get_soaWiperStatus
      Get_soaWiperSwVersion
      RequestWiperOperation
      SetWiperAutoSpeed
    someip required event group Eventgroup_Notification_soaWiperDeviceNormal: event-group=Eventgroup_Notification_soaWiperDeviceNormal, sd-client-event-group-timing-config=DefaultSdSubscribeConfig
    someip required event group Eventgroup_Notification_soaWiperStatus: event-group=Eventgroup_Notification_soaWiperStatus, sd-client-event-group-timing-config=DefaultSdSubscribeConfig
    someip required event group Eventgroup_Notification_soaWiperSwVersion: event-group=Eventgroup_Notification_soaWiperSwVersion, sd-client-event-group-timing-config=DefaultSdSubscribeConfig
  required someip service instance EEVP_IntelligentWiper_Consumer_SubscriptionManagement: service-interface-deployment=SubscriptionManagement, someip-method-props=registerSubscriptionApp, required-minor-version=ANY, required-service-instance-id=ANY, sd-client-config=DefaultClientConfig, version-driven-find-behavior=EXACT-OR-ANY-MINOR-VERSION
    someip required event group Eventgroup_notifySubscriptionEvent: event-group=Eventgroup_notifySubscriptionEvent, sd-client-event-group-timing-config=DefaultSdSubscribeConfig
