AUTOSAR XML (schema 00049)
package /ServiceInstance/Endpoint
  5 x someip service instance to machine mapping, all with communication-connector=eth0:
    EEVP_IntelligentWiper_SomeipConsumers_PdwFrontService: service-instance=EEVP_IntelligentWiper_Consumer_PdwFrontService, tcp-port=40013, udp-port=40013
    EEVP_IntelligentWiper_SomeipConsumers_PdwRearService: service-instance=EEVP_IntelligentWiper_Consumer_PdwRearService, tcp-port=40014, udp-port=40014
    EEVP_IntelligentWiper_SomeipConsumers_SubscriptionManagement: service-instance=EEVP_IntelligentWiper_Consumer_SubscriptionManagement, tcp-port=40012, udp-port=40012
    EEVP_IntelligentWiper_SomeipConsumers_VehicleInfo: service-instance=EEVP_IntelligentWiper_Consumer_SoaVehicleInfo, tcp-port=40010, udp-port=40010
    EEVP_IntelligentWiper_SomeipConsumers_Wiper: service-instance=EEVP_IntelligentWiper_Consumer_SoaWiper, tcp-port=40011, udp-port=40011
package /ServiceInstance/Someip/Consumer
  5 x required someip service instance, all with required-minor-version=ANY, required-service-instance-id=ANY, sd-client-config=DefaultClientConfig, version-driven-find-behavior=EXACT-OR-ANY-MINOR-VERSION:
    EEVP_IntelligentWiper_Consumer_PdwFrontService: service-interface-deployment=Main_PDW_Service, someip-method-props=Getter
      someip required event group Eventgroup_DistanceLevel: event-group=Eventgroup_DistanceLevel, sd-client-event-group-timing-config=DefaultSdSubscribeConfig
      someip required event group Eventgroup_UssStatus: event-group=Eventgroup_UssStatus, sd-client-event-group-timing-config=DefaultSdSubscribeConfig
    EEVP_IntelligentWiper_Consumer_PdwRearService: service-interface-deployment=Main_PDW_Service, someip-method-props=Getter
      someip required event group Eventgroup_DistanceLevel: event-group=Eventgroup_DistanceLevel, sd-client-event-group-timing-config=DefaultSdSubscribeConfig
      someip required event group Eventgroup_UssStatus: event-group=Eventgroup_UssStatus, sd-client-event-group-timing-config=DefaultSdSubscribeConfig
    EEVP_IntelligentWiper_Consumer_SoaVehicleInfo: service-interface-deployment=SoaVehicleInfo, someip-method-props=Get_soaVehicleInfo
      someip required event group Eventgroup_Notification_soaVehicleInfo: event-group=Eventgroup_Notification_soaVehicleInfo, sd-client-event-group-timing-config=DefaultSdSubscribeConfig
    EEVP_IntelligentWiper_Consumer_SoaWiper: service-interface-deployment=SoaWiper
      method-request-propss:
        method=Get_soaWiperDeviceNormal
        Get_soaWiperStatus
        Get_soaWiperSwVersion
        RequestWiperOperation
        SetWiperAutoSpeed
      someip required event group Eventgroup_Notification_soaWiperDeviceNormal: event-group=Eventgroup_Notification_soaWiperDeviceNormal, sd-client-event-group-timing-config=DefaultSdSubscribeConfig
      someip required event group Eventgroup_Notification_soaWiperStatus: event-group=Eventgroup_Notification_soaWiperStatus, sd-client-event-group-timing-config=DefaultSdSubscribeConfig
      someip required event group Eventgroup_Notification_soaWiperSwVersion: event-group=Eventgroup_Notification_soaWiperSwVersion, sd-client-event-group-timing-config=DefaultSdSubscribeConfig
    EEVP_IntelligentWiper_Consumer_SubscriptionManagement: service-interface-deployment=SubscriptionManagement, someip-method-props=registerSubscriptionApp
      someip required event group Eventgroup_notifySubscriptionEvent: event-group=Eventgroup_notifySubscriptionEvent, sd-client-event-group-timing-config=DefaultSdSubscribeConfig
