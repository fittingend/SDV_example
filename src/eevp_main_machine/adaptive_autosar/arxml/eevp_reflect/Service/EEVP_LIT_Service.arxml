AUTOSAR XML (schema 00049)
package /ServiceInstance/Endpoint
  5 x someip service instance to machine mapping, all with communication-connector=eth0:
    EEVP_LIT_SomeipConsumers_DMS: service-instance=EEVP_LIT_Consumer_DMS, tcp-port=40100, udp-port=40100
    EEVP_LIT_SomeipConsumers_PDW: service-instance=EEVP_LIT_Consumer_PDW, tcp-port=40101, udp-port=40101
    EEVP_LIT_SomeipConsumers_SmartFilm: service-instance=EEVP_LIT_Consumer_SmartFilm, tcp-port=40102, udp-port=40102
    EEVP_LIT_SomeipConsumers_SubscriptionManagement: service-instance=EEVP_LIT_Consumer_SubscriptionManagement, tcp-port=40103, udp-port=40103
    EEVP_LIT_SomeipConsumers_VehicleInfo: service-instance=EEVP_LIT_Consumer_VehicleInfo, tcp-port=40104, udp-port=40104
package /ServiceInstance/Someip/Consumer
  5 x required someip service instance:
    EEVP_LIT_Consumer_DMS: service-interface-deployment=SoaDms, method-request-propss=[Get_soaDmsDeviceNormal, method=Get_soaDmsDriverStatus, method=Get_soaDmsStatus], required-minor-version=ANY, required-service-instance-id=ANY, sd-client-config=DefaultSdClientConfig, version-driven-find-behavior=EXACT-OR-ANY-MINOR-VERSION
      someip required event group Eventgroup_Notification_soaDmsDeviceNormal: event-group=Eventgroup_Notify_soaDmsDeviceNormal, sd-client-event-group-timing-config=DefaultSdSubscribeConfig
      someip required event group Eventgroup_Notification_soaDmsDriverStatus: event-group=Eventgroup_Notify_soaDmsDriverStatus, sd-client-event-group-timing-config=DefaultSdSubscribeConfig
      someip required event group Eventgroup_Notification_soaDmsStatus: event-group=Eventgroup_Notify_soaDmsStatus, sd-client-event-group-timing-config=DefaultSdSubscribeConfig
    EEVP_LIT_Consumer_PDW: service-interface-deployment=Main_PDW_Service, sd-client-config=DefaultSdClientConfig
      someip required event group Eventgroup_Notification_PDWDistance: event-group=Eventgroup_DistanceLevel, sd-client-event-group-timing-config=DefaultSdSubscribeConfig
    EEVP_LIT_Consumer_SmartFilm: service-interface-deployment=SoaSmartFilm, method-request-propss=[Get_soaFilmAuto, Get_soaFilmDeviceNormal, Get_soaFilmOpacities, SetAllOpacities, SetAuto, SetOpacity], required-minor-version=ANY, required-service-instance-id=ANY, sd-client-config=DefaultSdClientConfig, version-driven-find-behavior=EXACT-OR-ANY-MINOR-VERSION
      someip required event group Eventgroup_Notification_soaFilmAuto: event-group=Eventgroup_Notify_soaFilmAuto, sd-client-event-group-timing-config=DefaultSdSubscribeConfig
      someip required event group Eventgroup_Notification_soaFilmDeviceNormal: event-group=Eventgroup_Notify_soaFilmDeviceNormal, sd-client-event-group-timing-config=DefaultSdSubscribeConfig
      someip required event group Eventgroup_Notification_soaFilmOpacities: event-group=Eventgroup_Notify_soaFilmOpacities, sd-client-event-group-timing-config=DefaultSdSubscribeConfig
    EEVP_LIT_Consumer_SubscriptionManagement: service-interface-deployment=SubscriptionManagement, required-minor-version=ANY, required-service-instance-id=ANY, sd-client-config=DefaultClientConfig, version-driven-find-behavior=EXACT-OR-ANY-MINOR-VERSION
      someip required event group Eventgroup_Notification_SubscriptionEvent: event-group=Eventgroup_notifySubscriptionEvent, sd-client-event-group-timing-config=DefaultSdSubscribeConfig
    EEVP_LIT_Consumer_VehicleInfo: service-interface-deployment=Zone_VehicleInfo_Input, sd-client-config=DefaultSdClientConfig
      someip required event group Eventgroup_Notification_VehicleInfo: event-group=Eventgroup_VehicleInfo, sd-client-event-group-timing-config=DefaultSdSubscribeConfig
