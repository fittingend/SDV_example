AUTOSAR XML (schema 00049)
package /ServiceInstance/Endpoint
  someip service instance to machine mapping EEVP_LIT_SomeipConsumers_DMS: communication-connector=eth0, service-instance=EEVP_LIT_Consumer_DMS, tcp-port=40100, udp-port=40100
  someip service instance to machine mapping EEVP_LIT_SomeipConsumers_SmartFilm: communication-connector=eth0, service-instance=EEVP_LIT_Consumer_SmartFilm, tcp-port=40101, udp-port=40101
  someip service instance to machine mapping EEVP_LIT_SomeipConsumers_SubscriptionManagement: communication-connector=eth0, service-instance=EEVP_LIT_Consumer_SubscriptionManagement, tcp-port=40102, udp-port=40102
package /ServiceInstance/Someip/Consumer
  required someip service instance EEVP_LIT_Consumer_DMS: service-interface-deployment=SoaDms, method-request-propss=[Get_soaDmsDeviceNormal, method=Get_soaDmsDriverStatus, method=Get_soaDmsStatus], required-minor-version=ANY, required-service-instance-id=ANY, sd-client-config=DefaultSdClientConfig, version-driven-find-behavior=EXACT-OR-ANY-MINOR-VERSION
    someip required event group Eventgroup_Notification_soaDmsDeviceNormal: event-group=Eventgroup_Notify_soaDmsDeviceNormal, sd-client-event-group-timing-config=DefaultSdSubscribeConfig
    someip required event group Eventgroup_Notification_soaDmsDriverStatus: event-group=Eventgroup_Notify_soaDmsDriverStatus, sd-client-event-group-timing-config=DefaultSdSubscribeConfig
    someip required event group Eventgroup_Notification_soaDmsStatus: event-group=Eventgroup_Notify_soaDmsStatus, sd-client-event-group-timing-config=DefaultSdSubscribeConfig
  required someip service instance EEVP_LIT_Consumer_SmartFilm: service-interface-deployment=SoaSmartFilm, method-request-propss=[Get_soaFilmAuto, Get_soaFilmDeviceNormal, Get_soaFilmOpacities, SetAllOpacities, SetAuto, SetOpacity], required-minor-version=ANY, required-service-instance-id=ANY, sd-client-config=DefaultSdClientConfig, version-driven-find-behavior=EXACT-OR-ANY-MINOR-VERSION
    someip required event group Eventgroup_Notification_soaFilmAuto: event-group=Eventgroup_Notify_soaFilmAuto, sd-client-event-group-timing-config=DefaultSdSubscribeConfig
    someip required event group Eventgroup_Notification_soaFilmDeviceNormal: event-group=Eventgroup_Notify_soaFilmDeviceNormal, sd-client-event-group-timing-config=DefaultSdSubscribeConfig
    someip required event group Eventgroup_Notification_soaFilmOpacities: event-group=Eventgroup_Notify_soaFilmOpacities, sd-client-event-group-timing-config=DefaultSdSubscribeConfig
  required someip service instance EEVP_LIT_Consumer_SubscriptionManagement: service-interface-deployment=SubscriptionManagement, required-minor-version=ANY, required-service-instance-id=ANY, sd-client-config=DefaultClientConfig, version-driven-find-behavior=EXACT-OR-ANY-MINOR-VERSION
    someip required event group Eventgroup_Notification_SubscriptionEvent: event-group=Eventgroup_notifySubscriptionEvent, sd-client-event-group-timing-config=DefaultSdSubscribeConfig
