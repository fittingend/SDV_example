AUTOSAR XML (schema 00049)
package /ServiceDeployment/Someip
  someip service interface deployment MonitoringManagement: service-interface=MonitoringManagement, service-interface-id=4881, service-interface-version={major-version=1, minor-version=0}
    6 x someip event deployment, all with transport-protocol=UDP:
      DistanceLevelFront: event=DistanceLevelFront, event-id=501
      DistanceLevelRear: event=DistanceLevelRear, event-id=502
      MbTempStatus: event=MbTempStatus, event-id=7
      eventServiceInfo: event=eventServiceInfo, event-id=4
      eventUpdatableService: event=eventUpdatableService, event-id=6
      resetUcmCompleted: event=resetUcmCompleted, event-id=1
    24 x someip field deployment:
      UssStatusFront: field=UssStatusFront
        get Get_UssStatusFront: method-id=503, transport-protocol=UDP
        notifier Notify_UssStatusFront: event-id=503, transport-protocol=UDP
      UssStatusRear: field=UssStatusRear
        get Get_UssStatusRear: method-id=504, transport-protocol=UDP
        notifier Notify_UssStatusRear: event-id=504, transport-protocol=UDP
      soaDmsDeviceNormal: field=soaDmsDeviceNormal
        get Get_soaDmsDeviceNormal: method-id=101, transport-protocol=UDP
        notifier Notify_soaDmsDeviceNormal: event-id=101, transport-protocol=UDP
      soaDmsSwVersion: field=soaDmsSwVersion
        get Get_soaDmsSwVersion: method-id=102, transport-protocol=UDP
        notifier Notify_soaDmsSwVersion: event-id=102, transport-protocol=UDP
      soaDrvSeatDeviceNormal: field=soaDrvSeatDeviceNormal
        get Get_soaDrvSeatDeviceNormal: method-id=751, transport-protocol=UDP
        notifier Notify_soaDrvSeatDeviceNormal: event-id=751, transport-protocol=UDP
      soaDrvSeatMotorDirection: field=soaDrvSeatMotorDirection
        get Get_soaDrvSeatMotorDirection: method-id=752, transport-protocol=UDP
        notifier Notify_soaDrvSeatMotorDirection: event-id=752, transport-protocol=UDP
      soaDrvSeatMotorPosition: field=soaDrvSeatMotorPosition
        get Get_soaDrvSeatMotorPosition: method-id=753, transport-protocol=UDP
        notifier Notify_soaDrvSeatMotorPosition: event-id=753, transport-protocol=UDP
      soaDrvSeatSwVersion: field=soaDrvSeatSwVersion
        get Get_soaDrvSeatSwVersion: method-id=754, transport-protocol=UDP
        notifier Notify_soaDrvSeatSwVersion: event-id=754, transport-protocol=UDP
      soaFilmDeviceNormal: field=soaFilmDeviceNormal
        get Get_soaFilmDeviceNormal: method-id=301, transport-protocol=UDP
        notifier Notify_soaFilmDeviceNormal: event-id=301, transport-protocol=UDP
      soaFilmSwVersion: field=soaFilmSwVersion
        get Get_soaFilmSwVersion: method-id=302, transport-protocol=UDP
        notifier Notify_soaFilmSwVersion: event-id=302, transport-protocol=UDP
      soaHvacDeviceNormal: field=soaHvacDeviceNormal
        get Get_soaHvacDeviceNormal: method-id=201, transport-protocol=UDP
        notifier Notify_soaHvacDeviceNormal: event-id=201, transport-protocol=UDP
      soaHvacSwVersion: field=soaHvacSwVersion
        get Get_soaHvacSwVersion: method-id=202, transport-protocol=UDP
        notifier Notify_soaHvacSwVersion: event-id=202, transport-protocol=UDP
      soaMlmStatus: field=soaMlmStatus
        get Get_soaMlmStatus: method-id=401, transport-protocol=UDP
        notifier Notify_soaMlmStatus: event-id=401, transport-protocol=UDP
      soaMlmSwVersion: field=soaMlmSwVersion
        get Get_soaMlmSwVersion: method-id=402, transport-protocol=UDP
        notifier Notify_soaMlmSwVersion: event-id=402, transport-protocol=UDP
      soaPowerDeviceNormal: field=soaPowerDeviceNormal
        get Get_soaPowerDeviceNormal: method-id=1051, transport-protocol=UDP
        notifier Notify_soaPowerDeviceNormal: event-id=1051, transport-protocol=UDP
      soaPowerSwVersion: field=soaPowerSwVersion
        get Get_soaPowerSwVersion: method-id=1052, transport-protocol=UDP
        notifier Notify_soaPowerSwVersion: event-id=1052, transport-protocol=UDP
      soaRctnStatus: field=soaRctnStatus
        get Get_soaRctnStatus: method-id=901, transport-protocol=UDP
        notifier Notify_soaRctnStatus: event-id=901, transport-protocol=UDP
      soaRctnSwVersion: field=soaRctnSwVersion
        get Get_soaRctnSwVersion: method-id=902, transport-protocol=UDP
        notifier Notify_soaRctnSwVersion: event-id=902, transport-protocol=UDP
      soaRoaDetectState: field=soaRoaDetectState
        get Get_soaRoaDetectState: method-id=652, transport-protocol=UDP
        notifier Notify_soaRoaDetectState: event-id=652, transport-protocol=UDP
      soaRoaDeviceNormal: field=soaRoaDeviceNormal
        get Get_soaRoaDeviceNormal: method-id=653, transport-protocol=UDP
        notifier Notify_soaRoaDeviceNormal: event-id=653, transport-protocol=UDP
      soaRoaSwVersion: field=soaRoaSwVersion
        get Get_soaRoaSwVersion: method-id=657, transport-protocol=UDP
        notifier Notify_soaRoaSwVersion: event-id=657, transport-protocol=UDP
      soaWiperDeviceNormal: field=soaWiperDeviceNormal
        get Get_soaWiperDeviceNormal: method-id=801, transport-protocol=UDP
        notifier Notify_soaWiperDeviceNormal: event-id=801, transport-protocol=UDP
      soaWiperStatus: field=soaWiperStatus
        get Get_soaWiperStatus: method-id=802, transport-protocol=UDP
        notifier Notify_soaWiperStatus: event-id=802, transport-protocol=UDP
      soaWiperSwVersion: field=soaWiperSwVersion
        get Get_soaWiperSwVersion: method-id=803, transport-protocol=UDP
        notifier Notify_soaWiperSwVersion: event-id=803, transport-protocol=UDP
    13 x someip method deployment, all with transport-protocol=UDP:
      RequestMlmSetRgbColor: method=RequestMlmSetRgbColor, method-id=405
      RequestMoveDrvSeatHeight: method=RequestMoveDrvSeatHeight, method-id=701
      RequestMoveDrvSeatRecline: method=RequestMoveDrvSeatRecline, method-id=702
      RequestMoveDrvSeatSlide: method=RequestMoveDrvSeatSlide, method-id=703
      RequestMoveDrvSeatTilt: method=RequestMoveDrvSeatTilt, method-id=704
      RequestRearCurtainOperation: method=RequestRearCurtainOperation, method-id=903
      RequestRearCurtainPosition: method=RequestRearCurtainPosition, method-id=904
      RequestWiperOperation: method=RequestWiperOperation, method-id=804
      SetWiperAutoSpeed: method=SetWiperAutoSpeed, method-id=805
      requestAppInstall: method=requestAppInstall, method-id=1
      requestAppUpdate: method=requestAppUpdate, method-id=2
      requestControllerServiceInfo: method=requestControllerServiceInfo, method-id=3
      resetUcmTest: method=resetUcmTest, method-id=12
    someip event group Eventgroup_eventService: event-group-id=1, event=[DistanceLevelFront, DistanceLevelRear, MbTempStatus, Notify_UssStatusFront, Notify_UssStatusRear, eventServiceInfo, eventUpdatableService, resetUcmCompleted, Notify_soaDmsDeviceNormal, Notify_soaDmsSwVersion, Notify_soaDrvSeatDeviceNormal, Notify_soaDrvSeatMotorDirection, Notify_soaDrvSeatMotorPosition, Notify_soaDrvSeatSwVersion, Notify_soaFilmDeviceNormal, Notify_soaFilmSwVersion, Notify_soaHvacDeviceNormal, Notify_soaHvacSwVersion, Notify_soaMlmStatus, Notify_soaMlmSwVersion, Notify_soaPowerDeviceNormal, Notify_soaPowerSwVersion, Notify_soaRctnStatus, Notify_soaRctnSwVersion, Notify_soaRoaDetectState, Notify_soaRoaDeviceNormal, Notify_soaRoaSwVersion, Notify_soaWiperDeviceNormal, Notify_soaWiperStatus, Notify_soaWiperSwVersion]
package /ServiceInstance/Endpoint
  13 x someip service instance to machine mapping, all with communication-connector=eth0:
    EEVP_MonitoringManager_SomeipConsumers_Dms: service-instance=EEVP_MonitoringManager_Consumer_Dms, tcp-port=55054, udp-port=55054
    EEVP_MonitoringManager_SomeipConsumers_DrvSeat: service-instance=EEVP_MonitoringManager_Consumer_SoaDriverSeat, tcp-port=55055, udp-port=55055
    EEVP_MonitoringManager_SomeipConsumers_MoodLamp: service-instance=EEVP_MonitoringManager_Consumer_MoodLamp, tcp-port=55061, udp-port=55061
    EEVP_MonitoringManager_SomeipConsumers_OtaMonitoring: service-instance=EEVP_MonitoringManager_Consumer_OtaMonitoring, tcp-port=55031, udp-port=55031
    EEVP_MonitoringManager_SomeipConsumers_PDWFront: service-instance=EEVP_MonitoringManager_Consumer_PDWFront, tcp-port=55081, udp-port=55081
    EEVP_MonitoringManager_SomeipConsumers_PDWRear: service-instance=EEVP_MonitoringManager_Consumer_PDWRear, tcp-port=55082, udp-port=55082
    EEVP_MonitoringManager_SomeipConsumers_Power: service-instance=EEVP_MonitoringManager_Consumer_SoaPower, tcp-port=55045, udp-port=55045
    EEVP_MonitoringManager_SomeipConsumers_RearCurtain: service-instance=EEVP_MonitoringManager_Consumer_RearCurtain, tcp-port=55071, udp-port=55071
    EEVP_MonitoringManager_SomeipConsumers_Roa: service-instance=EEVP_MonitoringManager_Consumer_SoaRoa, tcp-port=55048, udp-port=55048
    EEVP_MonitoringManager_SomeipConsumers_SmartFilm: service-instance=EEVP_MonitoringManager_Consumer_SmartFilm, tcp-port=55053, udp-port=55053
    EEVP_MonitoringManager_SomeipConsumers_StateManager: service-instance=EEVP_MonitoringManager_Consumer_StateManager, tcp-port=55051, udp-port=55051
    EEVP_MonitoringManager_SomeipConsumers_Wiper: service-instance=EEVP_MonitoringManager_Consumer_Wiper, tcp-port=55021, udp-port=55021
    EEVP_MonitoringManager_SomeipProviders_MonitoringManagement: service-instance=EEVP_MonitoringManager_Provider_MonitoringManagement, tcp-port=55011, udp-port=55011
package /ServiceInstance/Someip/Consumer
  13 x required someip service instance:
    EEVP_MonitoringManager_Consumer_Dms: service-interface-deployment=SoaDms, method-request-propss=[Get_soaDmsDeviceNormal, Get_soaDmsSwVersion], required-service-instance-id=ANY, sd-client-config=DefaultSdClientConfig
      someip required event group Eventgroup_Notification_soaDmsDeviceNormal: event-group=Eventgroup_Notify_soaDmsDeviceNormal, sd-client-event-group-timing-config=DefaultSdSubscribeConfig
      someip required event group Eventgroup_Notification_soaDmsVersion: event-group=Eventgroup_Notify_soaDmsSwVersion, sd-client-event-group-timing-config=DefaultSdSubscribeConfig
    EEVP_MonitoringManager_Consumer_Hvac: service-interface-deployment=SoaHvac, method-request-propss=[method=Get_soaHvacDeviceNormal, Get_soaHvacSwVersion], required-service-instance-id=ANY, sd-client-config=DefaultSdClientConfig
      someip required event group Eventgroup_Notification_soaHvacDeviceNormal: event-group=Eventgroup_Notify_soaHvacDeviceNormal, sd-client-event-group-timing-config=DefaultSdSubscribeConfig
      someip required event group Eventgroup_Notification_soaHvacVersion: event-group=Eventgroup_Notify_soaHvacSwVersion, sd-client-event-group-timing-config=DefaultSdSubscribeConfig
    EEVP_MonitoringManager_Consumer_MoodLamp: service-interface-deployment=SoaMlm, required-minor-version=ANY, required-service-instance-id=ANY, sd-client-config=DefaultSdClientConfig, version-driven-find-behavior=EXACT-OR-ANY-MINOR-VERSION
      method-request-propss:
        method=Get_soaMlmStatus
        RequestMlmSetBrightness
        RequestMlmSetMode
        RequestMlmSetRgbColor
        Get_soaMlmSwVersion
      someip required event group Eventgroup_Notification_soaMlmStatus: event-group=Eventgroup_Notification_soaMlmStatus, sd-client-event-group-timing-config=DefaultSdSubscribeConfig
      someip required event group Eventgroup_Notification_soaMlmVersion: event-group=Eventgroup_Notification_soaMlmSwVersion, sd-client-event-group-timing-config=DefaultSdSubscribeConfig
    EEVP_MonitoringManager_Consumer_OtaMonitoring: service-interface-deployment=OtaMonitoring, method-request-propss=[requestServiceInstall, requestServiceUpdate, requestVersionInfo, resetUcmTest], required-minor-version=ANY, required-service-instance-id=ANY, sd-client-config=DefaultSdClientConfig, version-driven-find-behavior=EXACT-OR-ANY-MINOR-VERSION
      someip required event group Eventgroup_notifyServiceEvent: event-group=Eventgroup_notifyServiceEvent, sd-client-event-group-timing-config=DefaultSdSubscribeConfig
      someip required event group Eventgroup_notifyUpdatableService: event-group=Eventgroup_notifyUpdatableService, sd-client-event-group-timing-config=DefaultSdSubscribeConfig
      someip required event group Eventgroup_resetUcmCompleted: event-group=Eventgroup_resetUcmCompleted, sd-client-event-group-timing-config=DefaultSdSubscribeConfig
    EEVP_MonitoringManager_Consumer_PDWFront: service-interface-deployment=Main_PDW_Service, someip-method-props=method=Getter, required-minor-version=ANY, required-service-instance-id=1, sd-client-config=DefaultSdClientConfig, version-driven-find-behavior=EXACT-OR-ANY-MINOR-VERSION
      someip required event group Eventgroup_DistanceLevel: event-group=Eventgroup_DistanceLevel, sd-client-event-group-timing-config=DefaultSdSubscribeConfig
      someip required event group Eventgroup_UssStatus: event-group=Eventgroup_UssStatus, sd-client-event-group-timing-config=DefaultSdSubscribeConfig
    EEVP_MonitoringManager_Consumer_PDWRear: service-interface-deployment=Main_PDW_Service, someip-method-props=method=Getter, required-minor-version=ANY, required-service-instance-id=2, sd-client-config=DefaultSdClientConfig, version-driven-find-behavior=EXACT-OR-ANY-MINOR-VERSION
      someip required event group Eventgroup_DistanceLevel: event-group=Eventgroup_DistanceLevel, sd-client-event-group-timing-config=DefaultSdSubscribeConfig
      someip required event group Eventgroup_UssStatus: event-group=Eventgroup_UssStatus, sd-client-event-group-timing-config=DefaultSdSubscribeConfig
    EEVP_MonitoringManager_Consumer_RearCurtain: service-interface-deployment=SoaRcurtain, method-request-propss=[method=Get_soaRctnStatus, Get_soaRctnSwVersion, RequestRearCurtainOperation, RequestRearCurtainPosition], required-minor-version=ANY, required-service-instance-id=ANY, sd-client-config=DefaultSdClientConfig, version-driven-find-behavior=EXACT-OR-ANY-MINOR-VERSION
      someip required event group Eventgroup_Notification_soaRctnStatus: event-group=Eventgroup_Notification_soaRctnStatus, sd-client-event-group-timing-config=DefaultSdSubscribeConfig
      someip required event group Eventgroup_Notification_soaRctnSwVersion: event-group=Eventgroup_Notification_soaRctnSwVersion, sd-client-event-group-timing-config=DefaultSdSubscribeConfig
    EEVP_MonitoringManager_Consumer_SmartFilm: service-interface-deployment=SoaSmartFilm, method-request-propss=[method=Get_soaFilmDeviceNormal, Get_soaFilmSwVersion], required-service-instance-id=ANY, sd-client-config=DefaultSdClientConfig
      someip required event group Eventgroup_Notification_soaFilmDeviceNormal: event-group=Eventgroup_Notify_soaFilmDeviceNormal, sd-client-event-group-timing-config=DefaultSdSubscribeConfig
      someip required event group Eventgroup_Notification_soaFilmVersion: event-group=Eventgroup_Notify_soaFilmSwVersion, sd-client-event-group-timing-config=DefaultSdSubscribeConfig
    EEVP_MonitoringManager_Consumer_SoaDriverSeat: service-interface-deployment=SoaDriverSeat, required-minor-version=ANY, required-service-instance-id=ANY, sd-client-config=DefaultSdClientConfig, version-driven-find-behavior=EXACT-OR-ANY-MINOR-VERSION
      method-request-propss:
        Get_soaDrvSeatDeviceNormal
        Get_soaDrvSeatMotorDirection
        Get_soaDrvSeatMotorPosition
        Get_soaDrvSeatSwVersion
        RequestMoveDrvSeatHeight
        RequestMoveDrvSeatRecline
        RequestMoveDrvSeatSlide
        RequestMoveDrvSeatTilt
      4 x someip required event group, all with sd-client-event-group-timing-config=DefaultSdSubscribeConfig:
        Eventgroup_Notification_soaDrvSeatDeviceNormal: event-group=Eventgroup_Notification_soaDrvSeatDeviceNormal
        Eventgroup_Notification_soaDrvSeatMotorDirection: event-group=Eventgroup_Notification_soaDrvSeatMotorDirection
        Eventgroup_Notification_soaDrvSeatMotorPosition: event-group=Eventgroup_Notification_soaDrvSeatMotorPosition
        Eventgroup_Notification_soaDrvSeatSwVersion: event-group=Eventgroup_Notification_soaDrvSeatSwVersion
    EEVP_MonitoringManager_Consumer_SoaPower: service-interface-deployment=SoaPower, method-request-propss=[Get_soaPowerDeviceNormal, Get_soaPowerSwVersion], required-minor-version=ANY, required-service-instance-id=ANY, sd-client-config=DefaultSdClientConfig, version-driven-find-behavior=EXACT-OR-ANY-MINOR-VERSION
      someip required event group Eventgroup_Notification_soaPowerDeviceNormal: event-group=Eventgroup_Notification_soaPowerDeviceNormal, sd-client-event-group-timing-config=DefaultSdSubscribeConfig
      someip required event group Eventgroup_Notify_soaPowerSwVersion: event-group=Eventgroup_Notify_soaPowerSwVersion, sd-client-event-group-timing-config=DefaultSdSubscribeConfig
    EEVP_MonitoringManager_Consumer_SoaRoa: service-interface-deployment=SoaRoa, method-request-propss=[Get_soaRoaDetectState, Get_soaRoaDeviceNormal, Get_soaRoaSwVersion], required-minor-version=ANY, required-service-instance-id=ANY, sd-client-config=DefaultSdClientConfig, version-driven-find-behavior=EXACT-OR-ANY-MINOR-VERSION
      someip required event group Eventgroup_Notification_soaRoaDetectState: event-group=Eventgroup3_Notification_soaRoaDetectState, sd-client-event-group-timing-config=DefaultSdSubscribeConfig
      someip required event group Eventgroup_Notification_soaRoaDeviceNormal: event-group=Eventgroup_Notification_soaRoaDeviceNormal, sd-client-event-group-timing-config=DefaultSdSubscribeConfig
      someip required event group Eventgroup_Notification_soaRoaSwVersion: event-group=Eventgroup_Notification_soaRoaSwVersion, sd-client-event-group-timing-config=DefaultSdSubscribeConfig
    EEVP_MonitoringManager_Consumer_StateManager: service-interface-deployment=StateManager, method-request-propss=[Get_NotifyTime, Set_NotifyTime, Get_SystemState], required-minor-version=ANY, required-service-instance-id=ANY, sd-client-config=DefaultSdClientConfig, version-driven-find-behavior=EXACT-OR-ANY-MINOR-VERSION
      someip required event group Eventgroup_Notification: event-group=Eventgroup_Notification, sd-client-event-group-timing-config=DefaultSdSubscribeConfig
    EEVP_MonitoringManager_Consumer_Wiper: service-interface-deployment=SoaWiper, required-minor-version=ANY, required-service-instance-id=ANY, sd-client-config=DefaultClientConfig, version-driven-find-behavior=EXACT-OR-ANY-MINOR-VERSION
      method-request-propss:
        Get_soaWiperDeviceNormal
        Get_soaWiperStatus
        Get_soaWiperSwVersion
        RequestWiperOperation
        SetWiperAutoSpeed
      someip required event group Eventgroup_Notification_isDeviceNormal: event-group=Eventgroup_Notification_soaWiperDeviceNormal, sd-client-event-group-timing-config=DefaultSdSubscribeConfig
      someip required event group Eventgroup_Notification_soaWiperStatus: event-group=Eventgroup_Notification_soaWiperStatus, sd-client-event-group-timing-config=DefaultSdSubscribeConfig
      someip required event group Eventgroup_Notification_soaWiperSwVersion: event-group=Eventgroup_Notification_soaWiperSwVersion, sd-client-event-group-timing-config=DefaultSdSubscribeConfig
package /ServiceInstance/Someip/Provider
  provided someip service instance EEVP_MonitoringManager_Provider_MonitoringManagement: service-interface-deployment=MonitoringManagement, sd-server-config=DefaultSdServerConfig, service-instance-id=1
    event-propss:
      eventServiceInfo
      eventUpdatableService
      Notify_soaWiperDeviceNormal
      Notify_soaWiperStatus
      Notify_soaWiperSwVersion
      Notify_soaMlmStatus
      Notify_soaMlmSwVersion
      Notify_soaRctnStatus
      Notify_soaRctnSwVersion
      DistanceLevelFront
      Notify_UssStatusFront
      Notify_soaDrvSeatDeviceNormal
      Notify_soaDrvSeatMotorDirection
      Notify_soaDrvSeatMotorPosition
      Notify_soaDrvSeatSwVersion
      Notify_soaRoaDetectState
      Notify_soaRoaDeviceNormal
      Notify_soaRoaSwVersion
      Notify_soaPowerDeviceNormal
      Notify_soaPowerSwVersion
      MbTempStatus
      event=Notify_UssStatusRear
      DistanceLevelRear
      resetUcmCompleted
      Notify_soaDmsDeviceNormal
      Notify_soaDmsSwVersion
      Notify_soaHvacSwVersion
      Notify_soaHvacDeviceNormal
      Notify_soaFilmDeviceNormal
      Notify_soaFilmSwVersion
    method-response-propss:
      requestAppInstall
      requestAppUpdate
      requestControllerServiceInfo
      resetUcmTest
      RequestWiperOperation
      SetWiperAutoSpeed
      Get_soaWiperDeviceNormal
      Get_soaWiperStatus
      Get_soaWiperSwVersion
      method=Get_soaMlmStatus
      Get_soaMlmSwVersion
      Get_soaRctnStatus
      Get_soaRctnSwVersion
      RequestMlmSetRgbColor
      RequestRearCurtainOperation
      RequestRearCurtainPosition
      Get_UssStatusFront
      Get_soaDrvSeatDeviceNormal
      Get_soaDrvSeatMotorDirection
      Get_soaDrvSeatMotorPosition
      Get_soaDrvSeatSwVersion
      Get_soaRoaDetectState
      Get_soaRoaDeviceNormal
      Get_soaRoaSwVersion
      RequestMoveDrvSeatHeight
      RequestMoveDrvSeatRecline
      RequestMoveDrvSeatSlide
      RequestMoveDrvSeatTilt
      Get_UssStatusRear
      Get_soaDmsDeviceNormal
      Get_soaDmsSwVersion
      Get_soaHvacSwVersion
      Get_soaHvacDeviceNormal
      Get_soaFilmDeviceNormal
      Get_soaFilmSwVersion
    someip provided event group Eventgroup_eventService: event-group=Eventgroup_eventService, multicast-threshold=0
package /ServiceInterface
  service interface MonitoringManagement
    namespaces:
      symbol props eevp
      symbol props monitoring
      symbol props service
    events:
      6 x data:
        DistanceLevelFront: type=DistanceLevel
        DistanceLevelRear: type=DistanceLevel
        MbTempStatus: type=MbTempStatus
        eventServiceInfo: type=ControllerServiceInfo
        eventUpdatableService: type=UpdatableServiceList
        resetUcmCompleted: type=bool
    24 x field, all with has-getter=true, has-notifier=true, has-setter=false:
      UssStatusFront: type=UssStatus
      UssStatusRear: type=UssStatus
      soaDmsDeviceNormal: type=SoaDeviceIsNormal
      soaDmsSwVersion: type=uint8_t
      soaDrvSeatDeviceNormal: type=SoaDeviceIsNormal
      soaDrvSeatMotorDirection: type=SoaSeatMotorDirection
      soaDrvSeatMotorPosition: type=SoaSeatMotorPosition
      soaDrvSeatSwVersion: type=uint8_t
      soaFilmDeviceNormal: type=SoaDeviceIsNormal
      soaFilmSwVersion: type=uint8_t
      soaHvacDeviceNormal: type=SoaDeviceIsNormal
      soaHvacSwVersion: type=uint8_t
      soaMlmStatus: type=SoaMlmStatus
      soaMlmSwVersion: type=uint8_t
      soaPowerDeviceNormal: type=SoaDeviceIsNormal
      soaPowerSwVersion: type=uint8_t
      soaRctnStatus: type=SoaRctnStatus
      soaRctnSwVersion: type=uint8_t
      soaRoaDetectState: type=SoaRoaDetectState
      soaRoaDeviceNormal: type=SoaDeviceIsNormal
      soaRoaSwVersion: type=uint8_t
      soaWiperDeviceNormal: type=SoaDeviceIsNormal
      soaWiperStatus: type=SoaWiperStatus
      soaWiperSwVersion: type=uint8_t
    methods:
      13 x operation, all with fire-and-forget=false:
        RequestMlmSetRgbColor
          arg colorTableIndex: type=uint8_t, direction=IN
        RequestMoveDrvSeatHeight
          arg dir: type=SoaSeatHeightDirection, direction=IN
        RequestMoveDrvSeatRecline
          arg dir: type=SoaSeatReclineDirection, direction=IN
        RequestMoveDrvSeatSlide
          arg dir: type=SoaSeatSlideDirection, direction=IN
        RequestMoveDrvSeatTilt
          arg dir: type=SoaSeatTiltDirection, direction=IN
        RequestRearCurtainOperation
          arg motorDir: type=SoaRctnMotorDir, direction=IN
          arg err: type=SoaErrorState, direction=OUT
        RequestRearCurtainPosition
          arg posPercentage: type=uint8_t, direction=IN
        RequestWiperOperation
          arg mode: type=SoaWiperMode, direction=IN
        SetWiperAutoSpeed
          arg isAutoSpeed: type=bool, direction=IN
        requestAppInstall
          arg controllerServiceName: type=String, direction=IN
          arg returnValue: type=bool, direction=OUT
        requestAppUpdate
          arg controllerServiceName: type=String, direction=IN
          arg returnValue: type=bool, direction=OUT
        requestControllerServiceInfo
          arg controllerServiceName: type=String, direction=IN
          arg controllerServiceInfo: type=ControllerServiceInfo, direction=OUT
          arg returnValue: type=bool, direction=OUT
        resetUcmTest
