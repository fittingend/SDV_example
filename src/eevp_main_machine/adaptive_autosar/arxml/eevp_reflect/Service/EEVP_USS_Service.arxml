AUTOSAR XML (schema 00049)
package /ServiceDeployment/Someip
  someip service interface deployment Zone_UssFront_Input: service-interface=Zone_UssFront_Input, service-interface-id=6208, service-interface-version={major-version=1, minor-version=0}
    someip event deployment UssData: event=UssFront, event-id=12920, serializer=SOMEIP, transport-protocol=UDP
    someip event group Eventgroup_UssData: event-group-id=1034, event=Zone_UssFront_Input/UssData
  someip service interface deployment Zone_UssUssRear_Input: service-interface=Zone_UssRear_Input, service-interface-id=5952, service-interface-version={major-version=1, minor-version=0}
    someip event deployment UssData: event=UssRear, event-id=12921, serializer=SOMEIP, transport-protocol=UDP
    someip event group Eventgroup_UssData: event-group-id=1024, event=Zone_UssUssRear_Input/UssData
package /ServiceInstance/Someip/Provider
  provided someip service instance Zone_USS_Provider_UssFront_Input: service-interface-deployment=Zone_UssFront_Input, someip-event-props=Zone_UssFront_Input/UssData, sd-server-config=DefaultSdServerConfig, service-instance-id=1
    someip provided event group Eventgroup_UssData: event-group=Zone_UssFront_Input/Eventgroup_UssData, multicast-threshold=0
  provided someip service instance Zone_USS_Provider_UssUssRear_Input: service-interface-deployment=Zone_UssUssRear_Input, someip-event-props=Zone_UssUssRear_Input/UssData, sd-server-config=DefaultSdServerConfig, service-instance-id=1
    someip provided event group Eventgroup_UssData: event-group=Zone_UssUssRear_Input/Eventgroup_UssData, multicast-threshold=0
package /ServiceInterface
  service interface Zone_UssFront_Input: major-version=1, minor-version=0
    namespaces:
      symbol props zone
      symbol props input
      symbol props service
    events:
      data UssFront: type=UssData
  service interface Zone_UssRear_Input: major-version=1, minor-version=0
    namespaces:
      symbol props zone
      symbol props input
      symbol props service
    events:
      data UssRear: type=UssData
