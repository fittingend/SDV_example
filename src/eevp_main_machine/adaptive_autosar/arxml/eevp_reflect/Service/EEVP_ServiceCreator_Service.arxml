AUTOSAR XML (schema 00049)
package /ServiceDeployment/Someip
  21 x someip service interface deployment, all with service-interface-version={major-version=1, minor-version=0}:
    BCM_ExteriorSignal: service-interface=BCM_ExteriorSignal, service-interface-id=9060
      someip field deployment hornState: field=hornState
        get Get_hornState: method-id=1, transport-protocol=UDP
        notifier Notification_hornState: event-id=11, transport-protocol=UDP
      someip field deployment lightState: field=lightState
        get Get_lightState: method-id=2, transport-protocol=UDP
        notifier Notification_lightState: event-id=12, transport-protocol=UDP
      someip event group Eventgroup_Notification_hornState: event-group-id=1, event=Notification_hornState
      someip event group Eventgroup_Notification_lightState: event-group-id=2, event=Notification_lightState
    BCM_Horn: service-interface=BCM_Horn, service-interface-id=9030
      someip method deployment Alert: method=Alert, method-id=3, transport-protocol=UDP
      someip method deployment start: method=start, method-id=1, transport-protocol=UDP
      someip method deployment stop: method=stop, method-id=2, transport-protocol=UDP
    BCM_WiperWash: service-interface=BCM_WiperWash, service-interface-id=5005
      someip field deployment wiperInterval: field=wiperInterval
        get Get_wiperInterval: method-id=5, transport-protocol=UDP
        notifier Notification_wiperInterval: event-id=6, transport-protocol=UDP
      someip field deployment wiperLevel: field=wiperLevel
        get Get_wiperLevel: method-id=7, transport-protocol=UDP
        notifier Notification_wiperLevel: event-id=8, transport-protocol=UDP
      4 x someip method deployment, all with transport-protocol=UDP:
        setWipingInterval: method=setWipingInterval, method-id=1
        setWipingLevel: method=setWipingLevel, method-id=2
        startWiping: method=startWiping, method-id=3
        stopWiping: method=stopWiping, method-id=4
      someip event group Eventgroup_Notification_wiperInterval: event-group-id=1, event=Notification_wiperInterval
      someip event group Eventgroup_Notification_wiperLevel: event-group-id=2, event=Notification_wiperLevel
    Ctrl_MoodLamp: service-interface=Ctrl_MoodLamp, service-interface-id=9048
      8 x someip method deployment, all with transport-protocol=UDP:
        getBrightness: method=getBrightness, method-id=5
        getColor: method=getColor, method-id=7
        getPowerStatus: method=getPowerStatus, method-id=3
        setBrightness: method=setBrightness, method-id=6
        setColor: method=setColor, method-id=8
        setPowerStatus: method=setPowerStatus, method-id=4
        turnOff: method=Ctrl_MoodLamp/turnOff, method-id=2
        turnOn: method=Ctrl_MoodLamp/turnOn, method-id=1
    Ctrl_RearCurtain: service-interface=Ctrl_RearCurtain, service-interface-id=9049
      someip method deployment getOpeningRate: method=getOpeningRate, method-id=1, transport-protocol=UDP
      someip method deployment setOpeningRate: method=setOpeningRate, method-id=2, transport-protocol=UDP
    DMS_Func: service-interface=DMS_Func, service-interface-id=9047
      someip method deployment isDetectDrowsy: method=isDetectDrowsy, method-id=1, transport-protocol=UDP
    Snsr_FaceDetectModule: service-interface=Snsr_FaceDetectModule, service-interface-id=9040
      4 x someip method deployment, all with transport-protocol=UDP:
        getEmotion: method=getEmotion, method-id=4
        isRunning: method=Snsr_FaceDetectModule/isRunning, method-id=3
        turnOff: method=Snsr_FaceDetectModule/turnOff, method-id=2
        turnOn: method=Snsr_FaceDetectModule/turnOn, method-id=1
    Snsr_Heartbeat: service-interface=Snsr_Heartbeat, service-interface-id=9041
      someip method deployment getHr: method=getHr, method-id=1, transport-protocol=UDP
    Snsr_USS: service-interface=Snsr_USS, service-interface-id=9034
      someip method deployment isDetect: method=isDetect, method-id=3, transport-protocol=UDP
      someip method deployment ntfFltSt: method=ntfFltSt, method-id=2, transport-protocol=UDP
      someip method deployment ntfSonarInfo: method=ntfSonarInfo, method-id=1, transport-protocol=UDP
    TMS_AC: service-interface=TMS_AC, service-interface-id=9042
      6 x someip method deployment, all with transport-protocol=UDP:
        getAirOutletTemp: method=getAirOutletTemp, method-id=6
        getTargetTemp: method=getTargetTemp, method-id=5
        isRunning: method=TMS_AC/isRunning, method-id=3
        setTargetTemp: method=setTargetTemp, method-id=4
        turnOff: method=TMS_AC/turnOff, method-id=2
        turnOn: method=TMS_AC/turnOn, method-id=1
    TMS_EnvMonitor: service-interface=TMS_EnvMonitor, service-interface-id=9046
      6 x someip method deployment, all with transport-protocol=UDP:
        getHumidity: method=getHumidity, method-id=4
        getLightIntensity: method=getLightIntensity, method-id=5
        getTemp: method=getTemp, method-id=2
        notifyHumidity: method=notifyHumidity, method-id=1
        notifyLightIntensity: method=notifyLightIntensity, method-id=6
        notifyTemp: method=notifyTemp, method-id=3
    TMS_Fragrance: service-interface=TMS_Fragrance, service-interface-id=9045
      7 x someip method deployment, all with transport-protocol=UDP:
        getConcentration: method=getConcentration, method-id=5
        getType: method=getType, method-id=7
        isRunning: method=TMS_Fragrance/isRunning, method-id=3
        setConcentration: method=setConcentration, method-id=4
        setType: method=setType, method-id=6
        turnOff: method=TMS_Fragrance/turnOff, method-id=2
        turnOn: method=TMS_Fragrance/turnOn, method-id=1
    TMS_Purifier: service-interface=TMS_Purifier, service-interface-id=9044
      someip method deployment isRunning: method=TMS_Purifier/isRunning, method-id=3, transport-protocol=UDP
      someip method deployment turnOff: method=TMS_Purifier/turnOff, method-id=2, transport-protocol=UDP
      someip method deployment turnOn: method=TMS_Purifier/turnOn, method-id=1, transport-protocol=UDP
    TMS_Ventilation: service-interface=TMS_Ventilation, service-interface-id=9043
      someip method deployment isRunning: method=TMS_Ventilation/isRunning, method-id=3, transport-protocol=UDP
      someip method deployment turnOff: method=TMS_Ventilation/turnOff, method-id=2, transport-protocol=UDP
      someip method deployment turnOn: method=TMS_Ventilation/turnOn, method-id=1, transport-protocol=UDP
    VCS_AccrPedal: service-interface=VCS_AccrPedal, service-interface-id=9003
      someip method deployment notifyAccrPedal: method=notifyAccrPedal, method-id=1, transport-protocol=UDP
    VCS_Brake: service-interface=VCS_Brake, service-interface-id=9032
      4 x someip method deployment, all with transport-protocol=UDP:
        notifyMCPrs: method=notifyMCPrs, method-id=1
        notifyTq: method=notifyTq, method-id=2
        setTargetAx: method=setTargetAx, method-id=3
        setTotalForce: method=setTotalForce, method-id=4
    VCS_BrakePedal: service-interface=VCS_BrakePedal, service-interface-id=9002
      someip method deployment nofityBrakeSwitch: method=notifyBrakeSwitch, method-id=1, transport-protocol=UDP
      someip method deployment notifyBrakeStatus: method=notifyBrakeStatus, method-id=2, transport-protocol=UDP
    VCS_EPB: service-interface=VCS_EPB, service-interface-id=9033
      someip method deployment notifystaticSlope: method=notifystaticSlope, method-id=1, transport-protocol=UDP
    VCS_Gear: service-interface=VCS_Gear, service-interface-id=9004
      someip method deployment notifyGear: method=notifyGear, method-id=1, transport-protocol=UDP
      someip method deployment setTarget: method=setTarget, method-id=2, transport-protocol=UDP
    VCS_TqDmd: service-interface=VCS_TqDmd, service-interface-id=9031
      someip method deployment setDrivePedalPosn: method=setDrivePedalPosn, method-id=1, transport-protocol=UDP
    VCS_VehSpd: service-interface=VCS_VehSpd, service-interface-id=9001
      someip method deployment notifyVehSpd: method=notifyVehSpd, method-id=1, transport-protocol=UDP
package /ServiceInstance/Endpoint
  18 x someip service instance to machine mapping, all with communication-connector=eth0:
    EEVP_ServiceCreator_SomeipProviders_BCM_ExteriorSignal: service-instance=EEVP_ServiceCreator_Provider_BCM_ExteriorSignal, tcp-port=40067, udp-port=40067
    EEVP_ServiceCreator_SomeipProviders_BCM_WiperWash: service-instance=EEVP_ServiceCreator_Provider_BCM_WiperWash, tcp-port=40050, udp-port=40050
    EEVP_ServiceCreator_SomeipProviders_Ctrl_MoodLamp: service-instance=EEVP_ServiceCreator_Provider_Ctrl_MoodLamp, tcp-port=40051, udp-port=40051
    EEVP_ServiceCreator_SomeipProviders_Ctrl_RearCurtain: service-instance=EEVP_ServiceCreator_Provider_Ctrl_RearCurtain, tcp-port=40052, udp-port=40052
    EEVP_ServiceCreator_SomeipProviders_Snsr_FaceDetectModule: service-instance=EEVP_ServiceCreator_Provider_Snsr_FaceDetectModule, tcp-port=40053, udp-port=40053
    EEVP_ServiceCreator_SomeipProviders_Snsr_Heartbeat: service-instance=EEVP_ServiceCreator_Provider_Snsr_Heartbeat, tcp-port=40054, udp-port=40054
    EEVP_ServiceCreator_SomeipProviders_Snsr_USS: service-instance=EEVP_ServiceCreator_Provider_Snsr_USS, tcp-port=40055, udp-port=40055
    EEVP_ServiceCreator_SomeipProviders_TMS_AC: service-instance=EEVP_ServiceCreator_Provider_TMS_AC, tcp-port=40056, udp-port=40056
    EEVP_ServiceCreator_SomeipProviders_TMS_EnvMonitor: service-instance=EEVP_ServiceCreator_Provider_TMS_EnvMonitor, tcp-port=40057, udp-port=40057
    EEVP_ServiceCreator_SomeipProviders_TMS_Fragrance: service-instance=EEVP_ServiceCreator_Provider_TMS_Fragrance, tcp-port=40058, udp-port=40058
    EEVP_ServiceCreator_SomeipProviders_TMS_Purifier: service-instance=EEVP_ServiceCreator_Provider_TMS_Purifier, tcp-port=40059, udp-port=40059
    EEVP_ServiceCreator_SomeipProviders_TMS_Ventilation: service-instance=EEVP_ServiceCreator_Provider_TMS_Ventilation, tcp-port=40060, udp-port=40060
    EEVP_ServiceCreator_SomeipProviders_VCS_AccrPedal: service-instance=EEVP_ServiceCreator_Provider_VCS_AccrPedal, tcp-port=40061, udp-port=40061
    EEVP_ServiceCreator_SomeipProviders_VCS_Brake: service-instance=EEVP_ServiceCreator_Provider_VCS_Brake, tcp-port=40062, udp-port=40062
    EEVP_ServiceCreator_SomeipProviders_VCS_BrakePedal: service-instance=EEVP_ServiceCreator_Provider_VCS_BrakePedal, tcp-port=40063, udp-port=40063
    EEVP_ServiceCreator_SomeipProviders_VCS_EPB: service-instance=EEVP_ServiceCreator_Provider_VCS_EPB, tcp-port=40064, udp-port=40064
    EEVP_ServiceCreator_SomeipProviders_VCS_Gear: service-instance=EEVP_ServiceCreator_Provider_VCS_Gear, tcp-port=40065, udp-port=40065
    EEVP_ServiceCreator_SomeipProviders_VCS_VehSpd: service-instance=EEVP_ServiceCreator_Provider_VCS_VehSpd, tcp-port=40066, udp-port=40066
package /ServiceInstance/Someip/Provider
  18 x provided someip service instance, all with sd-server-config=DefaultSdServerConfig:
    EEVP_ServiceCreator_Provider_BCM_ExteriorSignal: service-interface-deployment=BCM_ExteriorSignal, event-propss=[event=Notification_hornState, event=Notification_lightState], method-response-propss=[method=Get_hornState, Get_lightState], service-instance-id=1
      someip provided event group Eventgroup_Notification_hornState: event-group=Eventgroup_Notification_hornState, multicast-threshold=0, sd-server-event-group-timing-config=DefaultSdPublishConfig
      someip provided event group Eventgroup_Notification_lightState: event-group=Eventgroup_Notification_lightState, multicast-threshold=0, sd-server-event-group-timing-config=DefaultSdPublishConfig
    EEVP_ServiceCreator_Provider_BCM_WiperWash: service-interface-deployment=BCM_WiperWash, event-propss=[Notification_wiperInterval, Notification_wiperLevel], method-response-propss=[Get_wiperInterval, Get_wiperLevel, setWipingInterval, setWipingLevel, startWiping, stopWiping], service-instance-id=5005
      someip provided event group Eventgroup_Notification_wiperInterval: event-group=Eventgroup_Notification_wiperInterval, multicast-threshold=0
      someip provided event group Eventgroup_Notification_wiperLevel: event-group=Eventgroup_Notification_wiperLevel, multicast-threshold=0
    EEVP_ServiceCreator_Provider_Ctrl_MoodLamp: service-interface-deployment=Ctrl_MoodLamp, service-instance-id=9048
      method-response-propss:
        Ctrl_MoodLamp/turnOn
        Ctrl_MoodLamp/turnOff
        getPowerStatus
        setPowerStatus
        getBrightness
        setBrightness
        getColor
        setColor
    EEVP_ServiceCreator_Provider_Ctrl_RearCurtain: service-interface-deployment=Ctrl_RearCurtain, method-response-propss=[getOpeningRate, setOpeningRate], service-instance-id=9049
    EEVP_ServiceCreator_Provider_Snsr_FaceDetectModule: service-interface-deployment=Snsr_FaceDetectModule, method-response-propss=[Snsr_FaceDetectModule/turnOn, Snsr_FaceDetectModule/turnOff, Snsr_FaceDetectModule/isRunning, getEmotion], service-instance-id=9040
    EEVP_ServiceCreator_Provider_Snsr_Heartbeat: service-interface-deployment=Snsr_Heartbeat, someip-method-props=getHr, service-instance-id=9041
    EEVP_ServiceCreator_Provider_Snsr_USS: service-interface-deployment=Snsr_USS, method-response-propss=[ntfSonarInfo, ntfFltSt, isDetect], service-instance-id=9034
    EEVP_ServiceCreator_Provider_TMS_AC: service-interface-deployment=TMS_AC, method-response-propss=[TMS_AC/turnOn, TMS_AC/turnOff, TMS_AC/isRunning, setTargetTemp, getTargetTemp, getAirOutletTemp], service-instance-id=9042
    EEVP_ServiceCreator_Provider_TMS_EnvMonitor: service-interface-deployment=TMS_EnvMonitor, method-response-propss=[notifyHumidity, getTemp, notifyTemp, getHumidity, getLightIntensity, notifyLightIntensity], service-instance-id=9046
    EEVP_ServiceCreator_Provider_TMS_Fragrance: service-interface-deployment=TMS_Fragrance, service-instance-id=9045
      method-response-propss:
        TMS_Fragrance/turnOn
        TMS_Fragrance/turnOff
        TMS_Fragrance/isRunning
        setConcentration
        getConcentration
        setType
        getType
    EEVP_ServiceCreator_Provider_TMS_Purifier: service-interface-deployment=TMS_Purifier, method-response-propss=[TMS_Purifier/turnOn, TMS_Purifier/turnOff, TMS_Purifier/isRunning], service-instance-id=9044
    EEVP_ServiceCreator_Provider_TMS_Ventilation: service-interface-deployment=TMS_Ventilation, method-response-propss=[TMS_Ventilation/turnOn, TMS_Ventilation/turnOff, TMS_Ventilation/isRunning], service-instance-id=9043
    EEVP_ServiceCreator_Provider_VCS_AccrPedal: service-interface-deployment=VCS_AccrPedal, someip-method-props=notifyAccrPedal, service-instance-id=9003
    EEVP_ServiceCreator_Provider_VCS_Brake: service-interface-deployment=VCS_Brake, method-response-propss=[notifyMCPrs, setTargetAx, setTotalForce, notifyTq], service-instance-id=9032
    EEVP_ServiceCreator_Provider_VCS_BrakePedal: service-interface-deployment=VCS_BrakePedal, method-response-propss=[nofityBrakeSwitch, notifyBrakeStatus], service-instance-id=9002
    EEVP_ServiceCreator_Provider_VCS_EPB: service-interface-deployment=VCS_EPB, someip-method-props=notifystaticSlope, service-instance-id=9033
    EEVP_ServiceCreator_Provider_VCS_Gear: service-interface-deployment=VCS_Gear, method-response-propss=[notifyGear, method=setTarget], service-instance-id=9004
    EEVP_ServiceCreator_Provider_VCS_VehSpd: service-interface-deployment=VCS_VehSpd, someip-method-props=method=notifyVehSpd, service-instance-id=9001
package /ServiceInterface
  21 x service interface, all with major-version=1, minor-version=0:
    BCM_ExteriorSignal
      namespaces:
        symbol props eevp
        symbol props simulation
      field hornState: type=BCM_HornState, has-getter=true, has-notifier=true, has-setter=false
      field lightState: type=BCM_HeadlightState, has-getter=true, has-notifier=true, has-setter=false
    BCM_Horn
      namespaces:
        symbol props eevp
        symbol props simulation
      methods:
        operation Alert: fire-and-forget=false
          arg BCM_PeriodMode: type=uint8_t, direction=IN
        operation start: fire-and-forget=false
        operation stop: fire-and-forget=false
    BCM_WiperWash: category=COMMUNICATION_GROUP
      namespaces:
        symbol props eevp
        symbol props simulation
      field wiperInterval: type=uint16_t, has-getter=true, has-notifier=true, has-setter=false
      field wiperLevel: type=BCM_WipingLevel, has-getter=true, has-notifier=true, has-setter=false
      methods:
        4 x operation, all with fire-and-forget=false:
          setWipingInterval
            arg wipingInterval: type=uint16_t, direction=IN
            arg BCM_ReturnCode: type=BCM_ReturnCode, direction=OUT
          setWipingLevel
            arg wipingLevel: type=BCM_WipingLevel, direction=IN
            arg BCM_ReturnCode: type=BCM_ReturnCode, direction=OUT
          startWiping
            arg returnCode: type=BCM_ReturnCode, direction=OUT
          stopWiping
            arg returnCode: type=BCM_ReturnCode, direction=OUT
    Ctrl_MoodLamp
      namespaces:
        symbol props eevp
        symbol props simulation
      methods:
        8 x operation, all with fire-and-forget=false:
          getBrightness
            arg brightness: type=brightness, direction=OUT
          getColor
            arg color: type=color, direction=OUT
          getPowerStatus
            arg lampStatus: type=lampStatus, direction=OUT
          setBrightness
            arg brightness: type=brightness, direction=IN
            arg Ctrl_ReturnCode: type=Ctrl_ReturnCode, direction=OUT
          setColor
            arg color: type=color, direction=IN
            arg Ctrl_ReturnCode: type=Ctrl_ReturnCode, direction=OUT
          setPowerStatus
            arg lampStatus: type=lampStatus, direction=IN
            arg Ctrl_ReturnCode: type=Ctrl_ReturnCode, direction=OUT
          turnOff
            arg Ctrl_ReturnCode: type=Ctrl_ReturnCode, direction=OUT
          turnOn
            arg Ctrl_ReturnCode: type=Ctrl_ReturnCode, direction=OUT
    Ctrl_RearCurtain
      namespaces:
        symbol props eevp
        symbol props simulation
      methods:
        operation getOpeningRate: fire-and-forget=false
          arg rate: type=uint8_t, direction=OUT
        operation setOpeningRate: fire-and-forget=false
          arg rate: type=uint8_t, direction=IN
          arg Ctrl_ReturnCode: type=Ctrl_ReturnCode, direction=OUT
    DMS_Func
      namespaces:
        symbol props eevp
        symbol props simulation
      methods:
        operation isDetectDrowsy: fire-and-forget=false
          arg DMS_ReturnCode: type=DMS_ReturnCode, direction=OUT
    Snsr_FaceDetectModule
      namespaces:
        symbol props eevp
        symbol props simulation
      methods:
        4 x operation, all with fire-and-forget=false:
          getEmotion
            arg FDM_EmotionType: type=FDM_EmotionType, direction=OUT
          isRunning
            arg status: type=bool, direction=OUT
          turnOff
            arg FDM_ReturnCode: type=FDM_ReturnCode, direction=OUT
          turnOn
            arg FDM_ReturnCode: type=FDM_ReturnCode, direction=OUT
    Snsr_Heartbeat
      namespaces:
        symbol props eevp
        symbol props simulation
      methods:
        operation getHr: fire-and-forget=false
          arg hrStatus: type=uint32_t, direction=OUT
    Snsr_USS
      namespaces:
        symbol props eevp
        symbol props simulation
      methods:
        operation isDetect: fire-and-forget=false
          arg detect: type=bool, direction=OUT
        operation ntfFltSt: fire-and-forget=false
          arg ntfFltSt: type=uint8_t, direction=OUT
        operation ntfSonarInfo: fire-and-forget=false
          arg UssSonarinfo: type=USSSonarInfo, direction=OUT
    TMS_AC
      namespaces:
        symbol props eevp
        symbol props simulation
      methods:
        6 x operation, all with fire-and-forget=false:
          getAirOutletTemp
            arg outletId: type=uint8_t, direction=IN
            arg outletTemp: type=int16_t, direction=OUT
          getTargetTemp
            arg zoneId: type=uint8_t, direction=IN
            arg targetTemp: type=int16_t, direction=OUT
          isRunning
            arg status: type=bool, direction=OUT
          setTargetTemp
            arg zoneId: type=uint8_t, direction=IN
            arg targetTemp: type=int16_t, direction=IN
            arg TMS_ReturnCode: type=TMS_ReturnCode, direction=OUT
          turnOff
            arg TMS_ReturnCode: type=TMS_ReturnCode, direction=OUT
          turnOn
            arg TMS_ReturnCode: type=TMS_ReturnCode, direction=OUT
    TMS_EnvMonitor
      namespaces:
        symbol props eevp
        symbol props simulation
      methods:
        6 x operation, all with fire-and-forget=false:
          getHumidity
            arg zoneId: type=TMS_EnvZone, direction=IN
            arg humidity: type=uint8_t, direction=OUT
          getLightIntensity
            arg zoneId: type=TMS_EnvZone, direction=IN
            arg lightIntensity: type=uint16_t, direction=OUT
          getTemp
            arg zoneId: type=TMS_EnvZone, direction=IN
            arg temp: type=int16_t, direction=OUT
          notifyHumidity
            arg TMS_EnvZoneHumidityAry: type=TMS_EnvZoneHumidityAry, direction=OUT
          notifyLightIntensity
            arg TMS_EnvZoneLightIntensityAry: type=TMS_EnvZoneLightIntensityAry, direction=OUT
          notifyTemp
            arg TMS_EnvZoneTempAry: type=TMS_EnvZoneTempAry, direction=OUT
    TMS_Fragrance
      namespaces:
        symbol props eevp
        symbol props simulation
      methods:
        7 x operation, all with fire-and-forget=false:
          getConcentration
            arg concentration: type=uint16_t, direction=OUT
          getType
            arg TMS_FragranceType: type=TMS_FragranceType, direction=OUT
          isRunning
            arg state: type=bool, direction=OUT
          setConcentration
            arg concentration: type=uint16_t, direction=IN
            arg TMS_ReturnCode: type=TMS_ReturnCode, direction=OUT
          setType
            arg type: type=TMS_FragranceType, direction=IN
            arg TMS_ReturnCode: type=TMS_ReturnCode, direction=OUT
          turnOff
            arg TMS_ReturnCode: type=TMS_ReturnCode, direction=OUT
          turnOn
            arg TMS_ReturnCode: type=TMS_ReturnCode, direction=OUT
    TMS_Purifier
      namespaces:
        symbol props eevp
        symbol props simulation
      methods:
        operation isRunning: fire-and-forget=false
          arg status: type=bool, direction=OUT
        operation turnOff: fire-and-forget=false
          arg TMS_ReturnCode: type=TMS_ReturnCode, direction=OUT
        operation turnOn: fire-and-forget=false
          arg TMS_ReturnCode: type=TMS_ReturnCode, direction=OUT
    TMS_Ventilation
      namespaces:
        symbol props eevp
        symbol props simulation
      methods:
        operation isRunning: fire-and-forget=false
          arg status: type=bool, direction=OUT
        operation turnOff: fire-and-forget=false
          arg TMS_ReturnCode: type=TMS_ReturnCode, direction=OUT
        operation turnOn: fire-and-forget=false
          arg TMS_ReturnCode: type=TMS_ReturnCode, direction=OUT
    VCS_AccrPedal
      namespaces:
        symbol props eevp
        symbol props simulation
      methods:
        operation notifyAccrPedal: fire-and-forget=false
          arg VCS_AccrPedal: type=VCS_AccrPedal, direction=OUT
    VCS_Brake
      namespaces:
        symbol props eevp
        symbol props simulation
      methods:
        4 x operation, all with fire-and-forget=false:
          notifyMCPrs
            arg VCS_MCPrs: type=VCS_MCPrs, direction=OUT
          notifyTq
            arg VCS_TqCtrl: type=VCS_TqCtrl, direction=OUT
          setTargetAx
            arg ax: type=VCS_Acceleration, direction=IN
          setTotalForce
            arg lgtBrkFTotal: type=VCS_LgtBrkFTotal, direction=IN
    VCS_BrakePedal
      namespaces:
        symbol props eevp
        symbol props simulation
      methods:
        operation notifyBrakeStatus: fire-and-forget=false
          arg VCS_BrakePosn: type=VCS_BrakePosn, direction=OUT
        operation notifyBrakeSwitch: fire-and-forget=false
          arg VCS_BrakeSwitch: type=VCS_BrakeSwitch, direction=OUT
    VCS_EPB
      namespaces:
        symbol props eevp
        symbol props simulation
      methods:
        operation notifystaticSlope: fire-and-forget=false
          arg VCS_Slope: type=VCS_Slope, direction=OUT
    VCS_Gear
      namespaces:
        symbol props eevp
        symbol props simulation
      methods:
        operation notifyGear: fire-and-forget=false
          arg VCS_Gear: type=VCS_Gear, direction=OUT
        operation setTarget: fire-and-forget=false
          arg targetGear: type=VCS_Gear, direction=IN
          arg returnCode: type=bool, direction=OUT
    VCS_TqDmd
      namespaces:
        symbol props eevp
        symbol props simulation
      methods:
        operation setDrivePedalPosn: fire-and-forget=false
          arg drivePedalPosn: type=uint16_t, direction=IN
    VCS_VehSpd
      namespaces:
        symbol props eevp
        symbol props simulation
      methods:
        operation notifyVehSpd: fire-and-forget=false
          arg VCS_VehSpd: type=VCS_VehSpd, direction=OUT
