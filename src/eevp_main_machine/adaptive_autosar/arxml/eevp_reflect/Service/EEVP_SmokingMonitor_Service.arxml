AUTOSAR XML (schema 00049)
package /ServiceInstance/Endpoint
  5 x someip service instance to machine mapping, all with communication-connector=eth0:
    EEVP_SmokingMonitor_SomeipConsumers_SoaDms: service-instance=EEVP_SmokingMonitor_Consumer_SoaDms, tcp-port=40210, udp-port=40210
    EEVP_SmokingMonitor_SomeipConsumers_SoaHvac: service-instance=EEVP_SmokingMonitor_Consumer_SoaHvac, tcp-port=40212, udp-port=40212
    EEVP_SmokingMonitor_SomeipConsumers_SoaMlm: service-instance=EEVP_SmokingMonitor_Consumer_SoaMlm, tcp-port=40211, udp-port=40211
    EEVP_SmokingMonitor_SomeipConsumers_SoaSmartFilm: service-instance=EEVP_SmokingMonitor_Consumer_SoaSmartFilm, tcp-port=40213, udp-port=40213
    EEVP_SmokingMonitor_SomeipConsumers_SubscriptionManagement: service-instance=EEVP_SmokingMonitor_Consumer_SubscriptionManagement, tcp-port=40214, udp-port=40214
package /ServiceInstance/Someip/Consumer
  5 x required someip service instance, all with required-minor-version=ANY, required-service-instance-id=ANY, sd-client-config=DefaultSdClientConfig, version-driven-find-behavior=EXACT-OR-ANY-MINOR-VERSION:
    EEVP_SmokingMonitor_Consumer_SoaDms: service-interface-deployment=SoaDms, method-request-propss=[Get_soaDmsDeviceNormal, Get_soaDmsDriverStatus, Get_soaDmsStatus, Get_soaDmsSwVersion, SetDmsPower]
      7 x someip required event group, all with sd-client-event-group-timing-config=DefaultSdSubscribeConfig:
        Eventgroup_Notify_onDriverNotFocusing: event-group=Eventgroup_onDriverNotFocusing
        Eventgroup_Notify_onDriverNotWaken: event-group=Eventgroup_onDriverNotWaken
        Eventgroup_Notify_onDriverNotWatchingFront: event-group=Eventgroup_onDriverNotWatchingFront
        Eventgroup_Notify_soaDmsDeviceNormal: event-group=Eventgroup_Notify_soaDmsDeviceNormal
        Eventgroup_Notify_soaDmsDriverStatus: event-group=Eventgroup_Notify_soaDmsDriverStatus
        Eventgroup_Notify_soaDmsStatus: event-group=Eventgroup_Notify_soaDmsStatus
        Eventgroup_Notify_soaDmsSwVersion: event-group=Eventgroup_Notify_soaDmsSwVersion
    EEVP_SmokingMonitor_Consumer_SoaHvac: service-interface-deployment=SoaHvac
      method-request-propss:
        Get_soaHvacDeviceNormal
        Get_soaHvacSetting
        Get_soaHvacStatus
        Get_soaHvacSwVersion
        Get_soaHvacTemps
        SetAcOnOff
        SetAirSource
        SetAutoTemp
        SetBackwardDefrostOn
        SetBlowingDirection
        SetBlowingForce
        SetDriverTemp
        SetForwardDefrostOn
        SetHvacPower
        SetPassengerTemp
        SetSync
      5 x someip required event group, all with sd-client-event-group-timing-config=DefaultSdSubscribeConfig:
        Eventgroup_Notify_soaHvacDeviceNormal: event-group=Eventgroup_Notify_soaHvacDeviceNormal
        Eventgroup_Notify_soaHvacSetting: event-group=Eventgroup_Notify_soaHvacSetting
        Eventgroup_Notify_soaHvacStatus: event-group=Eventgroup_Notify_soaHvacStatus
        Eventgroup_Notify_soaHvacSwVersion: event-group=Eventgroup_Notify_soaHvacSwVersion
        Eventgroup_Notify_soaHvacTemps: event-group=Eventgroup_Notify_soaHvacTemps
    EEVP_SmokingMonitor_Consumer_SoaMlm: service-interface-deployment=SoaMlm, method-request-propss=[Get_soaMlmStatus, Get_soaMlmSwVersion, RequestMlmSetBrightness, RequestMlmSetRgbColor]
      someip required event group Eventgroup_Notification_soaMlmStatus: event-group=Eventgroup_Notification_soaMlmStatus, sd-client-event-group-timing-config=DefaultSdSubscribeConfig
      someip required event group Eventgroup_Notification_soaMlmSwVersion: event-group=Eventgroup_Notification_soaMlmSwVersion, sd-client-event-group-timing-config=DefaultSdSubscribeConfig
    EEVP_SmokingMonitor_Consumer_SoaSmartFilm: service-interface-deployment=SoaSmartFilm
      method-request-propss:
        Get_soaFilmAuto
        Get_soaFilmDeviceNormal
        Get_soaFilmOpacities
        Get_soaFilmSwVersion
        SetAllOpacities
        SetAuto
        SetOpacity
      4 x someip required event group, all with sd-client-event-group-timing-config=DefaultSdSubscribeConfig:
        Eventgroup_Notify_soaFilmAuto: event-group=Eventgroup_Notify_soaFilmAuto
        Eventgroup_Notify_soaFilmDeviceNormal: event-group=Eventgroup_Notify_soaFilmDeviceNormal
        Eventgroup_Notify_soaFilmOpacities: event-group=Eventgroup_Notify_soaFilmOpacities
        Eventgroup_Notify_soaFilmSwVersion: event-group=Eventgroup_Notify_soaFilmSwVersion
    EEVP_SmokingMonitor_Consumer_SubscriptionManagement: service-interface-deployment=SubscriptionManagement, someip-method-props=registerSubscriptionApp
      someip required event group Eventgroup_notifySubscriptionEvent: event-group=Eventgroup_notifySubscriptionEvent, sd-client-event-group-timing-config=DefaultSdSubscribeConfig
