AUTOSAR XML (schema 00049)
package /ServiceDeployment/Someip
  someip service interface deployment OtaMonitoring: service-interface=OtaMonitoring, service-interface-id=4883, service-interface-version={major-version=1, minor-version=0}
    someip event deployment notifyServiceEvent: event=notifyServiceEvent, event-id=11, transport-protocol=UDP
    someip event deployment notifyUpdatableService: event=notifyUpdatableService, event-id=12, transport-protocol=UDP
    someip event deployment resetUcmCompleted: event=resetUcmCompleted, event-id=13, transport-protocol=UDP
    4 x someip method deployment, all with transport-protocol=UDP:
      requestServiceInstall: method=requestServiceInstall, method-id=1
      requestServiceUpdate: method=requestServiceUpdate, method-id=2
      requestVersionInfo: method=OtaMonitoring/requestVersionInfo, method-id=3
      resetUcmTest: method=resetUcmTest, method-id=4
    someip event group Eventgroup_notifyServiceEvent: event-group-id=21, event=notifyServiceEvent
    someip event group Eventgroup_notifyUpdatableService: event-group-id=22, event=notifyUpdatableService
    someip event group Eventgroup_resetUcmCompleted: event-group-id=23, event=resetUcmCompleted
  someip service interface deployment OtaSubscription: service-interface=OtaSubscription, service-interface-id=4885, service-interface-version={major-version=1, minor-version=0}
    6 x someip event deployment, all with transport-protocol=UDP:
      notifyAppEvent: event=notifyAppEvent, event-id=11
      notifyResultInfo: event=notifyResultInfo, event-id=31
      notifyRollbackComplete: event=notifyRollbackComplete, event-id=22
      notifySwClusterInfo: event=notifySwClusterInfo, event-id=32
      notifyUpdatableApp: event=notifyUpdatableApp, event-id=12
      notifyUpdateComplete: event=notifyUpdateComplete, event-id=21
    5 x someip method deployment, all with transport-protocol=UDP:
      requestAppInstall: method=requestAppInstall, method-id=1
      requestAppRollback: method=requestAppRollback, method-id=11
      requestAppUpdate: method=requestAppUpdate, method-id=2
      requestOtaProcess: method=requestOtaProcess, method-id=4
      requestVersionInfo: method=OtaSubscription/requestVersionInfo, method-id=3
    5 x someip event group:
      Eventgroup_notifyAppEvent: event-group-id=21, event=notifyAppEvent
      Eventgroup_notifyResultInfo: event-group-id=41, event=notifyResultInfo
      Eventgroup_notifySwClusterInfo: event-group-id=51, event=notifySwClusterInfo
      Eventgroup_notifyUpdatableApp: event-group-id=22, event=notifyUpdatableApp
      Eventgroup_verifySubScription: event-group-id=31, event=[notifyRollbackComplete, notifyUpdateComplete]
package /ServiceInstance/Endpoint
  someip service instance to machine mapping EEVP_OTAClient_SomeipConsumers_VehiclePackageManagement: communication-connector=eth0, service-instance=EEVP_OTAClient_Consumer_VehiclePackageManagement, tcp-port=55032, udp-port=55032
  someip service instance to machine mapping EEVP_OTAClient_SomeipProviders_OtaMonitoring: communication-connector=eth0, service-instance=EEVP_OTAClient_Provider_OtaMonitoring, tcp-port=50031, udp-port=50031
  someip service instance to machine mapping EEVP_OTAClient_SomeipProviders_OtaSubscription: communication-connector=eth0, service-instance=EEVP_OTAClient_Provider_OtaSubscription, tcp-port=50041, udp-port=50041
package /ServiceInstance/Someip/Consumer
  required someip service instance EEVP_OTAClient_Consumer_VehiclePackageManagement: service-interface-deployment=VehiclePackageManagement, required-minor-version=ANY, required-service-instance-id=ANY, sd-client-config=UcmSdClientConfig, version-driven-find-behavior=EXACT-OR-ANY-MINOR-VERSION
    method-request-propss:
      Get_RequestedPackage
      Get_SafetyState
      Get_TransferState
      AllowCampaign
      CancelCampaign
      DeleteTransfer
      GetCampaignHistory
      GetSwClusterInfo
      GetSwPackages
      SwPackageInventory
      TransferData
      TransferExit
      TransferStart
      TransferVehiclePackage
    someip required event group Eventgroup_Notification_RequestedPackage: event-group=Eventgroup_Notification_RequestedPackage, sd-client-event-group-timing-config=UcmSdSubscribeConfig
    someip required event group Eventgroup_Notification_SafetyState: event-group=Eventgroup_Notification_SafetyState, sd-client-event-group-timing-config=UcmSdSubscribeConfig
    someip required event group Eventgroup_Notification_TransferState: event-group=Eventgroup_Notification_TransferState, sd-client-event-group-timing-config=UcmSdSubscribeConfig
package /ServiceInstance/Someip/Provider
  provided someip service instance EEVP_OTAClient_Provider_OtaMonitoring: service-interface-deployment=OtaMonitoring, event-propss=[notifyServiceEvent, notifyUpdatableService, resetUcmCompleted], method-response-propss=[requestServiceInstall, requestServiceUpdate, OtaMonitoring/requestVersionInfo, resetUcmTest], sd-server-config=DefaultSdServerConfig, service-instance-id=1
    someip provided event group Eventgroup_notifyServiceEvent: event-group=Eventgroup_notifyServiceEvent, multicast-threshold=0, sd-server-event-group-timing-config=DefaultSdPublishConfig
    someip provided event group Eventgroup_notifyUpdatableService: event-group=Eventgroup_notifyUpdatableService, multicast-threshold=0, sd-server-event-group-timing-config=DefaultSdPublishConfig
    someip provided event group Eventgroup_resetUcmCompleted: event-group=Eventgroup_resetUcmCompleted, multicast-threshold=0, sd-server-event-group-timing-config=DefaultSdPublishConfig
  provided someip service instance EEVP_OTAClient_Provider_OtaSubscription: service-interface-deployment=OtaSubscription, sd-server-config=DefaultSdServerConfig, service-instance-id=1
    event-propss:
      notifyAppEvent
      notifyUpdatableApp
      notifyUpdateComplete
      notifyRollbackComplete
      notifyResultInfo
      notifySwClusterInfo
    method-response-propss:
      requestAppInstall
      requestAppUpdate
      OtaSubscription/requestVersionInfo
      requestAppRollback
      requestOtaProcess
    5 x someip provided event group, all with multicast-threshold=0, sd-server-event-group-timing-config=DefaultSdPublishConfig:
      Eventgroup_notifyAppEvent: event-group=Eventgroup_notifyAppEvent
      Eventgroup_notifyResultInfo: event-group=Eventgroup_notifyResultInfo
      Eventgroup_notifySwClusterInfo: event-group=Eventgroup_notifySwClusterInfo
      Eventgroup_notifyUpdatableApp: event-group=Eventgroup_notifyUpdatableApp
      Eventgroup_verifySubScription: event-group=Eventgroup_verifySubScription
package /ServiceInterface
  service interface OtaMonitoring
    namespaces:
      4 x symbol props:
        eevp
        ota
        monitoring
        service
    events:
      data notifyServiceEvent: type=RequestServiceInfo
      data notifyUpdatableService: type=UpdatableServiceInfo
      data resetUcmCompleted: type=bool
    methods:
      4 x operation, all with fire-and-forget=false:
        requestServiceInstall
          arg serviceName: type=String, direction=IN
          arg returnValue: type=bool, direction=OUT
        requestServiceUpdate
          arg serviceName: type=String, direction=IN
          arg returnValue: type=bool, direction=OUT
        requestVersionInfo
          arg requestServiceInfoMap: type=RequestServiceInfoMap, direction=OUT
          arg returnValue: type=bool, direction=OUT
        resetUcmTest
  service interface OtaSubscription
    namespaces:
      4 x symbol props:
        eevp
        ota
        subscription
        service
    events:
      6 x data:
        notifyAppEvent: type=RequestAppInfo
        notifyResultInfo: type=resultInfoList
        notifyRollbackComplete: type=bool
        notifySwClusterInfo: type=swClusterInfoList
        notifyUpdatableApp: type=UpdatableAppInfo
        notifyUpdateComplete: type=bool
    methods:
      5 x operation, all with fire-and-forget=false:
        requestAppInstall
          arg appName: type=String, direction=IN
          arg returnValue: type=bool, direction=OUT
        requestAppRollback
        requestAppUpdate
          arg appName: type=String, direction=IN
          arg returnValue: type=bool, direction=OUT
        requestOtaProcess
          4 x arg:
            accessToken: type=String, direction=IN
            refreshToken: type=String, direction=IN
            downloadPackageInfo: type=downloadPackageInfoList, direction=IN
            returnValue: type=bool, direction=OUT
        requestVersionInfo
          arg requestAppInfoMap: type=RequestAppInfoMap, direction=OUT
          arg returnValue: type=bool, direction=OUT
