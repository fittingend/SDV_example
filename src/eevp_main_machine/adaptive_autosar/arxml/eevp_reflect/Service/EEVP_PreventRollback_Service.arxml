AUTOSAR XML (schema 00049)
package /ServiceInstance/Endpoint
  7 x someip service instance to machine mapping, all with communication-connector=eth0:
    EEVP_PreventRollback_SomeipConsumers_BCM_ExteriorSignal: service-instance=EEVP_PreventRollback_Consumer_BCM_ExteriorSignal, tcp-port=40302, udp-port=40302
    EEVP_PreventRollback_SomeipConsumers_Main_PDW_Service: service-instance=EEVP_PreventRollback_Consumer_Main_PDW_Service, tcp-port=40301, udp-port=40301
    EEVP_PreventRollback_SomeipConsumers_SoaVehicleInfo: service-instance=EEVP_PreventRollback_Consumer_SoaVehicleInfo, tcp-port=40304, udp-port=40304
    EEVP_PreventRollback_SomeipConsumers_SubscriptionManagement: service-instance=EEVP_PreventRollback_Consumer_SubscriptionManagement, tcp-port=40303, udp-port=40303
    EEVP_PreventRollback_SomeipConsumers_VCS_AccrPedal: service-instance=EEVP_PreventRollback_Consumer_VCS_AccrPedal, tcp-port=40306, udp-port=40306
    EEVP_PreventRollback_SomeipConsumers_VCS_BrakePedal: service-instance=EEVP_PreventRollback_Consumer_VCS_BrakePedal, tcp-port=40305, udp-port=40305
    EEVP_PreventRollback_SomeipConsumers_VCS_Gear: service-instance=EEVP_PreventRollback_Consumer_VCS_Gear, tcp-port=40307, udp-port=40307
package /ServiceInstance/Someip/Consumer
  7 x required someip service instance, all with required-minor-version=ANY, required-service-instance-id=ANY, sd-client-config=DefaultSdClientConfig, version-driven-find-behavior=EXACT-OR-ANY-MINOR-VERSION:
    EEVP_PreventRollback_Consumer_BCM_ExteriorSignal: service-interface-deployment=BCM_ExteriorSignal, method-request-propss=[Get_hornState, Get_lightState, Set_hornState, Set_hornState]
      someip required event group Eventgroup_Notification_hornState: event-group=Eventgroup_Notification_hornState, sd-client-event-group-timing-config=DefaultSdSubscribeConfig
      someip required event group Eventgroup_Notification_lightState: event-group=Eventgroup_Notification_lightState, sd-client-event-group-timing-config=DefaultSdSubscribeConfig
    EEVP_PreventRollback_Consumer_Main_PDW_Service: service-interface-deployment=Main_PDW_Service
      someip required event group Eventgroup_DistanceLevel: event-group=Eventgroup_DistanceLevel, sd-client-event-group-timing-config=DefaultSdSubscribeConfig
      someip required event group Eventgroup_UssStatus: event-group=Eventgroup_UssStatus, sd-client-event-group-timing-config=DefaultSdSubscribeConfig
    EEVP_PreventRollback_Consumer_SoaVehicleInfo: service-interface-deployment=SoaVehicleInfo, someip-method-props=Get_soaVehicleInfo
      someip required event group Eventgroup_Notification_soaVehicleInfo: event-group=Eventgroup_Notification_soaVehicleInfo, sd-client-event-group-timing-config=DefaultSdSubscribeConfig
    EEVP_PreventRollback_Consumer_SubscriptionManagement: service-interface-deployment=SubscriptionManagement
      someip required event group Eventgroup_notifySubscriptionEvent: event-group=Eventgroup_notifySubscriptionEvent, sd-client-event-group-timing-config=DefaultSdSubscribeConfig
    EEVP_PreventRollback_Consumer_VCS_AccrPedal: service-interface-deployment=VCS_AccrPedal, someip-method-props=notifyAccrPedal
    EEVP_PreventRollback_Consumer_VCS_BrakePedal: service-interface-deployment=VCS_BrakePedal, method-request-propss=[nofityBrakeSwitch, notifyBrakeStatus]
    EEVP_PreventRollback_Consumer_VCS_Gear: service-interface-deployment=VCS_Gear, method-request-propss=[notifyGear, setTarget]
