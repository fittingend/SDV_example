AUTOSAR XML (schema 00049)
package /Machine
  machine EEVP_Main_Machine: machine-design=EEVP_MAIN, trusted-platform-executable-launch-behavior=NO-TRUSTED-PLATFORM-SUPPORT
    module-instantiations:
      log and trace instantiation LOG: dlt-ecu-id=EEVP
        36 x dlt log channel, all with log-trace-log-modes=[CONSOLE, NETWORK]:
          AppIpsvTest: application-id=IPSV, context-id=IPSV, log-trace-default-log-level=INFO
          BatteryMonitor: application-id=BTMN, context-id=BTMN, log-trace-default-log-level=INFO
          BmsInfo: application-id=BMIN, context-id=BMIN, log-trace-default-log-level=INFO
          CM: application-id=CM, context-id=CM, log-trace-default-log-level=ERROR
          DummyTest_Consumer: application-id=TCON, context-id=TCON, log-trace-default-log-level=INFO
          DummyTest_Provider: application-id=TPRV, context-id=TPRV, log-trace-default-log-level=INFO
          EM: application-id=EM, context-id=EM, log-trace-default-log-level=ERROR
          IPCHandler: application-id=IPCH, context-id=CTX0, log-trace-default-log-level=INFO
          InfoHealthTest: application-id=HEAL, context-id=HEAL, log-trace-default-log-level=INFO
          IntelligentWiper: application-id=ITWP, context-id=ITWP, log-trace-default-log-level=INFO
          KATECH: application-id=KATC, context-id=KATC, log-trace-default-log-level=INFO
          LIT: application-id=LIT, context-id=LIT, log-trace-default-log-level=INFO
          MonitoringManager: application-id=MONM, context-id=MONM, log-trace-default-log-level=INFO
          OTAClient: application-id=OTAC, context-id=OTAC, log-trace-default-log-level=INFO
          OTATestP: application-description=OTA Test PPort Applicatoin, application-id=OTAP, context-id=OTAP, log-trace-default-log-level=INFO
          OTATestR: application-description=OTA Test RPort Applicatoin, application-id=OTAR, context-id=OTAR, log-trace-default-log-level=INFO
          PHM: application-id=PHM, context-id=PHM, log-trace-default-log-level=ERROR, non-verbose-mode=true
          SC_PDW_FRONT: application-id=PDWF, context-id=PDWF, log-trace-default-log-level=INFO
          SC_PDW_REAR: application-id=PDWR, context-id=PDWR, log-trace-default-log-level=INFO
          SM: application-id=SM, context-id=SM, log-trace-default-log-level=INFO
          SOA_DMS: application-id=SDMS, context-id=SDMS, log-trace-default-log-level=INFO
          SOA_Debugger: application-id=SDBG, context-id=SDBG, log-trace-default-log-level=INFO
          SOA_DriverSeat: application-id=SDST, context-id=SDST, log-trace-default-log-level=INFO
          SOA_HVAC: application-id=SHVC, context-id=SHVC, log-trace-default-log-level=INFO
          SOA_MoodLamp: application-id=SMLM, context-id=SMLM, log-trace-default-log-level=INFO
          SOA_Power: application-id=SPWR, context-id=SPWR, log-trace-default-log-level=INFO
          SOA_ROA: application-id=SROA, context-id=SROA, log-trace-default-log-level=INFO
          SOA_RearCurtain: application-id=SRCT, context-id=SRCT, log-trace-default-log-level=INFO
          SOA_SmartFilm: application-id=SSFM, context-id=SSFM, log-trace-default-log-level=INFO
          SOA_Wiper: application-id=SWIP, context-id=SWIP, log-trace-default-log-level=INFO
          ServiceCreator: application-id=SVCT, context-id=SVCT, log-trace-default-log-level=INFO
          SmokingMonitor: application-id=SKMN, context-id=SKMN, log-trace-default-log-level=INFO
          SubscriptionManager: application-id=SUSM, context-id=SUSM, log-trace-default-log-level=INFO
          UCM: application-id=UCM, context-id=UCM, log-trace-default-log-level=ERROR
          VDI: application-id=VDI, context-id=VDI, log-trace-default-log-level=INFO
          VUCM: application-id=VUCM, context-id=VUCM, log-trace-default-log-level=ERROR
      os module instantiation POSIX
        resource group DefaultResourceGroup
      ucm module instantiation UCM: identifier=EEVP_UCM
    processor S32G2
      4 x processor core:
        Core{0..3}: core-id={0..3}
package /Machine/FunctionGroup
  function group set EEVP_Main_FunctionGroup
    function-groups:
      23 x mode declaration group prototype:
        MachineFG: type=MachineState
        OTATestFG: type=OTATestState
        SC: type=SCState
        SFG{01..20}: type=SFG{01..20}
package /Machine/PlatformHealth
  platform health management contribution EEVP_Main_PHM
  phm contribution to machine mapping EEVP_Main_PhmContributionToMachineMapping: machine=EEVP_Main_Machine, phm-contribution=EEVP_Main_PHM
package /Machine/ProcessToMachine
  process to machine mapping set EEVP_Main_ProcessToMachineMapping
    37 x process to machine mapping:
      ProcessToMachineMapping_AppIpsvTest_TO_EEVP_Main_Machine_TO_UnknownModule: machine=EEVP_Main_Machine, process=AppIpsvTest
      ProcessToMachineMapping_BatteryMonitor_TO_EEVP_Main_Machine_TO_UnknownModule: machine=EEVP_Main_Machine, process=BatteryMonitor
      ProcessToMachineMapping_BmsInfo_TO_EEVP_Main_Machine_TO_UnknownModule: machine=EEVP_Main_Machine, process=BmsInfo
      ProcessToMachineMapping_CM_TO_EEVP_Machine_TO_UnknownModule: machine=EEVP_Main_Machine, process=CM
      ProcessToMachineMapping_DummyTest_Consumer_TO_EEVP_Main_Machine_TO_UnknownModule: design=ProcessDesignToMachineDesignMapping_TestDummy_Consumer_TO_EEVP_MAIN, machine=EEVP_Main_Machine, process=DummyTest_Consumer
      ProcessToMachineMapping_DummyTest_Provider_TO_EEVP_Main_Machine_TO_UnknownModule: design=ProcessDesignToMachineDesignMapping_TestDummy_Provider_TO_EEVP_MAIN, machine=EEVP_Main_Machine, process=DummyTest_Provider
      ProcessToMachineMapping_EM_TO_EEVP_Machine_TO_UnknownModule: machine=EEVP_Main_Machine, process=EM
      ProcessToMachineMapping_IPCHandler_TO_EEVP_Main_Machine_TO_UnknownModule: machine=EEVP_Main_Machine, process=IPCHandler
      ProcessToMachineMapping_InfoHealthTest_TO_EEVP_Main_Machine_TO_UnknownModule: machine=EEVP_Main_Machine, process=InfoHealthTest
      ProcessToMachineMapping_IntelligentWiper_TO_EEVP_Main_Machine_TO_UnknownModule: machine=EEVP_Main_Machine, process=IntelligentWiper
      ProcessToMachineMapping_KATECH_TO_EEVP_Main_Machine_TO_UnknownModule: machine=EEVP_Main_Machine, process=KATECH
      ProcessToMachineMapping_LIT_TO_EEVP_Main_Machine_TO_UnknownModule: machine=EEVP_Main_Machine, process=LIT
      ProcessToMachineMapping_MonitoringManager_TO_EEVP_Main_Machine_TO_UnknownModule: machine=EEVP_Main_Machine, process=MonitoringManager
      ProcessToMachineMapping_OTAClient_TO_EEVP_Main_Machine_TO_UnknownModule: machine=EEVP_Main_Machine, process=OTAClient
      ProcessToMachineMapping_OTATestP_TO_EEVP_Main_Machine_TO_UnknownModule: machine=EEVP_Main_Machine, process=OTATestP
      ProcessToMachineMapping_OTATestR_TO_EEVP_Main_Machine_TO_UnknownModule: machine=EEVP_Main_Machine, process=OTATestR
      ProcessToMachineMapping_PHM_TO_EEVP_Machine_TO_UnknownModule: machine=EEVP_Main_Machine, process=PHM
      ProcessToMachineMapping_SC_PDW_FRONT_TO_EEVP_Main_Machine_TO_UnknownModule: machine=EEVP_Main_Machine, process=SC_PDW_FRONT
      ProcessToMachineMapping_SC_PDW_REAR_TO_EEVP_Main_Machine_TO_UnknownModule: machine=EEVP_Main_Machine, process=SC_PDW_REAR
      ProcessToMachineMapping_SM_TO_EEVP_Main_Machine_TO_UnknownModule: machine=EEVP_Main_Machine, process=SM
      ProcessToMachineMapping_SOA_DMS_TO_EEVP_Main_Machine_TO_UnknownModule: machine=EEVP_Main_Machine, process=SOA_DMS
      ProcessToMachineMapping_SOA_Debugger_TO_EEVP_Main_Machine_TO_UnknownModule: machine=EEVP_Main_Machine, process=SOA_Debugger
      ProcessToMachineMapping_SOA_DriverSeat_TO_EEVP_Main_Machine_TO_UnknownModule: machine=EEVP_Main_Machine, process=SOA_DriverSeat
      ProcessToMachineMapping_SOA_HVAC_TO_EEVP_Main_Machine_TO_UnknownModule: machine=EEVP_Main_Machine, process=SOA_HVAC
      ProcessToMachineMapping_SOA_MoodLamp_TO_EEVP_Main_Machine_TO_UnknownModule: machine=EEVP_Main_Machine, process=SOA_MoodLamp
      ProcessToMachineMapping_SOA_Power_TO_EEVP_Main_Machine_TO_UnknownModule: machine=EEVP_Main_Machine, process=SOA_Power
      ProcessToMachineMapping_SOA_ROA_TO_EEVP_Main_Machine_TO_UnknownModule: machine=EEVP_Main_Machine, process=SOA_ROA
      ProcessToMachineMapping_SOA_RearCurtain_TO_EEVP_Main_Machine_TO_UnknownModule: machine=EEVP_Main_Machine, process=SOA_RearCurtain
      ProcessToMachineMapping_SOA_SmartFilm_TO_EEVP_Main_Machine_TO_UnknownModule: machine=EEVP_Main_Machine, process=SOA_SmartFilm
      ProcessToMachineMapping_SOA_Wiper_TO_EEVP_Main_Machine_TO_UnknownModule: machine=EEVP_Main_Machine, process=SOA_Wiper
      ProcessToMachineMapping_ServiceCreator_TO_EEVP_Main_Machine_TO_UnknownModule: machine=EEVP_Main_Machine, process=ServiceCreator
      ProcessToMachineMapping_SmokingMonitor_TO_EEVP_Main_Machine_TO_UnknownModule: machine=EEVP_Main_Machine, process=SmokingMonitor
      ProcessToMachineMapping_SubscriptionManager_TO_EEVP_Main_Machine_TO_UnknownModule: machine=EEVP_Main_Machine, process=SubscriptionManager
      ProcessToMachineMapping_UCM_TO_EEVP_Machine_TO_UnknownModule: machine=EEVP_Main_Machine, process=UCM
      ProcessToMachineMapping_UnknownProcess_TO_UnknownMachine_TO_UnknownModule
      ProcessToMachineMapping_VDI_TO_EEVP_Main_Machine_TO_UnknownModule: machine=EEVP_Main_Machine, process=VDI
      ProcessToMachineMapping_VUCM_TO_EEVP_Main_Machine_TO_UnknownModule: machine=EEVP_Main_Machine, process=VUCM
  process design to machine design mapping set ProcessDesignToMachineDesignMappingSet
    process design to machine design mapping ProcessDesignToMachineDesignMapping_AppIpsvTest_Consumer_TO_EEVP_MAIN: machine-design=EEVP_MAIN, process-design=AppIpsvTest_Consumer
    process design to machine design mapping ProcessDesignToMachineDesignMapping_TestDummy_Consumer_TO_EEVP_MAIN: machine-design=EEVP_MAIN, process-design=TestDummy_Consumer
    process design to machine design mapping ProcessDesignToMachineDesignMapping_TestDummy_Provider_TO_EEVP_MAIN: machine-design=EEVP_MAIN, process-design=TestDummy_Provider
package /StateMachine
  24 x mode declaration group:
    MachineState: initial-mode=MachineState/Off
      5 x mode:
        Off
        Restart
        Shutdown
        Startup
        Verify
    OTATestState: initial-mode=OTATestState/Off
      mode Off
      mode On
      mode Verify
    ProcessState: initial-mode=Idle
      4 x mode:
        Idle
        Running
        Starting
        Terminated
    SCState: initial-mode=SCState/Off
      mode Off
      mode On
      mode Verify
    SFG01: initial-mode=SFG01/Off
      mode Off
      mode On
      mode Verify
    SFG02: initial-mode=SFG02/Off
      mode Off
      mode On
      mode Verify
    SFG03: initial-mode=SFG03/Off
      mode Off
      mode On
      mode Verify
    SFG04: initial-mode=SFG04/Off
      mode Off
      mode On
      mode Verify
    SFG05: initial-mode=SFG05/Off
      mode Off
      mode On
      mode Verify
    SFG06: initial-mode=SFG06/Off
      mode Off
      mode On
      mode Verify
    SFG07: initial-mode=SFG07/Off
      mode Off
      mode On
      mode Verify
    SFG08: initial-mode=SFG08/Off
      mode Off
      mode On
      mode Verify
    SFG09: initial-mode=SFG09/Off
      mode Off
      mode On
      mode Verify
    SFG10: initial-mode=SFG10/Off
      mode Off
      mode On
      mode Verify
    SFG11: initial-mode=SFG11/Off
      mode Off
      mode On
      mode Verify
    SFG12: initial-mode=SFG12/Off
      mode Off
      mode On
      mode Verify
    SFG13: initial-mode=SFG13/Off
      mode Off
      mode On
      mode Verify
    SFG14: initial-mode=SFG14/Off
      mode Off
      mode On
      mode Verify
    SFG15: initial-mode=SFG15/Off
      mode Off
      mode On
      mode Verify
    SFG16: initial-mode=SFG16/Off
      mode Off
      mode On
      mode Verify
    SFG17: initial-mode=SFG17/Off
      mode Off
      mode On
      mode Verify
    SFG18: initial-mode=SFG18/Off
      mode Off
      mode On
      mode Verify
    SFG19: initial-mode=SFG19/Off
      mode Off
      mode On
      mode Verify
    SFG20: initial-mode=SFG20/Off
      mode Off
      mode On
      mode Verify
