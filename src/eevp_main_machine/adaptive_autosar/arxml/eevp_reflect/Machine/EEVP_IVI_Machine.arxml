AUTOSAR XML (schema 00049)
package /Machine
  machine EEVP_IVI_Machine: machine-design=EEVP_IVI, trusted-platform-executable-launch-behavior=NO-TRUSTED-PLATFORM-SUPPORT
    module-instantiations:
      log and trace instantiation LOG: dlt-ecu-id=IVI
        dlt log channel IVI_MonitoringApp: application-id=IVIM, context-id=IVIM, log-trace-default-log-level=INFO, log-trace-log-modes=CONSOLE
      os module instantiation POSIX
        resource group DefaultResourceGroup
    processor CPU
      8 x processor core:
        Core{0..7}: core-id={0..7}
package /Machine/FunctionGroup
  function group set EEVP_IVI_FunctionGroup
    function-groups:
      mode declaration group prototype MachineFG: type=MachineState
package /Machine/ProcessToMachine
  process to machine mapping set EEVP_IVI_ProcessToMachineMapping
    process to machine mapping ProcessToMachineMapping_IVI_MonitoringApp_TO_EEVP_IVI_Machine_TO_UnknownModule: machine=EEVP_IVI_Machine, process=IVI_MonitoringApp
