AUTOSAR XML (schema 00049)
package /Machine
  machine EEVP_ADAS_Machine: machine-design=EEVP_ADAS, trusted-platform-executable-launch-behavior=NO-TRUSTED-PLATFORM-SUPPORT
    module-instantiations:
      log and trace instantiation LOG: dlt-ecu-id=ADAS
      os module instantiation POSIX
        resource group DefaultResourceGroup
    processor CPU
      4 x processor core:
        Core{0..3}: core-id={0..3}
package /Machine/FunctionGroup
  function group set EEVP_ADAS_FunctionGroup
    function-groups:
      mode declaration group prototype MachineFG: type=MachineState
package /Machine/ProcessToMachine
  process to machine mapping set EEVP_ADAS_ProcessToMachineMapping
