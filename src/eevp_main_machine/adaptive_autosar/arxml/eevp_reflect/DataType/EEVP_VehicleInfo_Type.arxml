AUTOSAR XML (schema 00049)
package /DataType/CppImplementationType
  std cpp implementation data type VehicleInfo: category=STRUCTURE
    namespaces:
      symbol props zone
      symbol props input
      symbol props type
    5 x cpp implementation data type element:
      VehicleSpeed: type-reference=uint16_t
      GearState: type-reference=uint8_t
      ACC_In: type-reference=uint8_t
      IGN1_In: type-reference=uint8_t
      IGN2_In: type-reference=uint8_t
