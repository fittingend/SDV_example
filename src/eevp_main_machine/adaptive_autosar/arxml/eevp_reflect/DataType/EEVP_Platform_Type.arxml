AUTOSAR XML (schema 00049)
package /DataType/BaseType
  11 x std cpp implementation data type, all with category=VALUE:
    bool: type-emitter=FundamentalType
    double: type-emitter=FundamentalType
    float: type-emitter=FundamentalType
    int16_t: header-file=cstdint
    int32_t: header-file=cstdint
    int64_t: header-file=cstdint
    int8_t: header-file=cstdint
    uint16_t: header-file=cstdint
    uint32_t: header-file=cstdint
    uint64_t: header-file=cstdint
    uint8_t: header-file=cstdint
package /DataType/FunctionalClusterType
  37 x std cpp implementation data type:
    ActionType: compu {0x00=kUpdate, 0x01=kInstall, 0x02=kRemove}, type-reference=uint8_t
      namespaces:
        symbol props ara
        symbol props ucm
    ByteVectorType: category=VECTOR, cpp-template-argument=uint8_t
      namespaces:
        symbol props ara
        symbol props ucm
    CampaignErrorType: category=STRUCTURE
      namespaces:
        symbol props ara
        symbol props ucm
      cpp implementation data type element CampaignFailure: type-reference=CampaignFailureType
      cpp implementation data type element UCMStepError: type-reference=UCMStepErrorType
    CampaignFailureType: compu {0x01=kUCMError, 0x02=kInvalidVehiclePackageManifest, 0x03=kSubordinateNotAvailableOnTheNetwork, 0x04=kVehicleStateManagerCommunicationError, 0x05=kVehicleDriverInterfaceCommunicationError, 0x06=kCampaignCancelled}, type-reference=uint8_t
      namespaces:
        symbol props ara
        symbol props ucm
    CampaignHistoryType: category=STRUCTURE
      namespaces:
        symbol props ara
        symbol props ucm
      cpp implementation data type element CampaignError: type-reference=CampaignErrorType
      cpp implementation data type element HistoryVector: type-reference=HistoryVectorType
    CampaignStateType: compu {0x00=kIdle, 0x01=kSyncing, 0x02=kVehiclePackageTransferring, 0x03=kSoftwarePackageTransferring, 0x04=kProcessing, 0x05=kActivating, 0x06=kVehicleChecking, 0x07=kCancelling}, type-reference=uint8_t
      namespaces:
        symbol props ara
        symbol props ucm
    FGNameType: category=STRING
      namespaces:
        symbol props ara
        symbol props sm
    FunctionGroupList: category=VECTOR, cpp-template-argument=FGNameType
      namespaces:
        symbol props ara
        symbol props sm
    GetHistoryType: category=STRUCTURE
      namespaces:
        symbol props ara
        symbol props ucm
      5 x cpp implementation data type element:
        Time: type-reference=uint64_t
        Name: type-reference=SwNameType
        Version: type-reference=StrongRevisionLabelString
        Action: type-reference=ActionType
        Resolution: type-reference=ResultType
    GetHistoryVectorType: category=VECTOR, cpp-template-argument=GetHistoryType
      namespaces:
        symbol props ara
        symbol props ucm
    HistoryVectorType: category=STRUCTURE
      namespaces:
        symbol props ara
        symbol props ucm
      cpp implementation data type element id: type-reference=UCMIdentifierType
      cpp implementation data type element HistoryVector: type-reference=GetHistoryVectorType
    LicenseString: category=STRING
      namespaces:
        symbol props ara
        symbol props ucm
    MachineState: compu {0x00=kOff, 0x01=kStartup, 0x02=kShutdown, 0x03=kRestart, 0x04=kVerify}, type-reference=uint8_t
      namespaces:
        symbol props ara
        symbol props sm
    NetworkStateType: compu {0=kNoCom, 1=kFullCom}, type-reference=uint8_t
      namespaces:
        symbol props ara
        symbol props nm
    PackageManagerStatusType: compu {0x00=kIdle, 0x01=kReady, 0x02=kProcessing, 0x03=kActivating, 0x04=kActivated, 0x05=kRollingBack, 0x06=kRolledBack, 0x07=kCleaningUp, 0x08=kVerifying}, type-reference=uint8_t
      namespaces:
        symbol props ara
        symbol props ucm
    ReleaseNotesString: category=STRING
      namespaces:
        symbol props ara
        symbol props ucm
    ResultType: compu {0x00=kSuccessfull, 0x01=kFailed}, type-reference=uint8_t
      namespaces:
        symbol props ara
        symbol props ucm
    SafetyPolicyType: category=STRING
      namespaces:
        symbol props ara
        symbol props ucm
    SoftwarePackageStepType: compu {0x00=kTransfer, 0x01=kProcess, 0x02=kPreActivate, 0x03=kVerify}, type-reference=uint8_t
      namespaces:
        symbol props ara
        symbol props ucm
    StrongRevisionLabelString: category=STRING
      namespaces:
        symbol props ara
        symbol props ucm
    SwClusterInfoType: category=STRUCTURE
      namespaces:
        symbol props ara
        symbol props ucm
      cpp implementation data type element Name: type-reference=SwNameType
      cpp implementation data type element Version: type-reference=StrongRevisionLabelString
      cpp implementation data type element State: type-reference=SwClusterStateType
    SwClusterInfoVectorType: category=VECTOR, cpp-template-argument=SwClusterInfoType
      namespaces:
        symbol props ara
        symbol props ucm
    SwClusterStateType: compu {0x00=kPresent, 0x01=kAdded, 0x02=kUpdated, 0x03=kRemoved}, type-reference=uint8_t
      namespaces:
        symbol props ara
        symbol props ucm
    SwDescType: category=STRUCTURE
      namespaces:
        symbol props ara
        symbol props ucm
      6 x cpp implementation data type element:
        Name: type-reference=SwNameType
        Version: type-reference=StrongRevisionLabelString
        TypeApproval: type-reference=TypeApprovalString
        License: type-reference=LicenseString
        ReleaseNotes: type-reference=ReleaseNotesString
        Size: type-reference=uint64_t
    SwDescVectorType: category=VECTOR, cpp-template-argument=SwDescType
      namespaces:
        symbol props ara
        symbol props ucm
    SwNameType: category=STRING
      namespaces:
        symbol props ara
        symbol props ucm
    SwNameVectorType: category=VECTOR, cpp-template-argument=SwNameType
      namespaces:
        symbol props ara
        symbol props ucm
    SwNameVersionType: category=STRUCTURE
      namespaces:
        symbol props ara
        symbol props ucm
      cpp implementation data type element Name: type-reference=SwNameType
      cpp implementation data type element Version: type-reference=StrongRevisionLabelString
    SwNameVersionVectorType: category=VECTOR, cpp-template-argument=SwNameVersionType
      namespaces:
        symbol props ara
        symbol props ucm
    SwPackageInfoType: category=STRUCTURE
      namespaces:
        symbol props ara
        symbol props ucm
      6 x cpp implementation data type element:
        Name: type-reference=SwNameType
        Version: type-reference=StrongRevisionLabelString
        TransferID: type-reference=TransferIdType
        ConsecutiveBytesReceived: type-reference=uint64_t
        ConsecutiveBlocksReceived: type-reference=uint64_t
        State: type-reference=SwPackageStateType
    SwPackageInfoVectorType: category=VECTOR, cpp-template-argument=SwPackageInfoType
      namespaces:
        symbol props ara
        symbol props ucm
    SwPackageStateType: compu {0x00=kTransferring, 0x01=kTransferred, 0x02=kProcessing, 0x03=kProcessed, 0x04=kProcessingStream}, type-reference=uint8_t
      namespaces:
        symbol props ara
        symbol props ucm
    TransferIdType: category=ARRAY, array-size=16, cpp-template-argument=uint8_t
      namespaces:
        symbol props ara
        symbol props ucm
    TransferStateType: compu {0x00=kIdle, 0x01=kTransferring, 0x02=kUpdating, 0x03=kCancelling}, type-reference=uint8_t
      namespaces:
        symbol props ara
        symbol props ucm
    TypeApprovalString: category=STRING
      namespaces:
        symbol props ara
        symbol props ucm
    UCMIdentifierType: category=STRING
      namespaces:
        symbol props ara
        symbol props ucm
    UCMStepErrorType: category=STRUCTURE
      namespaces:
        symbol props ara
        symbol props ucm
      cpp implementation data type element id: type-reference=UCMIdentifierType
      cpp implementation data type element SoftwarePackageStep: type-reference=SoftwarePackageStepType
      cpp implementation data type element ReturnedError: type-reference=uint64_t
