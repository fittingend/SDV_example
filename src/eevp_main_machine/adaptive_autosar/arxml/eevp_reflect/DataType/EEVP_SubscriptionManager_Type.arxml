AUTOSAR XML (schema 00049)
package /DataType/CppImplementationType
  std cpp implementation data type SubscriptionInfo: category=STRUCTURE
    namespaces:
      symbol props eevp
      symbol props subscription
      symbol props type
    cpp implementation data type element appName: type-reference=String
    cpp implementation data type element isSubscription: type-reference=bool
