AUTOSAR XML (schema 00049)
package /DataType/CppImplementationType
  std cpp implementation data type ArithmeticType: compu {0=Add, 1=Sub, 2=Mul, 3=Div}, type-reference=uint8_t
    namespaces:
      symbol props test
      symbol props dummy
  std cpp implementation data type DeviceInfo: category=STRUCTURE
    namespaces:
      symbol props test
      symbol props dummy
    cpp implementation data type element DeviceNum: type-reference=int16_t
    cpp implementation data type element DeviceState: type-reference=bool
  std cpp implementation data type TString: category=STRING
    namespaces:
      symbol props test
      symbol props dummy
