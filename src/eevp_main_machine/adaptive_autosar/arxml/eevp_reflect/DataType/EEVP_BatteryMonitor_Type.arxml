AUTOSAR XML (schema 00049)
package /DataType/CppImplementationType
  std cpp implementation data type Struct_BmsInfo: category=STRUCTURE
    namespaces:
      symbol props eevp
      symbol props bmsinfo
    26 x cpp implementation data type element, all with type-reference=uint32_t:
      InterfaceIDforDbg
      DataSerialNumber
      VehicleUniqueSnr
      EMS_BatteryAvgTemperature
      EMS_ChargerOutputVolt
      EMS_ChargerOutputCurr
      EMS_ReturnCode
      EMS_ConnectionStatus
      EMS_TargetVolt
      EMS_TargetCurr
      EMS_RemainHour
      EMS_RemainMin
      EMS_HVBattSOC
      EMS_HVBattSOE
      EMS_HVBattSOH
      EMS_BattVolt
      EMS_BattCurr
      EMS_Obc_dcVolt
      EMS_Obc_dcCurr
      EMS_Avn_ChargeCurrSetSts
      EMS_HvBatt_MainRlyCloseReq
      EMS_HvBatt_preChrgRlyStatus
      EMS_HvBatt_posRlyStatus
      EMS_HvBatt_negRlyStatus
      EMS_Avn_DcChargingTartgetSetSts
      EMS_Avn_AcChargingTartgetSetSts
