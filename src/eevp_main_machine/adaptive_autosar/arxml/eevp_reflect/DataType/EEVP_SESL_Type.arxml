AUTOSAR XML (schema 00049)
package /DataType/CppImplementationType
  std cpp implementation data type SeslDataType: category=STRUCTURE
    namespaces:
      symbol props eevp
      symbol props sesl
      symbol props type
    7 x cpp implementation data type element:
      Fwd_Distance: type-reference=double
      Rear_Distance: type-reference=double
      Accel: type-reference=bool
      Brake: type-reference=double
      Beep: type-reference=bool
      Beep_Large: type-reference=bool
      Light: type-reference=bool
