AUTOSAR XML (schema 00049)
package /ServiceInterface
  6 x service interface:
    NetworkState
      namespaces:
        symbol props ara
        symbol props nm
      field NetworkCurrentType: type=NetworkStateType, has-getter=true, has-notifier=true, has-setter=false
      field NetworkRequestedType: type=NetworkStateType, has-getter=true, has-notifier=true, has-setter=true
    PackageManagement
      namespaces:
        symbol props ara
        symbol props ucm
        symbol props pkgmgr
      field CurrentStatus: type=PackageManagerStatusType, has-getter=true, has-notifier=true, has-setter=false
      methods:
        17 x operation, all with fire-and-forget=false:
          Activate: possible-ap-error=[MissingDependencies, OperationNotPermitted, PreActivationFailed, UpdateSessionRejected, VerificationFailed]
          Cancel: possible-ap-error=[CancelFailed, InvalidTransferId, OperationNotPermitted]
            arg id: type=TransferIdType, direction=IN
          DeleteTransfer: possible-ap-error=[InvalidTransferId, OperationNotPermitted]
            arg id: type=TransferIdType, direction=IN
          Finish: possible-ap-error=OperationNotPermitted
          GetHistory
            arg timestampGE: type=uint64_t, direction=IN
            arg timestampLT: type=uint64_t, direction=IN
            arg history: type=GetHistoryVectorType, direction=OUT
          GetId
            arg id: type=UCMIdentifierType, direction=OUT
          GetSwClusterChangeInfo
            arg SwInfo: type=SwClusterInfoVectorType, direction=OUT
          GetSwClusterDescription
            arg SwCluster: type=SwDescVectorType, direction=OUT
          GetSwClusterInfo
            arg SwInfo: type=SwClusterInfoVectorType, direction=OUT
          GetSwPackages
            arg Packages: type=SwClusterInfoVectorType, direction=OUT
          GetSwProcessProgress: possible-ap-error=InvalidTransferId
            arg id: type=TransferIdType, direction=IN
            arg progress: type=uint8_t, direction=OUT
          ProcessSwPackage: possible-ap-error=[AuthenticationFailed, IncompatibleDelta, IncompatiblePackageVersion, InsufficientComputationPower, InsufficientMemory, InvalidPackageManifest, InvalidTransferId, OperationNotPermitted, ProcessSwPackageCancelled, ProcessedSoftwarePackageInconsistent, ServiceBusy]
            arg id: type=TransferIdType, direction=IN
          RevertProcessedSwPackages: possible-ap-error=[NotAbleToRevertPackages, OperationNotPermitted]
          Rollback: possible-ap-error=[NotAbleToRollback, OperationNotPermitted]
          TransferData: possible-ap-error=[AuthenticationFailed, BlockInconsistent, IncompatiblePackageVersion, IncorrectBlock, IncorrectBlockSize, IncorrectSize, InsufficientComputationPower, InsufficientMemory, InvalidTransferId, OperationNotPermitted, PackageInconsistent, TransferInterrupted]
            arg id: type=TransferIdType, direction=IN
            arg data: type=ByteVectorType, direction=IN
            arg blockCounter: type=uint64_t, direction=IN
          TransferExit: possible-ap-error=[AuthenticationFailed, IncompatiblePackageVersion, InsufficientData, InvalidPackageManifest, InvalidTransferId, MissingDependencies, OldVersion, OperationNotPermitted, PackageInconsistent]
            arg id: type=TransferIdType, direction=IN
          TransferStart: possible-ap-error=[InsufficientComputationPower, InsufficientMemory]
            arg size: type=uint64_t, direction=IN
            arg id: type=TransferIdType, direction=OUT
            arg BlockSize: type=uint32_t, direction=OUT
    TriggerInOut_MachineFG
      namespaces:
        symbol props ara
        symbol props sm
        symbol props machinefg
      field Notifier: type=MachineState, has-getter=true, has-notifier=true, has-setter=false
      field Trigger: type=MachineState, has-getter=false, has-notifier=false, has-setter=true
    UpdateRequest
      namespaces:
        symbol props ara
        symbol props sm
      methods:
        6 x operation:
          PrepareRollback: fire-and-forget=false, possible-ap-error=[kRejected, kRollbackFailed]
            arg FunctionGroupList: type=FunctionGroupList, direction=IN
          PrepareUpdate: fire-and-forget=false, possible-ap-error=[kPrepareFailed, kRejected]
            arg FunctionGroupList: type=FunctionGroupList, direction=IN
          ResetMachine: fire-and-forget=false, possible-ap-error=kRejected
          StartUpdateSession: fire-and-forget=false, possible-ap-error=kRejected
          StopUpdateSession: fire-and-forget=true
          VerifyUpdate: fire-and-forget=false, possible-ap-error=[kRejected, kVerifyFailed]
            arg FunctionGroupList: type=FunctionGroupList, direction=IN
    VehicleDriverApplication
      namespaces:
        symbol props ara
        symbol props vucm
        symbol props driver
      4 x field, all with has-getter=true, has-notifier=true, has-setter=false:
        ApprovalRequired: type=bool
        CampaignState: type=CampaignStateType
        SafetyPolicy: type=SafetyPolicyType
        SafetyState: type=bool
      methods:
        8 x operation, all with fire-and-forget=false:
          AllowCampaign
          CancelCampaign: possible-ap-error=[CancelFailed, InvalidTransferId, OperationNotPermitted]
            arg DisableCampaign: type=bool, direction=IN
          DriverApproval
            arg Approval: type=bool, direction=IN
            arg SafetyPolicy: type=SafetyPolicyType, direction=IN
          GetCampaignHistory
            arg timestampGE: type=uint64_t, direction=IN
            arg timestampLT: type=uint64_t, direction=IN
            arg history: type=CampaignHistoryType, direction=OUT
          GetSwClusterDescription
            arg SoftwareClusterDescriptions: type=SwDescVectorType, direction=OUT
          GetSwPackageDescription
            arg Packages: type=SwDescVectorType, direction=OUT
          GetSwProcessProgress
            arg progress: type=uint8_t, direction=OUT
          GetSwTransferProgress
            arg progress: type=uint8_t, direction=OUT
    VehiclePackageManagement
      namespaces:
        symbol props ara
        symbol props vucm
        symbol props pkgmgr
      field RequestedPackage: type=SwNameVersionType, has-getter=true, has-notifier=true, has-setter=false
      field SafetyState: type=bool, has-getter=true, has-notifier=true, has-setter=false
      field TransferState: type=TransferStateType, has-getter=true, has-notifier=true, has-setter=false
      methods:
        11 x operation, all with fire-and-forget=false:
          AllowCampaign
          CancelCampaign: possible-ap-error=[CancelFailed, InvalidTransferId, OperationNotPermitted]
            arg DisableCampaign: type=bool, direction=IN
          DeleteTransfer
            arg id: type=TransferIdType, direction=IN
          GetCampaignHistory
            arg timestampGE: type=uint64_t, direction=IN
            arg timestampLT: type=uint64_t, direction=IN
            arg CampaignHistory: type=CampaignHistoryType, direction=OUT
          GetSwClusterInfo
            arg SwInfo: type=SwClusterInfoVectorType, direction=OUT
          GetSwPackages
            arg Packages: type=SwPackageInfoVectorType, direction=OUT
          SwPackageInventory
            arg AvailableSoftwarePackages: type=SwNameVersionVectorType, direction=IN
            arg RequiredSoftwarePackages: type=SwNameVersionVectorType, direction=OUT
          TransferData: possible-ap-error=[AuthenticationFailed, BlockInconsistent, IncompatiblePackageVersion, IncorrectBlock, IncorrectBlockSize, IncorrectSize, InsufficientComputationPower, InsufficientMemory, InvalidTransferId, OperationNotPermitted, PackageInconsistent, TransferInterrupted]
            arg id: type=TransferIdType, direction=IN
            arg data: type=ByteVectorType, direction=IN
            arg blockCounter: type=uint64_t, direction=IN
          TransferExit: possible-ap-error=[AuthenticationFailed, IncompatiblePackageVersion, InsufficientData, InvalidPackageManifest, InvalidTransferId, MissingDependencies, OldVersion, OperationNotPermitted, PackageInconsistent]
            arg id: type=TransferIdType, direction=IN
          TransferStart: possible-ap-error=[InsufficientComputationPower, InsufficientMemory, UnexpectedPackage]
            4 x arg:
              SoftwarePackageName: type=SwNameType, direction=IN
              id: type=TransferIdType, direction=OUT
              size: type=uint64_t, direction=OUT
              BlockSize: type=uint32_t, direction=OUT
          TransferVehiclePackage: possible-ap-error=[InsufficientMemory, NewCampaignDisabled]
            arg size: type=uint64_t, direction=IN
            arg id: type=TransferIdType, direction=OUT
            arg BlockSize: type=uint32_t, direction=OUT
package /ServiceInterface/ErrorDomain
  23 x ap application error, all with error-domain=UCMErrorDomain:
    AuthenticationFailed: error-code=8
    BlockInconsistent: error-code=25
    CancelFailed: error-code=16
    IncompatibleDelta: error-code=29
    IncompatiblePackageVersion: error-code=24
    IncorrectBlock: error-code=2
    IncorrectBlockSize: error-code=30
    IncorrectSize: error-code=3
    InsufficientComputationPower: error-code=28
    InsufficientData: error-code=6
    InsufficientMemory: error-code=1
    InvalidPackageManifest: error-code=13
    InvalidTransferId: error-code=4
    MissingDependencies: error-code=21
    NewCampaignDisabled: error-code=31
    NotAbleToRevertPackages: error-code=15
    NotAbleToRollback: error-code=18
    OldVersion: error-code=9
    OperationNotPermitted: error-code=5
    PackageInconsistent: error-code=7
    PreActivationFailed: error-code=19
    ProcessSwPackageCancelled: error-code=22
    ProcessedSoftwarePackageInconsistent: error-code=23
  ap application error domain SMErrorDomain: value=13835058055282163729
  ap application error ServiceBusy: error-code=12, error-domain=UCMErrorDomain
  ap application error TransferInterrupted: error-code=26, error-domain=UCMErrorDomain
  ap application error domain UCMErrorDomain: value=13835058055282164000
  7 x ap application error:
    UnexpectedPackage: error-code=32, error-domain=UCMErrorDomain
    UpdateSessionRejected: error-code=33, error-domain=UCMErrorDomain
    VerificationFailed: error-code=27, error-domain=UCMErrorDomain
    kPrepareFailed: error-code=7, error-domain=SMErrorDomain
    kRejected: error-code=5, error-domain=SMErrorDomain
    kRollbackFailed: error-code=8, error-domain=SMErrorDomain
    kVerifyFailed: error-code=6, error-domain=SMErrorDomain
package /ServiceDeployment/Someip
  5 x someip service interface deployment, all with service-interface-version={major-version=1, minor-version=0}:
    PackageManagement: service-interface=PackageManagement, service-interface-id=4866
      someip field deployment CurrentStatus: field=CurrentStatus
        get Get_CurrentStatus: method-id=21, transport-protocol=TCP
        notifier Notification_CurrentStatus: event-id=22, transport-protocol=TCP
      17 x someip method deployment, all with transport-protocol=TCP:
        Activate: method=Activate, method-id=1
        Cancel: method=Cancel, method-id=2
        DeleteTransfer: method=PackageManagement/DeleteTransfer, method-id=3
        Finish: method=Finish, method-id=4
        GetHistory: method=GetHistory, method-id=5
        GetId: method=GetId, method-id=6
        GetSwClusterChangeInfo: method=GetSwClusterChangeInfo, method-id=7
        GetSwClusterDescription: method=PackageManagement/GetSwClusterDescription, method-id=8
        GetSwClusterInfo: method=PackageManagement/GetSwClusterInfo, method-id=9
        GetSwPackages: method=PackageManagement/GetSwPackages, method-id=10
        GetSwProcessProgress: method=PackageManagement/GetSwProcessProgress, method-id=11
        ProcessSwPackage: method=ProcessSwPackage, method-id=12
        RevertProcessedSwPackages: method=RevertProcessedSwPackages, method-id=13
        Rollback: method=Rollback, method-id=14
        TransferData: method=PackageManagement/TransferData, method-id=15
        TransferExit: method=PackageManagement/TransferExit, method-id=16
        TransferStart: method=PackageManagement/TransferStart, method-id=17
      someip event group Eventgroup_Notification_CurrentStatus: event-group-id=1, event=Notification_CurrentStatus
    TriggerInOut_MachineFG: service-interface=TriggerInOut_MachineFG, service-interface-id=4869
      someip field deployment Notifier: field=Notifier
        get Get_Notifier: method-id=1, transport-protocol=UDP
        notifier Notification_Notifier: event-id=2, transport-protocol=UDP
      someip field deployment Trigger: field=Trigger
        set Set_Trigger: method-id=3, transport-protocol=UDP
      someip event group Eventgroup_Notification_Notifier: event-group-id=1, event=Notification_Notifier
    UpdateRequest: service-interface=UpdateRequest, service-interface-id=4865
      6 x someip method deployment, all with transport-protocol=UDP:
        PrepareRollback: method=PrepareRollback, method-id=1
        PrepareUpdate: method=PrepareUpdate, method-id=2
        ResetMachine: method=ResetMachine, method-id=3
        StartUpdateSession: method=StartUpdateSession, method-id=4
        StopUpdateSession: method=StopUpdateSession, method-id=5
        VerifyUpdate: method=VerifyUpdate, method-id=6
    VehicleDriverApplication: service-interface=VehicleDriverApplication, service-interface-id=4867
      4 x someip field deployment:
        ApprovalRequired: field=ApprovalRequired
          get Get_ApprovalRequired: method-id=21, transport-protocol=UDP
          notifier Notification_ApprovalRequired: event-id=22, transport-protocol=UDP
        CampaignState: field=CampaignState
          get Get_CampaignState: method-id=23, transport-protocol=UDP
          notifier Notification_CampaignState: event-id=24, transport-protocol=UDP
        SafetyPolicy: field=SafetyPolicy
          get Get_SafetyPolicy: method-id=25, transport-protocol=UDP
          notifier Notification_SafetyPolicy: event-id=26, transport-protocol=UDP
        SafetyState: field=VehicleDriverApplication/SafetyState
          get Get_SafetyState: method-id=27, transport-protocol=UDP
          notifier Notification_SafetyState: event-id=28, transport-protocol=UDP
      8 x someip method deployment, all with transport-protocol=UDP:
        AllowCampaign: method=VehicleDriverApplication/AllowCampaign, method-id=1
        CancelCampaign: method=VehicleDriverApplication/CancelCampaign, method-id=2
        DriverApproval: method=DriverApproval, method-id=3
        GetCampaignHistory: method=VehicleDriverApplication/GetCampaignHistory, method-id=4
        GetSwClusterDescription: method=VehicleDriverApplication/GetSwClusterDescription, method-id=5
        GetSwPackageDescription: method=GetSwPackageDescription, method-id=6
        GetSwProcessProgress: method=VehicleDriverApplication/GetSwProcessProgress, method-id=7
        GetSwTransferProgress: method=GetSwTransferProgress, method-id=8
      4 x someip event group:
        Eventgroup_Notification_ApprovalRequired: event-group-id=1, event=Notification_ApprovalRequired
        Eventgroup_Notification_CampaignState: event-group-id=2, event=Notification_CampaignState
        Eventgroup_Notification_SafetyPolicy: event-group-id=3, event=Notification_SafetyPolicy
        Eventgroup_Notification_SafetyState: event-group-id=4, event=SafetyState/Notification_SafetyState
    VehiclePackageManagement: service-interface=VehiclePackageManagement, service-interface-id=4868
      someip field deployment RequestedPackage: field=RequestedPackage
        get Get_RequestedPackage: method-id=21, transport-protocol=TCP
        notifier Notification_RequestedPackage: event-id=21, transport-protocol=TCP
      someip field deployment SafetyState: field=VehiclePackageManagement/SafetyState
        get Get_SafetyState: method-id=22, transport-protocol=TCP
        notifier Notification_SafetyState: event-id=22, transport-protocol=TCP
      someip field deployment TransferState: field=TransferState
        get Get_TransferState: method-id=23, transport-protocol=TCP
        notifier Notification_TransferState: event-id=23, transport-protocol=TCP
      11 x someip method deployment, all with transport-protocol=TCP:
        AllowCampaign: method=VehiclePackageManagement/AllowCampaign, method-id=1
        CancelCampaign: method=VehiclePackageManagement/CancelCampaign, method-id=2
        DeleteTransfer: method=VehiclePackageManagement/DeleteTransfer, method-id=3
        GetCampaignHistory: method=VehiclePackageManagement/GetCampaignHistory, method-id=4
        GetSwClusterInfo: method=VehiclePackageManagement/GetSwClusterInfo, method-id=5
        GetSwPackages: method=VehiclePackageManagement/GetSwPackages, method-id=6
        SwPackageInventory: method=SwPackageInventory, method-id=7
        TransferData: method=VehiclePackageManagement/TransferData, method-id=8
        TransferExit: method=VehiclePackageManagement/TransferExit, method-id=9
        TransferStart: method=VehiclePackageManagement/TransferStart, method-id=10
        TransferVehiclePackage: method=TransferVehiclePackage, method-id=11
      someip event group Eventgroup_Notification_RequestedPackage: event-group-id=1, event=Notification_RequestedPackage
      someip event group Eventgroup_Notification_SafetyState: event-group-id=2, event=SafetyState/Notification_SafetyState
      someip event group Eventgroup_Notification_TransferState: event-group-id=3, event=Notification_TransferState
package /ServiceInstance/Endpoint
  5 x someip service instance to machine mapping, all with communication-connector=eth0:
    EEVP_Platform_SomeipConsumers_SM: service-instance=[EEVP_Platform_Consumer_TriggerInOut_MachineFG, EEVP_Platform_Consumer_UpdateRequest], tcp-port=55003, udp-port=55003
    EEVP_Platform_SomeipConsumers_UCM: service-instance=EEVP_Platform_Consumer_PackageManagement, tcp-port=55002, udp-port=55002
    EEVP_Platform_SomeipProviders_SM: service-instance=[EEVP_Platform_Provider_TriggerInOut_MachineFG, EEVP_Platform_Provider_UpdateRequest], tcp-port=50003, udp-port=50003
    EEVP_Platform_SomeipProviders_UCM: service-instance=EEVP_Platform_Provider_PackageManagement, tcp-port=50001, udp-port=50001
    EEVP_Platform_SomeipProviders_VUCM: service-instance=[EEVP_Platform_Provider_VehicleDriverApplication, EEVP_Platform_Provider_VehiclePackageManagement], tcp-port=50002, udp-port=50002
package /ServiceInstance/SdTimingConfig/Client
  someip sd client service instance config DefaultSdClientConfig: initial-find-behavior={initial-delay-max-value=0.1, initial-delay-min-value=0.01, initial-repetitions-base-delay=0.1, initial-repetitions-max=3}, service-find-time-to-live=16777215
  someip sd client service instance config SmSdClientConfig: initial-find-behavior={initial-delay-max-value=0.0, initial-delay-min-value=0.0, initial-repetitions-base-delay=0.1, initial-repetitions-max=3}, service-find-time-to-live=16777215
  someip sd client service instance config UcmSdClientConfig: initial-find-behavior={initial-delay-max-value=0.0, initial-delay-min-value=0.0, initial-repetitions-base-delay=0.1, initial-repetitions-max=3}, service-find-time-to-live=16777215
package /ServiceInstance/SdTimingConfig/Server
  someip sd server service instance config DefaultSdServerConfig: initial-offer-behavior={initial-delay-max-value=0.1, initial-delay-min-value=0.01, initial-repetitions-base-delay=0.1, initial-repetitions-max=3}, offer-cyclic-delay=2.0, request-response-delay={max-value=0.0, min-value=0.0}, service-offer-time-to-live=16777215
  someip sd server service instance config SmSdServerConfig: initial-offer-behavior={initial-delay-max-value=0.0, initial-delay-min-value=0.0, initial-repetitions-base-delay=0.0, initial-repetitions-max=0}, offer-cyclic-delay=0.5, request-response-delay={max-value=0.0, min-value=0.0}, service-offer-time-to-live=16777215
  someip sd server service instance config UcmSdServerConfig: initial-offer-behavior={initial-delay-max-value=0.0, initial-delay-min-value=0.0, initial-repetitions-base-delay=0.0, initial-repetitions-max=0}, offer-cyclic-delay=1.0, request-response-delay={max-value=0.0, min-value=0.0}, service-offer-time-to-live=16777215
package /ServiceInstance/SdTimingConfig/Subscription
  someip sd server event group timing config DefaultSdPublishConfig: request-response-delay={max-value=0.0, min-value=0.0}
  someip sd client event group timing config DefaultSdSubscribeConfig: request-response-delay={max-value=0.0, min-value=0.0}, time-to-live=16777215
  someip sd server event group timing config SmSdPublishConfig: request-response-delay={max-value=0.0, min-value=0.0}
  someip sd client event group timing config SmSdSubscribeConfig: request-response-delay={max-value=0.0, min-value=0.0}, time-to-live=16777215
  someip sd server event group timing config UcmSdPublishConfig: request-response-delay={max-value=0.0, min-value=0.0}
  someip sd client event group timing config UcmSdSubscribeConfig: request-response-delay={max-value=0.0, min-value=0.0}, subscribe-eventgroup-retry-delay=0.0, subscribe-eventgroup-retry-max=0, time-to-live=16777215
package /ServiceInstance/Someip/Consumer
  5 x required someip service instance, all with required-minor-version=ANY, required-service-instance-id=ANY, version-driven-find-behavior=EXACT-OR-ANY-MINOR-VERSION:
    EEVP_Platform_Consumer_PackageManagement: service-interface-deployment=PackageManagement, sd-client-config=UcmSdClientConfig
      someip required event group Eventgroup_Notification_CurrentStatus: event-group=Eventgroup_Notification_CurrentStatus, sd-client-event-group-timing-config=UcmSdSubscribeConfig
    EEVP_Platform_Consumer_TriggerInOut_MachineFG: service-interface-deployment=TriggerInOut_MachineFG, sd-client-config=SmSdClientConfig
      someip required event group Eventgroup_Notification_Notifier: event-group=Eventgroup_Notification_Notifier, sd-client-event-group-timing-config=SmSdSubscribeConfig
    EEVP_Platform_Consumer_UpdateRequest: service-interface-deployment=UpdateRequest, sd-client-config=SmSdClientConfig
    EEVP_Platform_Consumer_VehicleDriverApplication: service-interface-deployment=VehicleDriverApplication, sd-client-config=UcmSdClientConfig
      4 x someip required event group, all with sd-client-event-group-timing-config=UcmSdSubscribeConfig:
        Eventgroup_Notification_ApprovalRequired: event-group=Eventgroup_Notification_ApprovalRequired
        Eventgroup_Notification_CampaignState: event-group=Eventgroup_Notification_CampaignState
        Eventgroup_Notification_SafetyPolicy: event-group=Eventgroup_Notification_SafetyPolicy
        Eventgroup_Notification_SafetyState: event-group=VehicleDriverApplication/Eventgroup_Notification_SafetyState
    EEVP_Platform_Consumer_VehiclePackageManagement: service-interface-deployment=VehiclePackageManagement, sd-client-config=UcmSdClientConfig
      someip required event group Eventgroup_Notification_RequestedPackage: event-group=Eventgroup_Notification_RequestedPackage, sd-client-event-group-timing-config=UcmSdSubscribeConfig
      someip required event group Eventgroup_Notification_SafetyState: event-group=VehiclePackageManagement/Eventgroup_Notification_SafetyState, sd-client-event-group-timing-config=UcmSdSubscribeConfig
      someip required event group Eventgroup_Notification_TransferState: event-group=Eventgroup_Notification_TransferState, sd-client-event-group-timing-config=UcmSdSubscribeConfig
package /ServiceInstance/Someip/Provider
  5 x provided someip service instance, all with service-instance-id=1:
    EEVP_Platform_Provider_PackageManagement: service-interface-deployment=PackageManagement, sd-server-config=UcmSdServerConfig
      someip provided event group Eventgroup_Notification_CurrentStatus: event-group=Eventgroup_Notification_CurrentStatus, multicast-threshold=0, sd-server-event-group-timing-config=UcmSdPublishConfig
    EEVP_Platform_Provider_TriggerInOut_MachineFG: service-interface-deployment=TriggerInOut_MachineFG, sd-server-config=SmSdServerConfig
      someip provided event group Eventgroup_Notification_Notifier: event-group=Eventgroup_Notification_Notifier, multicast-threshold=0, sd-server-event-group-timing-config=SmSdPublishConfig
    EEVP_Platform_Provider_UpdateRequest: service-interface-deployment=UpdateRequest, sd-server-config=SmSdServerConfig
    EEVP_Platform_Provider_VehicleDriverApplication: service-interface-deployment=VehicleDriverApplication, sd-server-config=UcmSdServerConfig
      4 x someip provided event group, all with multicast-threshold=0, sd-server-event-group-timing-config=UcmSdPublishConfig:
        Eventgroup_Notification_ApprovalRequired: event-group=Eventgroup_Notification_ApprovalRequired
        Eventgroup_Notification_CampaignState: event-group=Eventgroup_Notification_CampaignState
        Eventgroup_Notification_SafetyPolicy: event-group=Eventgroup_Notification_SafetyPolicy
        Eventgroup_Notification_SafetyState: event-group=VehicleDriverApplication/Eventgroup_Notification_SafetyState
    EEVP_Platform_Provider_VehiclePackageManagement: service-interface-deployment=VehiclePackageManagement, sd-server-config=UcmSdServerConfig
      someip provided event group Eventgroup_Notification_RequestedPackage: event-group=Eventgroup_Notification_RequestedPackage, multicast-threshold=0, sd-server-event-group-timing-config=UcmSdPublishConfig
      someip provided event group Eventgroup_Notification_SafetyState: event-group=VehiclePackageManagement/Eventgroup_Notification_SafetyState, multicast-threshold=0, sd-server-event-group-timing-config=UcmSdPublishConfig
      someip provided event group Eventgroup_Notification_TransferState: event-group=Eventgroup_Notification_TransferState, multicast-threshold=0, sd-server-event-group-timing-config=UcmSdPublishConfig
