AUTOSAR XML (schema 00049)
package /Application/DltConfig
  dlt log channel to process mapping DltLogChannelToProcessMapping_InfoHealthTest_TO_InfoHealthTest: dlt-log-channel=InfoHealthTest, process=InfoHealthTest
package /Application/Executable
  executable InfoHealthTest: category=APPLICATION_LEVEL, logging-behavior=USES-LOGGING, reporting-behavior=REPORTS-EXECUTION-STATE, version=1.0.0
    root sw component prototype AA: application-type=InfoHealthTest
package /Application/Manifest
  service instance to port prototype mapping InfoHealthTest_AA_RPortAdasInfoHealth: port-prototype=AA.RPortAdasInfoHealth, service-instance=EEVP_InfoHealthTest_Consumer_AdasInfoHealth
package /Application/Process
  process InfoHealthTest: executable=InfoHealthTest, state-dependent-startup-config{execution-dependency=SM.Running, function-group-state=MachineFG.Startup, resource-group=DefaultResourceGroup, startup-config=InfoHealthTest}
    process state machine InfoHealthTest: type=ProcessState
package /Application/StartupConfig
  startup config set EEVP_InfoHealthTest_StartupConfig
    startup config InfoHealthTest: scheduling-policy=SCHED_OTHER, scheduling-priority=0, timeout={enter-timeout-value=2.0, exit-timeout-value=2.0}
package /Application/SwComponent
  adaptive application sw component type InfoHealthTest
    require port RPortAdasInfoHealth: required-interface=AdasInfoHealth
