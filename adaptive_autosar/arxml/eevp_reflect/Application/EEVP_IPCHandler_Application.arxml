AUTOSAR XML (schema 00049)
package /Application/DltConfig
  dlt log channel to process mapping DltLogChannelToProcessMapping_IPCHandler_TO_IPCHandler: dlt-log-channel=IPCHandler, process=IPCHandler
package /Application/Executable
  executable IPCHandler: category=PLATFORM_LEVEL, logging-behavior=USES-LOGGING, reporting-behavior=REPORTS-EXECUTION-STATE, version=1.0.0
    root sw component prototype RootSwComponent: application-type=IPCHandler_RoutingIPC
package /Application/Manifest
  service instance to port prototype mapping IPCHandler_RootSwComponent_IPCHandler: port-prototype=RootSwComponent.IPCHandler, service-instance=EEVP_IPCHandler_Provider_Main_IPC_RoutingIPC
  service instance to port prototype mapping SM_PARA_IPCHandler: port-prototype=PARA.IPCHandler, service-instance=EEVP_IPCHandler_Consumer_Main_IPC_RoutingIPC
package /Application/Process
  process IPCHandler: executable=IPCHandler, state-dependent-startup-config{execution-dependency=CM.Running, function-group-state=MachineFG.Startup, resource-group=DefaultResourceGroup, startup-config=IPCHandler}
    process state machine IPCHandler: type=ProcessState
package /Application/StartupConfig
  startup config set EEVP_IPCHandler_StartupConfig
    startup config IPCHandler: scheduling-policy=SCHED_OTHER, scheduling-priority=0, timeout={enter-timeout-value=1.0, exit-timeout-value=1.0}
package /Application/SwComponent
  adaptive application sw component type IPCHandler_RoutingIPC
    provide port IPCHandler: provided-interface=Main_IPC_RoutingIPC
