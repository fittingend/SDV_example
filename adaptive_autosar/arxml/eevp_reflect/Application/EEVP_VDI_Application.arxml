AUTOSAR XML (schema 00049)
package /Application/DltConfig
  dlt log channel to process mapping DltLogChannelToProcessMapping_VDI_TO_VDI: dlt-log-channel=VDI, process=VDI
package /Application/Executable
  executable VDI: category=APPLICATION_LEVEL, reporting-behavior=REPORTS-EXECUTION-STATE, version=1.0.0
    root sw component prototype RootSwComponent: application-type=VDI
package /Application/Manifest
  service instance to port prototype mapping VDI_RootSwComponent_RPort0: port-prototype=RootSwComponent.VDI, service-instance=EEVP_Platform_Consumer_VehicleDriverApplication
package /Application/Process
  process VDI: executable=VDI, state-dependent-startup-config{execution-dependency=VUCM.Running, function-group-state=MachineFG.Startup, resource-group=DefaultResourceGroup, startup-config=DefaultStartupConfig}
    process state machine VDI: type=ProcessState
package /Application/SwComponent
  adaptive application sw component type VDI
    require port VDI: required-interface=VehicleDriverApplication
