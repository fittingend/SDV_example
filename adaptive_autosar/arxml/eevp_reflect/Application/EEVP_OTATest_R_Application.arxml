AUTOSAR XML (schema 00049)
package /Application/DltConfig
  dlt log channel to process mapping DltLogChannelToProcessMapping_OTATestR_TO_OTATestR: dlt-log-channel=OTATestR, process=OTATestR
package /Application/Executable
  executable OTATestR: category=APPLICATION_LEVEL, reporting-behavior=REPORTS-EXECUTION-STATE, version=1.0.0
    root sw component prototype RootSwComponent: application-type=OTATestR
package /Application/Manifest
  service instance to port prototype mapping OTATestR_RootSwComponent_OTATestR: port-prototype=RootSwComponent.OTATestR, service-instance=EEVP_Consumer_Main_OTA_Test
package /Application/Package
  software package Main_OTATestR_InstallSoftwarePackage_1_0_0: action-type=INSTALL, compressed-software-package-size=0, maximum-supported-ucm-version=1.0.0, minimum-supported-ucm-version=1.0.0, packager-id=79, packager-signature=ParaCertificate, post-verification-reboot=false, pre-activate=OTATestFG.Off, pre-activation-reboot=false, software-cluster=Main_OTATestR_SoftwareCluster_1_0_0/Main_OTATestR_SoftwareCluster, uncompressed-software-cluster-size=0, verify=OTATestFG.Verify
  vehicle package Main_OTATestR_InstallVehiclePackage_1_0_0: packager-signature=ParaCertificate
    rollout-qualifications:
      vehicle rollout step RolloutQualification0
        ucm-processings:
          ucm step UcmProcessing0: ucm=Main_OTATestR_InstallVehiclePackage_1_0_0/EEVP_UCM
            software package step SoftwarePackageStep0: process=Main_OTATestR_InstallSoftwarePackage_1_0_0, transfers=software-package-storing={storing=UCM, transfer=Main_OTATestR_InstallSoftwarePackage_1_0_0}
    ucm description EEVP_UCM: identifier=EEVP_UCM
  software package Main_OTATestR_RemoveSoftwarePackage_1_0_2: action-type=REMOVE, compressed-software-package-size=0, maximum-supported-ucm-version=1.0.0, minimum-supported-ucm-version=1.0.0, packager-id=79, packager-signature=ParaCertificate, post-verification-reboot=false, pre-activate=OTATestFG.Off, pre-activation-reboot=false, software-cluster=Main_OTATest_SoftwareCluster_1_0_2/Main_OTATestR_SoftwareCluster, uncompressed-software-cluster-size=0, verify=OTATestFG.Verify
  vehicle package Main_OTATestR_RemoveVehiclePackage_1_0_2: packager-signature=ParaCertificate
    rollout-qualifications:
      vehicle rollout step RolloutQualification0
        ucm-processings:
          ucm step UcmProcessing0: ucm=Main_OTATestR_RemoveVehiclePackage_1_0_2/EEVP_UCM
            software package step SoftwarePackageStep0: process=Main_OTATestR_RemoveSoftwarePackage_1_0_2, transfers=software-package-storing={storing=UCM, transfer=Main_OTATestR_RemoveSoftwarePackage_1_0_2}
    ucm description EEVP_UCM: identifier=EEVP_UCM
  software package Main_OTATestR_UpdateSoftwarePackage_1_0_1: action-type=UPDATE, compressed-software-package-size=0, maximum-supported-ucm-version=1.0.0, minimum-supported-ucm-version=1.0.0, packager-id=79, packager-signature=ParaCertificate, post-verification-reboot=false, pre-activate=OTATestFG.Off, pre-activation-reboot=false, software-cluster=Main_OTATest_SoftwareCluster_1_0_1/Main_OTATestR_SoftwareCluster, uncompressed-software-cluster-size=0, verify=OTATestFG.Verify
  vehicle package Main_OTATestR_UpdateVehiclePackage_1_0_1: packager-signature=ParaCertificate
    rollout-qualifications:
      vehicle rollout step RolloutQualification0
        ucm-processings:
          ucm step UcmProcessing0: ucm=Main_OTATestR_UpdateVehiclePackage_1_0_1/EEVP_UCM
            software package step SoftwarePackageStep0: process=Main_OTATestR_UpdateSoftwarePackage_1_0_1, transfers=software-package-storing={storing=UCM, transfer=Main_OTATestR_UpdateSoftwarePackage_1_0_1}
    ucm description EEVP_UCM: identifier=EEVP_UCM
package /Application/Package/Main_OTATestR_SoftwareCluster_1_0_0
  software cluster Main_OTATestR_SoftwareCluster: category=APPLICATION_LAYER, contained-ar-element=OTATestR, contained-package-element=OTATestR_RootSwComponent_OTATestR, contained-process=OTATestR, vendor-id=79, vendor-signature=ParaCertificate, version=1.0.0
package /Application/Package/Main_OTATest_SoftwareCluster_1_0_1
  software cluster Main_OTATestR_SoftwareCluster: category=APPLICATION_LAYER, contained-ar-element=OTATestR, contained-package-element=OTATestR_RootSwComponent_OTATestR, contained-process=OTATestR, vendor-id=79, vendor-signature=ParaCertificate, version=1.0.1
package /Application/Package/Main_OTATest_SoftwareCluster_1_0_2
  software cluster Main_OTATestR_SoftwareCluster: category=APPLICATION_LAYER, contained-ar-element=OTATestR, contained-package-element=OTATestR_RootSwComponent_OTATestR, contained-process=OTATestR, vendor-id=79, vendor-signature=ParaCertificate, version=1.0.2
package /Application/Process
  process OTATestR: executable=OTATestR, state-dependent-startup-config{function-group-state=[OTATestFG.On, OTATestFG.Verify], resource-group=DefaultResourceGroup, startup-config=DefaultStartupConfig}
    process state machine OTATestR: type=ProcessState
package /Application/SwComponent
  adaptive application sw component type OTATestR
    require port OTATestR: required-interface=Main_OTA_Test
