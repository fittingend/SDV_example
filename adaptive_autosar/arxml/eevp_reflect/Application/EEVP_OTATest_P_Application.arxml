AUTOSAR XML (schema 00049)
package /Application/DltConfig
  dlt log channel to process mapping DltLogChannelToProcessMapping_OTATestP_TO_OTATestP: dlt-log-channel=OTATestP, process=OTATestP
package /Application/Executable
  executable OTATestP: category=APPLICATION_LEVEL, reporting-behavior=REPORTS-EXECUTION-STATE, version=1.0.0
    root sw component prototype RootSwComponent: application-type=OTATestP
package /Application/Manifest
  service instance to port prototype mapping OTATestP_RootSwComponent_OTATestP: port-prototype=RootSwComponent.OTATestP, service-instance=EEVP_Provider_Main_OTA_Test
package /Application/Process
  process OTATestP: executable=OTATestP, state-dependent-startup-config{function-group-state=[OTATestFG.On, OTATestFG.Verify], resource-group=DefaultResourceGroup, startup-config=DefaultStartupConfig}
    process state machine OTATestP: type=ProcessState
package /Application/SwComponent
  adaptive application sw component type OTATestP
    provide port OTATestP: provided-interface=Main_OTA_Test
