AUTOSAR XML (schema 00049)
package /ServiceDeployment/Someip
  someip service interface deployment AdasInfoHealth: service-interface=AdasInfoHealth, service-interface-id=6657, service-interface-version={major-version=1, minor-version=0}
    someip field deployment status: field=status
      get Getter_status: method-id=256, transport-protocol=TCP
      notifier Notifier_status: event-id=256, transport-protocol=TCP
    someip event group Eventgroup_Notification_status: event-group-id=33024, event=Notifier_status
package /ServiceInstance/Endpoint
  someip service instance to machine mapping EEVP_InfoHealthTest_SomeipConsumer_AdasInfoHealth: communication-connector=eth0, service-instance=EEVP_InfoHealthTest_Consumer_AdasInfoHealth, tcp-port=30550, udp-port=30550
package /ServiceInstance/Someip/Consumer
  required someip service instance EEVP_InfoHealthTest_Consumer_AdasInfoHealth: service-interface-deployment=AdasInfoHealth, someip-method-props=method=Getter_status, required-minor-version=ANY, required-service-instance-id=ANY, sd-client-config=DefaultSdClientConfig, version-driven-find-behavior=EXACT-OR-ANY-MINOR-VERSION
    someip required event group Eventgroup_Notification_status: event-group=Eventgroup_Notification_status, sd-client-event-group-timing-config=DefaultSdSubscribeConfig
package /ServiceInstance/Someip/Provider
  provided someip service instance EEVP_InfoHealthTest_Provider_AdasInfoHealth: service-interface-deployment=AdasInfoHealth, someip-event-props=event=Notifier_status, someip-method-props=method=Getter_status, sd-server-config=DefaultSdServerConfig, service-instance-id=1
    someip provided event group Eventgroup_Notification_status: event-group=Eventgroup_Notification_status, multicast-threshold=0
package /ServiceInterface
  service interface AdasInfoHealth
    namespaces:
      symbol props adas
      symbol props info
      symbol props health
    field status: type=HealthStatus, has-getter=true, has-notifier=true, has-setter=false
