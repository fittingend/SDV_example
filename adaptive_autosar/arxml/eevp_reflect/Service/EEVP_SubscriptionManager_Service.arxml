AUTOSAR XML (schema 00049)
package /ServiceDeployment/Someip
  someip service interface deployment SubscriptionManagement: service-interface=SubscriptionManagement, service-interface-id=4887, service-interface-version={major-version=1, minor-version=0}
    someip event deployment notifySubscriptionEvent: event=notifySubscriptionInfo, event-id=11, transport-protocol=UDP
    someip method deployment registerSubscriptionApp: method=getSubscriptionInfo, method-id=1, transport-protocol=UDP
    someip event group Eventgroup_notifySubscriptionEvent: event-group-id=21, event=notifySubscriptionEvent
package /ServiceInstance/Endpoint
  someip service instance to machine mapping EEVP_SubscriptionManager_SomeipConsumers_OtaSubscription: communication-connector=eth0, service-instance=EEVP_SubscriptionManager_Consumer_OtaSubscription, tcp-port=55041, udp-port=55041
  someip service instance to machine mapping EEVP_SubscriptionManager_SomeipProviders_SubscriptionManagement: communication-connector=eth0, service-instance=EEVP_SubscriptionManager_Provider_SubscriptionManagement, tcp-port=50021, udp-port=50021
package /ServiceInstance/Someip/Consumer
  required someip service instance EEVP_SubscriptionManager_Consumer_OtaSubscription: service-interface-deployment=OtaSubscription, method-request-propss=[requestAppInstall, requestAppUpdate, requestVersionInfo, method=requestAppRollback, requestOtaProcess], required-minor-version=ANY, required-service-instance-id=ANY, sd-client-config=DefaultSdClientConfig, version-driven-find-behavior=EXACT-OR-ANY-MINOR-VERSION
    5 x someip required event group, all with sd-client-event-group-timing-config=DefaultSdSubscribeConfig:
      Eventgroup_notifyAppEvent: event-group=Eventgroup_notifyAppEvent
      Eventgroup_notifyResultInfo: event-group=Eventgroup_notifyResultInfo
      Eventgroup_notifySwClusterInfo: event-group=Eventgroup_notifySwClusterInfo
      Eventgroup_notifyUpdatableApp: event-group=Eventgroup_notifyUpdatableApp
      Eventgroup_verifySubScription: event-group=Eventgroup_verifySubScription
package /ServiceInstance/Someip/Provider
  provided someip service instance EEVP_SubscriptionManager_Provider_SubscriptionManagement: service-interface-deployment=SubscriptionManagement, someip-event-props=notifySubscriptionEvent, someip-method-props=registerSubscriptionApp, sd-server-config=DefaultSdServerConfig, service-instance-id=1
    someip provided event group Eventgroup_notifySubscriptionEvent: event-group=Eventgroup_notifySubscriptionEvent, multicast-threshold=0
package /ServiceInterface
  service interface SubscriptionManagement
    namespaces:
      symbol props eevp
      symbol props subscription
      symbol props service
    events:
      data notifySubscriptionInfo: type=SubscriptionInfo
    methods:
      operation getSubscriptionInfo: fire-and-forget=false
        arg appName: type=String, direction=IN
        arg isSubscription: type=bool, direction=OUT
