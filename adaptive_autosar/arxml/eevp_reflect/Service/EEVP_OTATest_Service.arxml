AUTOSAR XML (schema 00049)
package /ServiceInterface
  service interface Main_OTA_Test
    namespaces:
      symbol props eevp
      symbol props otatest
      symbol props service
    events:
      data Event0: type=int32_t
    field Field0: type=int32_t, has-getter=true, has-notifier=true, has-setter=true
    methods:
      operation Method0
        arg Arg0: type=int32_t, direction=IN
        arg Arg1: type=String, direction=OUT
package /ServiceDeloyment
  someip service interface deployment Main_OTA_Test: service-interface=Main_OTA_Test, service-interface-id=5008, service-interface-version={major-version=1, minor-version=0}
    someip event deployment Event0: event=Event0, event-id=1, serializer=SOMEIP, transport-protocol=UDP
    someip field deployment Field0: field=Field0
      get Get_Field0: method-id=3, transport-protocol=UDP
      notifier Notification_Field0: event-id=5, transport-protocol=UDP
      set Set_Field0: method-id=4, transport-protocol=UDP
    someip method deployment Method0: method=Method0, method-id=2, transport-protocol=UDP
    someip event group Eventgroup_Event0: event-group-id=6, event=Event0
    someip event group Eventgroup_Notification_Field0: event-group-id=7, event=Notification_Field0
package /ServiceInstance
  required someip service instance EEVP_Consumer_Main_OTA_Test: service-interface-deployment=Main_OTA_Test, method-request-propss=[method=Get_Field0, Set_Field0, Method0], required-service-instance-id=ANY, sd-client-config=DefaultSdClientConfig
    someip required event group Eventgroup_Event0: event-group=Eventgroup_Event0, sd-client-event-group-timing-config=DefaultSdSubscribeConfig
    someip required event group Eventgroup_Notification_Field0: event-group=Eventgroup_Notification_Field0, sd-client-event-group-timing-config=DefaultSdSubscribeConfig
  provided someip service instance EEVP_Provider_Main_OTA_Test: service-interface-deployment=Main_OTA_Test, event-propss=[Event0, Notification_Field0], method-response-propss=[Get_Field0, Set_Field0, Method0], sd-server-config=DefaultSdServerConfig, service-instance-id=1
    someip provided event group Eventgroup_Event0: event-group=Eventgroup_Event0, multicast-threshold=0
    someip provided event group Eventgroup_Notification_Field0: event-group=Eventgroup_Notification_Field0, multicast-threshold=0
  someip service instance to machine mapping EEVP_Someip_Consumers_Main_OTA_Test: communication-connector=eth0, service-instance=EEVP_Consumer_Main_OTA_Test, udp-port=50100
  someip service instance to machine mapping EEVP_Someip_Providers_Main_OTA_Test: communication-connector=eth0, service-instance=EEVP_Provider_Main_OTA_Test, udp-port=50101
