AUTOSAR XML (schema 00049)
package /DataType/CppImplementationType
  std cpp implementation data type ViewMode: compu {0x00=OFF, 0x01=TOP_ONLY, 0x02=THREE_DIM, 0x03=FRONT, 0x04=REAR, 0x05=FRONT_SIDES, 0x06=REAR_SIDES}, type-reference=uint8_t
    namespaces:
      symbol props adas
      symbol props app
      symbol props ipsv
