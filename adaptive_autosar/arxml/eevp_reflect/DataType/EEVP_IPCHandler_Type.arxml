AUTOSAR XML (schema 00049)
package /DataType/CppImplementationType
  6 x std cpp implementation data type:
    OneTimeSysInfo: category=STRUCTURE
      namespaces:
        symbol props eevp
        symbol props ipchandler
        symbol props type
      cpp implementation data type element versions: type-reference=VersionInfo
    PowerState: category=STRUCTURE
      namespaces:
        symbol props eevp
        symbol props ipchandler
        symbol props type
      cpp implementation data type element accState: type-reference=bool
      cpp implementation data type element ign1State: type-reference=bool
      cpp implementation data type element ign3State: type-reference=bool
    String: category=STRING
      namespaces:
        symbol props eevp
        symbol props type
    SysCtrlReq: compu {0=NORMAL, 1=BOOTING, 2=ACC_ON, 3=DELAY, 4=SHUTDOWN, 5=RESET}, type-reference=uint32_t
      namespaces:
        symbol props eevp
        symbol props ipchandler
        symbol props type
    SysCtrlResp: compu {0=NORMAL, 1=BOOTING, 2=ACC_ON, 3=DELAY, 4=SHUTDOWN, 5=RESET}, type-reference=uint32_t
      namespaces:
        symbol props eevp
        symbol props ipchandler
        symbol props type
    VersionInfo: category=STRUCTURE
      namespaces:
        symbol props eevp
        symbol props ipchandler
        symbol props type
      cpp implementation data type element hwVersion: type-reference=String
      cpp implementation data type element swVersion: type-reference=String
