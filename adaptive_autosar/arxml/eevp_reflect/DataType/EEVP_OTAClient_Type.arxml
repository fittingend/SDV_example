AUTOSAR XML (schema 00049)
package /DataType/CppImplementationType
  14 x std cpp implementation data type:
    AppEventError: compu {0x00=SUCCESS, 0x01=INSTALL_FAIL, 0x02=UPDATE_FAIL}, type-reference=uint8_t
      namespaces:
        4 x symbol props:
          eevp
          ota
          monitoring
          type
    RequestAppInfo: category=STRUCTURE
      namespaces:
        4 x symbol props:
          eevp
          ota
          subscription
          type
      4 x cpp implementation data type element:
        appName: type-reference=String
        version: type-reference=String
        lastUpdateTime: type-reference=uint64_t
        actionType: type-reference=String
    RequestAppInfoMap: category=ASSOCIATIVE_MAP, template-arguments=[String, RequestAppInfo]
      namespaces:
        4 x symbol props:
          eevp
          ota
          subscription
          type
    RequestServiceInfo: category=STRUCTURE
      namespaces:
        4 x symbol props:
          eevp
          ota
          monitoring
          type
      4 x cpp implementation data type element:
        serviceName: type-reference=String
        version: type-reference=String
        lastUpdateTime: type-reference=uint64_t
        actionType: type-reference=String
    RequestServiceInfoMap: category=ASSOCIATIVE_MAP, template-arguments=[String, RequestServiceInfo]
      namespaces:
        4 x symbol props:
          eevp
          ota
          monitoring
          type
    ServiceEventError: compu {0x00=SUCCESS, 0x01=INSTALL_FAIL, 0x02=UPDATE_FAIL}, type-reference=uint8_t
      namespaces:
        4 x symbol props:
          eevp
          ota
          monitoring
          type
    UpdatableAppInfo: category=STRUCTURE
      namespaces:
        4 x symbol props:
          eevp
          ota
          subscription
          type
      cpp implementation data type element appName: type-reference=String
      cpp implementation data type element version: type-reference=String
      cpp implementation data type element actionType: type-reference=String
    UpdatableServiceInfo: category=STRUCTURE
      namespaces:
        4 x symbol props:
          eevp
          ota
          monitoring
          type
      cpp implementation data type element serviceName: type-reference=String
      cpp implementation data type element version: type-reference=String
      cpp implementation data type element actionType: type-reference=String
    downloadPackageInfo: category=STRUCTURE
      namespaces:
        4 x symbol props:
          eevp
          ota
          subscription
          type
      11 x cpp implementation data type element:
        appName: type-reference=String
        actionId: type-reference=String
        actionType: type-reference=String
        version: type-reference=String
        jsonDownloadUrl: type-reference=String
        tarDownloadUrl: type-reference=String
        jsonHash: type-reference=String
        tarHash: type-reference=String
        softwareType: type-reference=uint32_t
        jsonFileName: type-reference=String
        tarFileName: type-reference=String
    downloadPackageInfoList: category=VECTOR, cpp-template-argument=downloadPackageInfo
      namespaces:
        4 x symbol props:
          eevp
          ota
          subscription
          type
    resultInfo: category=STRUCTURE
      namespaces:
        4 x symbol props:
          eevp
          ota
          subscription
          type
      cpp implementation data type element appName: type-reference=String
      cpp implementation data type element actionId: type-reference=String
      cpp implementation data type element bSuccess: type-reference=bool
    resultInfoList: category=VECTOR, cpp-template-argument=resultInfo
      namespaces:
        4 x symbol props:
          eevp
          ota
          subscription
          type
    swClusterInfo: category=STRUCTURE
      namespaces:
        4 x symbol props:
          eevp
          ota
          subscription
          type
      cpp implementation data type element appName: type-reference=String
      cpp implementation data type element version: type-reference=String
    swClusterInfoList: category=VECTOR, cpp-template-argument=swClusterInfo
      namespaces:
        4 x symbol props:
          eevp
          ota
          subscription
          type
