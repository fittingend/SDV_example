AUTOSAR XML (schema 00049)
package /DataType/CppImplementationType
  std cpp implementation data type IviErrorReason: compu {0x00=NO_ERROR, 0x01=ERROR_CASE1, 0x02=ERROR_CASE2, 0x03=ERROR_CASE3}, type-reference=uint8_t
    namespaces:
      4 x symbol props:
        ivi
        info
        statemanager
        type
  std cpp implementation data type IviState: compu {0x00=NORMAL, 0x01=ERROR}, type-reference=uint8_t
    namespaces:
      4 x symbol props:
        ivi
        info
        statemanager
        type
  std cpp implementation data type SystemState: category=STRUCTURE
    namespaces:
      4 x symbol props:
        ivi
        info
        statemanager
        type
    cpp implementation data type element currentState: type-reference=IviState
    cpp implementation data type element errorReason: type-reference=IviErrorReason
