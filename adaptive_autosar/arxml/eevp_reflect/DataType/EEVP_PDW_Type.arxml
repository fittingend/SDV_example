AUTOSAR XML (schema 00049)
package /DataType/CppImplementationType
  4 x std cpp implementation data type:
    Direction: compu {0x01=kFront, 0x02=kRear}, type-reference=uint8_t
      namespaces:
        symbol props eevp
        symbol props pdw
        symbol props type
    DistanceLevel: category=STRUCTURE
      namespaces:
        symbol props eevp
        symbol props pdw
        symbol props type
      4 x cpp implementation data type element:
        Left: type-reference=uint8_t
        Right: type-reference=uint8_t
        Center: type-reference=uint8_t
        SensorDirection: type-reference=Direction
    State: compu-method=State, type-reference=uint8_t
      namespaces:
        symbol props eevp
        symbol props pdw
        symbol props type
    UssStatus: category=STRUCTURE
      namespaces:
        symbol props eevp
        symbol props pdw
        symbol props type
      cpp implementation data type element SensorDirection: type-reference=Direction
      cpp implementation data type element SensorStatus: type-reference=State
